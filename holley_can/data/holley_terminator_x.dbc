VERSION ""

NS_ :

BS_:

BU_: Vector__XXX

BO_ 2657357824 IO_OUTPUT23: 8 Vector__XXX
SG_ IO_OUTPUT23 : 7|32@0- (1,0) [-4294967295|4294967295] "" Vector__XXX
SG_ Status : 63|8@0+ (1,0) [0|255] "" Vector__XXX

BO_ 2657374208 IO_OUTPUT24: 8 Vector__XXX
SG_ IO_OUTPUT24 : 7|32@0- (1,0) [-4294967295|4294967295] "" Vector__XXX
SG_ Status : 63|8@0+ (1,0) [0|255] "" Vector__XXX

BO_ 2657390592 IO_OUTPUT25: 8 Vector__XXX
SG_ IO_OUTPUT25 : 7|32@0- (1,0) [-4294967295|4294967295] "" Vector__XXX
SG_ Status : 63|8@0+ (1,0) [0|255] "" Vector__XXX

BO_ 2657406976 IO_OUTPUT26: 8 Vector__XXX
SG_ IO_OUTPUT26 : 7|32@0- (1,0) [-4294967295|4294967295] "" Vector__XXX
SG_ Status : 63|8@0+ (1,0) [0|255] "" Vector__XXX

BO_ 2657423360 IO_OUTPUT27: 8 Vector__XXX
SG_ IO_OUTPUT27 : 7|32@0- (1,0) [-4294967295|4294967295] "" Vector__XXX
SG_ Status : 63|8@0+ (1,0) [0|255] "" Vector__XXX

BO_ 2657439744 IO_OUTPUT28: 8 Vector__XXX
SG_ IO_OUTPUT28 : 7|32@0- (1,0) [-4294967295|4294967295] "" Vector__XXX
SG_ Status : 63|8@0+ (1,0) [0|255] "" Vector__XXX

BO_ 2657456128 IO_OUTPUT29: 8 Vector__XXX
SG_ IO_OUTPUT29 : 7|32@0- (1,0) [-4294967295|4294967295] "" Vector__XXX
SG_ Status : 63|8@0+ (1,0) [0|255] "" Vector__XXX

BO_ 2657472512 IO_OUTPUT30: 8 Vector__XXX
SG_ IO_OUTPUT30 : 7|32@0- (1,0) [-4294967295|4294967295] "" Vector__XXX
SG_ Status : 63|8@0+ (1,0) [0|255] "" Vector__XXX

BO_ 2657488896 IO_OUTPUT31: 8 Vector__XXX
SG_ IO_OUTPUT31 : 7|32@0- (1,0) [-4294967295|4294967295] "" Vector__XXX
SG_ Status : 63|8@0+ (1,0) [0|255] "" Vector__XXX

BO_ 2657505280 IO_OUTPUT32: 8 Vector__XXX
SG_ IO_OUTPUT32 : 7|32@0- (1,0) [-4294967295|4294967295] "" Vector__XXX
SG_ Status : 63|8@0+ (1,0) [0|255] "" Vector__XXX

BO_ 2657521664 IO_OUTPUT33: 8 Vector__XXX
SG_ IO_OUTPUT33 : 7|32@0- (1,0) [-4294967295|4294967295] "" Vector__XXX
SG_ Status : 63|8@0+ (1,0) [0|255] "" Vector__XXX

BO_ 2657538048 IO_OUTPUT34: 8 Vector__XXX
SG_ IO_OUTPUT34 : 7|32@0- (1,0) [-4294967295|4294967295] "" Vector__XXX
SG_ Status : 63|8@0+ (1,0) [0|255] "" Vector__XXX

BO_ 2657554432 IO_OUTPUT35: 8 Vector__XXX
SG_ IO_OUTPUT35 : 7|32@0- (1,0) [-4294967295|4294967295] "" Vector__XXX
SG_ Status : 63|8@0+ (1,0) [0|255] "" Vector__XXX

BO_ 2657570816 IO_OUTPUT36: 8 Vector__XXX
SG_ IO_OUTPUT36 : 7|32@0- (1,0) [-4294967295|4294967295] "" Vector__XXX
SG_ Status : 63|8@0+ (1,0) [0|255] "" Vector__XXX

BO_ 2657587200 IO_OUTPUT37: 8 Vector__XXX
SG_ IO_OUTPUT37 : 7|32@0- (1,0) [-4294967295|4294967295] "" Vector__XXX
SG_ Status : 63|8@0+ (1,0) [0|255] "" Vector__XXX

BO_ 2657603584 IO_OUTPUT38: 8 Vector__XXX
SG_ IO_OUTPUT38 : 7|32@0- (1,0) [-4294967295|4294967295] "" Vector__XXX
SG_ Status : 63|8@0+ (1,0) [0|255] "" Vector__XXX

BO_ 2657619968 IO_OUTPUT39: 8 Vector__XXX
SG_ IO_OUTPUT39 : 7|32@0- (1,0) [-4294967295|4294967295] "" Vector__XXX
SG_ Status : 63|8@0+ (1,0) [0|255] "" Vector__XXX

BO_ 2657636352 IO_OUTPUT40: 8 Vector__XXX
SG_ IO_OUTPUT40 : 7|32@0- (1,0) [-4294967295|4294967295] "" Vector__XXX
SG_ Status : 63|8@0+ (1,0) [0|255] "" Vector__XXX

BO_ 2657652736 IO_OUTPUT41: 8 Vector__XXX
SG_ IO_OUTPUT41 : 7|32@0- (1,0) [-4294967295|4294967295] "" Vector__XXX
SG_ Status : 63|8@0+ (1,0) [0|255] "" Vector__XXX

BO_ 2657669120 IO_OUTPUT42: 8 Vector__XXX
SG_ IO_OUTPUT42 : 7|32@0- (1,0) [-4294967295|4294967295] "" Vector__XXX
SG_ Status : 63|8@0+ (1,0) [0|255] "" Vector__XXX

BO_ 2657685504 IO_OUTPUT43: 8 Vector__XXX
SG_ IO_OUTPUT43 : 7|32@0- (1,0) [-4294967295|4294967295] "" Vector__XXX
SG_ Status : 63|8@0+ (1,0) [0|255] "" Vector__XXX

BO_ 2657701888 IO_OUTPUT44: 8 Vector__XXX
SG_ IO_OUTPUT44 : 7|32@0- (1,0) [-4294967295|4294967295] "" Vector__XXX
SG_ Status : 63|8@0+ (1,0) [0|255] "" Vector__XXX

BO_ 2657718272 IO_OUTPUT45: 8 Vector__XXX
SG_ IO_OUTPUT45 : 7|32@0- (1,0) [-4294967295|4294967295] "" Vector__XXX
SG_ Status : 63|8@0+ (1,0) [0|255] "" Vector__XXX

BO_ 2657734656 IO_OUTPUT46: 8 Vector__XXX
SG_ IO_OUTPUT46 : 7|32@0- (1,0) [-4294967295|4294967295] "" Vector__XXX
SG_ Status : 63|8@0+ (1,0) [0|255] "" Vector__XXX

BO_ 2657751040 IO_OUTPUT47: 8 Vector__XXX
SG_ IO_OUTPUT47 : 7|32@0- (1,0) [-4294967295|4294967295] "" Vector__XXX
SG_ Status : 63|8@0+ (1,0) [0|255] "" Vector__XXX

BO_ 2657767424 IO_OUTPUT48: 8 Vector__XXX
SG_ IO_OUTPUT48 : 7|32@0- (1,0) [-4294967295|4294967295] "" Vector__XXX
SG_ Status : 63|8@0+ (1,0) [0|255] "" Vector__XXX

BO_ 2657783808 IO_OUTPUT49: 8 Vector__XXX
SG_ IO_OUTPUT49 : 7|32@0- (1,0) [-4294967295|4294967295] "" Vector__XXX
SG_ Status : 63|8@0+ (1,0) [0|255] "" Vector__XXX

BO_ 2657800192 IO_OUTPUT50: 8 Vector__XXX
SG_ IO_OUTPUT50 : 7|32@0- (1,0) [-4294967295|4294967295] "" Vector__XXX
SG_ Status : 63|8@0+ (1,0) [0|255] "" Vector__XXX

BO_ 2657816576 IO_OUTPUT51: 8 Vector__XXX
SG_ IO_OUTPUT51 : 7|32@0- (1,0) [-4294967295|4294967295] "" Vector__XXX
SG_ Status : 63|8@0+ (1,0) [0|255] "" Vector__XXX

BO_ 2657832960 IO_OUTPUT52: 8 Vector__XXX
SG_ IO_OUTPUT52 : 7|32@0- (1,0) [-4294967295|4294967295] "" Vector__XXX
SG_ Status : 63|8@0+ (1,0) [0|255] "" Vector__XXX

BO_ 2657849344 IO_OUTPUT53: 8 Vector__XXX
SG_ IO_OUTPUT53 : 7|32@0- (1,0) [-4294967295|4294967295] "" Vector__XXX
SG_ Status : 63|8@0+ (1,0) [0|255] "" Vector__XXX

BO_ 2657865728 IO_OUTPUT54: 8 Vector__XXX
SG_ IO_OUTPUT54 : 7|32@0- (1,0) [-4294967295|4294967295] "" Vector__XXX
SG_ Status : 63|8@0+ (1,0) [0|255] "" Vector__XXX

BO_ 2657882112 IO_OUTPUT55: 8 Vector__XXX
SG_ IO_OUTPUT55 : 7|32@0- (1,0) [-4294967295|4294967295] "" Vector__XXX
SG_ Status : 63|8@0+ (1,0) [0|255] "" Vector__XXX

BO_ 2657898496 IO_OUTPUT56: 8 Vector__XXX
SG_ IO_OUTPUT56 : 7|32@0- (1,0) [-4294967295|4294967295] "" Vector__XXX
SG_ Status : 63|8@0+ (1,0) [0|255] "" Vector__XXX

BO_ 2657914880 IO_OUTPUT57: 8 Vector__XXX
SG_ IO_OUTPUT57 : 7|32@0- (1,0) [-4294967295|4294967295] "" Vector__XXX
SG_ Status : 63|8@0+ (1,0) [0|255] "" Vector__XXX

BO_ 2657931264 IO_OUTPUT58: 8 Vector__XXX
SG_ IO_OUTPUT58 : 7|32@0- (1,0) [-4294967295|4294967295] "" Vector__XXX
SG_ Status : 63|8@0+ (1,0) [0|255] "" Vector__XXX

BO_ 2657947648 IO_OUTPUT59: 8 Vector__XXX
SG_ IO_OUTPUT59 : 7|32@0- (1,0) [-4294967295|4294967295] "" Vector__XXX
SG_ Status : 63|8@0+ (1,0) [0|255] "" Vector__XXX

BO_ 2657964032 IO_OUTPUT60: 8 Vector__XXX
SG_ IO_OUTPUT60 : 7|32@0- (1,0) [-4294967295|4294967295] "" Vector__XXX
SG_ Status : 63|8@0+ (1,0) [0|255] "" Vector__XXX

BO_ 2657980416 IO_OUTPUT61: 8 Vector__XXX
SG_ IO_OUTPUT61 : 7|32@0- (1,0) [-4294967295|4294967295] "" Vector__XXX
SG_ Status : 63|8@0+ (1,0) [0|255] "" Vector__XXX

BO_ 2657996800 IO_OUTPUT62: 8 Vector__XXX
SG_ IO_OUTPUT62 : 7|32@0- (1,0) [-4294967295|4294967295] "" Vector__XXX
SG_ Status : 63|8@0+ (1,0) [0|255] "" Vector__XXX

BO_ 2658013184 FUEL_TABLE1_PERCENT: 8 Vector__XXX
SG_ FUEL_TABLE1_PERCENT : 7|32@0- (1,0) [-4294967295|4294967295] "" Vector__XXX
SG_ Status : 63|8@0+ (1,0) [0|255] "" Vector__XXX

BO_ 2658029568 FUEL_TABLE2_PERCENT: 8 Vector__XXX
SG_ FUEL_TABLE2_PERCENT : 7|32@0- (1,0) [-4294967295|4294967295] "" Vector__XXX
SG_ Status : 63|8@0+ (1,0) [0|255] "" Vector__XXX

BO_ 2658045952 FUEL_TABLE3_PERCENT: 8 Vector__XXX
SG_ FUEL_TABLE3_PERCENT : 7|32@0- (1,0) [-4294967295|4294967295] "" Vector__XXX
SG_ Status : 63|8@0+ (1,0) [0|255] "" Vector__XXX

BO_ 2658062336 SYSTEM_INJ_PPH13: 8 Vector__XXX
SG_ SYSTEM_INJ_PPH13 : 7|32@0- (1,0) [-4294967295|4294967295] "" Vector__XXX
SG_ Status : 63|8@0+ (1,0) [0|255] "" Vector__XXX

BO_ 2658078720 SYSTEM_INJ_PPH14: 8 Vector__XXX
SG_ SYSTEM_INJ_PPH14 : 7|32@0- (1,0) [-4294967295|4294967295] "" Vector__XXX
SG_ Status : 63|8@0+ (1,0) [0|255] "" Vector__XXX

BO_ 2658095104 SYSTEM_INJ_PPH15: 8 Vector__XXX
SG_ SYSTEM_INJ_PPH15 : 7|32@0- (1,0) [-4294967295|4294967295] "" Vector__XXX
SG_ Status : 63|8@0+ (1,0) [0|255] "" Vector__XXX

BO_ 2658111488 SYSTEM_INJ_PPH16: 8 Vector__XXX
SG_ SYSTEM_INJ_PPH16 : 7|32@0- (1,0) [-4294967295|4294967295] "" Vector__XXX
SG_ Status : 63|8@0+ (1,0) [0|255] "" Vector__XXX

BO_ 2658127872 SYSTEM_INJ_PPH17: 8 Vector__XXX
SG_ SYSTEM_INJ_PPH17 : 7|32@0- (1,0) [-4294967295|4294967295] "" Vector__XXX
SG_ Status : 63|8@0+ (1,0) [0|255] "" Vector__XXX

BO_ 2658144256 SYSTEM_INJ_PPH18: 8 Vector__XXX
SG_ SYSTEM_INJ_PPH18 : 7|32@0- (1,0) [-4294967295|4294967295] "" Vector__XXX
SG_ Status : 63|8@0+ (1,0) [0|255] "" Vector__XXX

BO_ 2658160640 SYSTEM_INJ_PPH19: 8 Vector__XXX
SG_ SYSTEM_INJ_PPH19 : 7|32@0- (1,0) [-4294967295|4294967295] "" Vector__XXX
SG_ Status : 63|8@0+ (1,0) [0|255] "" Vector__XXX

BO_ 2658177024 SYSTEM_INJ_PPH20: 8 Vector__XXX
SG_ SYSTEM_INJ_PPH20 : 7|32@0- (1,0) [-4294967295|4294967295] "" Vector__XXX
SG_ Status : 63|8@0+ (1,0) [0|255] "" Vector__XXX

BO_ 2658193408 SYSTEM_INJ_PPH21: 8 Vector__XXX
SG_ SYSTEM_INJ_PPH21 : 7|32@0- (1,0) [-4294967295|4294967295] "" Vector__XXX
SG_ Status : 63|8@0+ (1,0) [0|255] "" Vector__XXX

BO_ 2658209792 SYSTEM_INJ_PPH22: 8 Vector__XXX
SG_ SYSTEM_INJ_PPH22 : 7|32@0- (1,0) [-4294967295|4294967295] "" Vector__XXX
SG_ Status : 63|8@0+ (1,0) [0|255] "" Vector__XXX

BO_ 2658226176 SYSTEM_INJ_PPH23: 8 Vector__XXX
SG_ SYSTEM_INJ_PPH23 : 7|32@0- (1,0) [-4294967295|4294967295] "" Vector__XXX
SG_ Status : 63|8@0+ (1,0) [0|255] "" Vector__XXX

BO_ 2658242560 SYSTEM_INJ_PPH24: 8 Vector__XXX
SG_ SYSTEM_INJ_PPH24 : 7|32@0- (1,0) [-4294967295|4294967295] "" Vector__XXX
SG_ Status : 63|8@0+ (1,0) [0|255] "" Vector__XXX

BO_ 2658258944 SYSTEM_INJ_PPH25: 8 Vector__XXX
SG_ SYSTEM_INJ_PPH25 : 7|32@0- (1,0) [-4294967295|4294967295] "" Vector__XXX
SG_ Status : 63|8@0+ (1,0) [0|255] "" Vector__XXX

BO_ 2658275328 SYSTEM_INJ_PPH26: 8 Vector__XXX
SG_ SYSTEM_INJ_PPH26 : 7|32@0- (1,0) [-4294967295|4294967295] "" Vector__XXX
SG_ Status : 63|8@0+ (1,0) [0|255] "" Vector__XXX

BO_ 2658291712 SYSTEM_INJ_PPH27: 8 Vector__XXX
SG_ SYSTEM_INJ_PPH27 : 7|32@0- (1,0) [-4294967295|4294967295] "" Vector__XXX
SG_ Status : 63|8@0+ (1,0) [0|255] "" Vector__XXX

BO_ 2658308096 SYSTEM_INJ_PPH28: 8 Vector__XXX
SG_ SYSTEM_INJ_PPH28 : 7|32@0- (1,0) [-4294967295|4294967295] "" Vector__XXX
SG_ Status : 63|8@0+ (1,0) [0|255] "" Vector__XXX

BO_ 2658324480 SYSTEM_INJ_PW13: 8 Vector__XXX
SG_ SYSTEM_INJ_PW13 : 7|32@0- (1,0) [-4294967295|4294967295] "" Vector__XXX
SG_ Status : 63|8@0+ (1,0) [0|255] "" Vector__XXX

BO_ 2658340864 SYSTEM_INJ_PW14: 8 Vector__XXX
SG_ SYSTEM_INJ_PW14 : 7|32@0- (1,0) [-4294967295|4294967295] "" Vector__XXX
SG_ Status : 63|8@0+ (1,0) [0|255] "" Vector__XXX

BO_ 2658357248 SYSTEM_INJ_PW15: 8 Vector__XXX
SG_ SYSTEM_INJ_PW15 : 7|32@0- (1,0) [-4294967295|4294967295] "" Vector__XXX
SG_ Status : 63|8@0+ (1,0) [0|255] "" Vector__XXX

BO_ 2658373632 SYSTEM_INJ_PW16: 8 Vector__XXX
SG_ SYSTEM_INJ_PW16 : 7|32@0- (1,0) [-4294967295|4294967295] "" Vector__XXX
SG_ Status : 63|8@0+ (1,0) [0|255] "" Vector__XXX

BO_ 2658390016 SYSTEM_INJ_PW17: 8 Vector__XXX
SG_ SYSTEM_INJ_PW17 : 7|32@0- (1,0) [-4294967295|4294967295] "" Vector__XXX
SG_ Status : 63|8@0+ (1,0) [0|255] "" Vector__XXX

BO_ 2658406400 SYSTEM_INJ_PW18: 8 Vector__XXX
SG_ SYSTEM_INJ_PW18 : 7|32@0- (1,0) [-4294967295|4294967295] "" Vector__XXX
SG_ Status : 63|8@0+ (1,0) [0|255] "" Vector__XXX

BO_ 2658422784 SYSTEM_INJ_PW19: 8 Vector__XXX
SG_ SYSTEM_INJ_PW19 : 7|32@0- (1,0) [-4294967295|4294967295] "" Vector__XXX
SG_ Status : 63|8@0+ (1,0) [0|255] "" Vector__XXX

BO_ 2658439168 SYSTEM_INJ_PW20: 8 Vector__XXX
SG_ SYSTEM_INJ_PW20 : 7|32@0- (1,0) [-4294967295|4294967295] "" Vector__XXX
SG_ Status : 63|8@0+ (1,0) [0|255] "" Vector__XXX

BO_ 2658455552 SYSTEM_INJ_PW21: 8 Vector__XXX
SG_ SYSTEM_INJ_PW21 : 7|32@0- (1,0) [-4294967295|4294967295] "" Vector__XXX
SG_ Status : 63|8@0+ (1,0) [0|255] "" Vector__XXX

BO_ 2658471936 SYSTEM_INJ_PW22: 8 Vector__XXX
SG_ SYSTEM_INJ_PW22 : 7|32@0- (1,0) [-4294967295|4294967295] "" Vector__XXX
SG_ Status : 63|8@0+ (1,0) [0|255] "" Vector__XXX

BO_ 2658488320 SYSTEM_INJ_PW23: 8 Vector__XXX
SG_ SYSTEM_INJ_PW23 : 7|32@0- (1,0) [-4294967295|4294967295] "" Vector__XXX
SG_ Status : 63|8@0+ (1,0) [0|255] "" Vector__XXX

BO_ 2658504704 SYSTEM_INJ_PW24: 8 Vector__XXX
SG_ SYSTEM_INJ_PW24 : 7|32@0- (1,0) [-4294967295|4294967295] "" Vector__XXX
SG_ Status : 63|8@0+ (1,0) [0|255] "" Vector__XXX

BO_ 2658521088 SYSTEM_INJ_PW25: 8 Vector__XXX
SG_ SYSTEM_INJ_PW25 : 7|32@0- (1,0) [-4294967295|4294967295] "" Vector__XXX
SG_ Status : 63|8@0+ (1,0) [0|255] "" Vector__XXX

BO_ 2658537472 SYSTEM_INJ_PW26: 8 Vector__XXX
SG_ SYSTEM_INJ_PW26 : 7|32@0- (1,0) [-4294967295|4294967295] "" Vector__XXX
SG_ Status : 63|8@0+ (1,0) [0|255] "" Vector__XXX

BO_ 2658553856 SYSTEM_INJ_PW27: 8 Vector__XXX
SG_ SYSTEM_INJ_PW27 : 7|32@0- (1,0) [-4294967295|4294967295] "" Vector__XXX
SG_ Status : 63|8@0+ (1,0) [0|255] "" Vector__XXX

BO_ 2658570240 SYSTEM_INJ_PW28: 8 Vector__XXX
SG_ SYSTEM_INJ_PW28 : 7|32@0- (1,0) [-4294967295|4294967295] "" Vector__XXX
SG_ Status : 63|8@0+ (1,0) [0|255] "" Vector__XXX

BO_ 2658586624 SYSTEM_STAGING_INPUT1: 8 Vector__XXX
SG_ SYSTEM_STAGING_INPUT1 : 7|32@0- (1,0) [-4294967295|4294967295] "" Vector__XXX
SG_ Status : 63|8@0+ (1,0) [0|255] "" Vector__XXX

BO_ 2658603008 SYSTEM_STAGING_INPUT2: 8 Vector__XXX
SG_ SYSTEM_STAGING_INPUT2 : 7|32@0- (1,0) [-4294967295|4294967295] "" Vector__XXX
SG_ Status : 63|8@0+ (1,0) [0|255] "" Vector__XXX

BO_ 2658619392 SYSTEM_STAGING_OUTPUT: 8 Vector__XXX
SG_ SYSTEM_STAGING_OUTPUT : 7|32@0- (1,0) [-4294967295|4294967295] "" Vector__XXX
SG_ Status : 63|8@0+ (1,0) [0|255] "" Vector__XXX

BO_ 2658635776 TRACTION_SMARTDROP: 8 Vector__XXX
SG_ TRACTION_SMARTDROP : 7|32@0- (1,0) [-4294967295|4294967295] "" Vector__XXX
SG_ Status : 63|8@0+ (1,0) [0|255] "" Vector__XXX

BO_ 2658652160 TRACTION_TIMINGRETARD: 8 Vector__XXX
SG_ TRACTION_TIMINGRETARD : 7|32@0- (1,0) [-4294967295|4294967295] "" Vector__XXX
SG_ Status : 63|8@0+ (1,0) [0|255] "" Vector__XXX

BO_ 2658668544 TRACTION_N2ODECREASE: 8 Vector__XXX
SG_ TRACTION_N2ODECREASE : 7|32@0- (1,0) [-4294967295|4294967295] "" Vector__XXX
SG_ Status : 63|8@0+ (1,0) [0|255] "" Vector__XXX

BO_ 2658684928 TRACTION_BOOSTDECREASE: 8 Vector__XXX
SG_ TRACTION_BOOSTDECREASE : 7|32@0- (1,0) [-4294967295|4294967295] "" Vector__XXX
SG_ Status : 63|8@0+ (1,0) [0|255] "" Vector__XXX

BO_ 2658701312 TRACTION_DBWDECREASE: 8 Vector__XXX
SG_ TRACTION_DBWDECREASE : 7|32@0- (1,0) [-4294967295|4294967295] "" Vector__XXX
SG_ Status : 63|8@0+ (1,0) [0|255] "" Vector__XXX

BO_ 2658717696 TRACTION_DSTIMINGOFFSET: 8 Vector__XXX
SG_ TRACTION_DSTIMINGOFFSET : 7|32@0- (1,0) [-4294967295|4294967295] "" Vector__XXX
SG_ Status : 63|8@0+ (1,0) [0|255] "" Vector__XXX

BO_ 2658734080 TRACTION_CSTIMINGOFFSET: 8 Vector__XXX
SG_ TRACTION_CSTIMINGOFFSET : 7|32@0- (1,0) [-4294967295|4294967295] "" Vector__XXX
SG_ Status : 63|8@0+ (1,0) [0|255] "" Vector__XXX

BO_ 2658750464 TRACTION_DSREVLIMIT: 8 Vector__XXX
SG_ TRACTION_DSREVLIMIT : 7|32@0- (1,0) [-4294967295|4294967295] "" Vector__XXX
SG_ Status : 63|8@0+ (1,0) [0|255] "" Vector__XXX

BO_ 2658766848 TRACTION_CSREVLIMIT: 8 Vector__XXX
SG_ TRACTION_CSREVLIMIT : 7|32@0- (1,0) [-4294967295|4294967295] "" Vector__XXX
SG_ Status : 63|8@0+ (1,0) [0|255] "" Vector__XXX

BO_ 2658783232 TRACTION_TCTIME: 8 Vector__XXX
SG_ TRACTION_TCTIME : 7|32@0- (1,0) [-4294967295|4294967295] "" Vector__XXX
SG_ Status : 63|8@0+ (1,0) [0|255] "" Vector__XXX

BO_ 2658799616 TRACTION_TCLAUNCHINPUT: 8 Vector__XXX
SG_ TRACTION_TCLAUNCHINPUT : 7|32@0- (1,0) [-4294967295|4294967295] "" Vector__XXX
SG_ Status : 63|8@0+ (1,0) [0|255] "" Vector__XXX

BO_ 2658816000 DIFUEL_GRAMSPERCYLINDER: 8 Vector__XXX
SG_ DIFUEL_GRAMSPERCYLINDER : 7|32@0- (1,0) [-4294967295|4294967295] "" Vector__XXX
SG_ Status : 63|8@0+ (1,0) [0|255] "" Vector__XXX

BO_ 2658832384 VVT_DESIREDINTAKECAMPOS: 8 Vector__XXX
SG_ VVT_DESIREDINTAKECAMPOS : 7|32@0- (1,0) [-4294967295|4294967295] "" Vector__XXX
SG_ Status : 63|8@0+ (1,0) [0|255] "" Vector__XXX

BO_ 2658848768 VVT_ACTUALINTAKECAMPOS: 8 Vector__XXX
SG_ VVT_ACTUALINTAKECAMPOS : 7|32@0- (1,0) [-4294967295|4294967295] "" Vector__XXX
SG_ Status : 63|8@0+ (1,0) [0|255] "" Vector__XXX

BO_ 2658865152 VVT_INTAKESOLDUTY: 8 Vector__XXX
SG_ VVT_INTAKESOLDUTY : 7|32@0- (1,0) [-4294967295|4294967295] "" Vector__XXX
SG_ Status : 63|8@0+ (1,0) [0|255] "" Vector__XXX

BO_ 2658881536 VVT_DESIREDEXHAUSTCAMPOS: 8 Vector__XXX
SG_ VVT_DESIREDEXHAUSTCAMPOS : 7|32@0- (1,0) [-4294967295|4294967295] "" Vector__XXX
SG_ Status : 63|8@0+ (1,0) [0|255] "" Vector__XXX

BO_ 2658897920 VVT_ACTUALEXHAUSTCAMPOS: 8 Vector__XXX
SG_ VVT_ACTUALEXHAUSTCAMPOS : 7|32@0- (1,0) [-4294967295|4294967295] "" Vector__XXX
SG_ Status : 63|8@0+ (1,0) [0|255] "" Vector__XXX

BO_ 2658914304 VVT_EXHAUSTSOLDUTY: 8 Vector__XXX
SG_ VVT_EXHAUSTSOLDUTY : 7|32@0- (1,0) [-4294967295|4294967295] "" Vector__XXX
SG_ Status : 63|8@0+ (1,0) [0|255] "" Vector__XXX

BO_ 2658930688 TRANS_GOVERNORPRESSUREPSIACTUAL: 8 Vector__XXX
SG_ TRANS_GOVERNORPRESSUREPSIACTUAL : 7|32@0- (1,0) [-4294967295|4294967295] "" Vector__XXX
SG_ Status : 63|8@0+ (1,0) [0|255] "" Vector__XXX

BO_ 2658947072 TRANS_GOVERNORPRESSUREPSITARGET: 8 Vector__XXX
SG_ TRANS_GOVERNORPRESSUREPSITARGET : 7|32@0- (1,0) [-4294967295|4294967295] "" Vector__XXX
SG_ Status : 63|8@0+ (1,0) [0|255] "" Vector__XXX

BO_ 2658963456 TRANS_LINEPRESSUREPSIACTUAL: 8 Vector__XXX
SG_ TRANS_LINEPRESSUREPSIACTUAL : 7|32@0- (1,0) [-4294967295|4294967295] "" Vector__XXX
SG_ Status : 63|8@0+ (1,0) [0|255] "" Vector__XXX

BO_ 2658979840 RACE_LAUNCH_STATUS: 8 Vector__XXX
SG_ RACE_LAUNCH_STATUS : 7|32@0- (1,0) [-4294967295|4294967295] "" Vector__XXX
SG_ Status : 63|8@0+ (1,0) [0|255] "" Vector__XXX

BO_ 2658996224 RACE_SPOOL_ASSIST_OUTPUT_STATUS2: 8 Vector__XXX
SG_ RACE_SPOOL_ASSIST_OUTPUT_STATUS2 : 7|32@0- (1,0) [-4294967295|4294967295] "" Vector__XXX
SG_ Status : 63|8@0+ (1,0) [0|255] "" Vector__XXX

BO_ 2659012608 RACE_SHIFT_SINGLE_OUTPUT_STATUS: 8 Vector__XXX
SG_ RACE_SHIFT_SINGLE_OUTPUT_STATUS : 7|32@0- (1,0) [-4294967295|4294967295] "" Vector__XXX
SG_ Status : 63|8@0+ (1,0) [0|255] "" Vector__XXX

BO_ 2659028992 RACE_SHIFT_1_2_OUTPUT_STATUS: 8 Vector__XXX
SG_ RACE_SHIFT_1_2_OUTPUT_STATUS : 7|32@0- (1,0) [-4294967295|4294967295] "" Vector__XXX
SG_ Status : 63|8@0+ (1,0) [0|255] "" Vector__XXX

BO_ 2659045376 RACE_SHIFT_2_3_OUTPUT_STATUS: 8 Vector__XXX
SG_ RACE_SHIFT_2_3_OUTPUT_STATUS : 7|32@0- (1,0) [-4294967295|4294967295] "" Vector__XXX
SG_ Status : 63|8@0+ (1,0) [0|255] "" Vector__XXX

BO_ 2659061760 RACE_SHIFT_3_4_OUTPUT_STATUS: 8 Vector__XXX
SG_ RACE_SHIFT_3_4_OUTPUT_STATUS : 7|32@0- (1,0) [-4294967295|4294967295] "" Vector__XXX
SG_ Status : 63|8@0+ (1,0) [0|255] "" Vector__XXX

BO_ 2659078144 RACE_SHIFT_4_5_OUTPUT_STATUS: 8 Vector__XXX
SG_ RACE_SHIFT_4_5_OUTPUT_STATUS : 7|32@0- (1,0) [-4294967295|4294967295] "" Vector__XXX
SG_ Status : 63|8@0+ (1,0) [0|255] "" Vector__XXX

BO_ 2659094528 RACE_SHIFT_5_6_OUTPUT_STATUS: 8 Vector__XXX
SG_ RACE_SHIFT_5_6_OUTPUT_STATUS : 7|32@0- (1,0) [-4294967295|4294967295] "" Vector__XXX
SG_ Status : 63|8@0+ (1,0) [0|255] "" Vector__XXX

BO_ 2659110912 RACE_SHIFT_6_7_OUTPUT_STATUS: 8 Vector__XXX
SG_ RACE_SHIFT_6_7_OUTPUT_STATUS : 7|32@0- (1,0) [-4294967295|4294967295] "" Vector__XXX
SG_ Status : 63|8@0+ (1,0) [0|255] "" Vector__XXX

BO_ 2659127296 RACE_SHIFT_7_8_OUTPUT_STATUS: 8 Vector__XXX
SG_ RACE_SHIFT_7_8_OUTPUT_STATUS : 7|32@0- (1,0) [-4294967295|4294967295] "" Vector__XXX
SG_ Status : 63|8@0+ (1,0) [0|255] "" Vector__XXX

BO_ 2659143680 RACE_SHIFT_OVERRIDE_STATUS: 8 Vector__XXX
SG_ RACE_SHIFT_OVERRIDE_STATUS : 7|32@0- (1,0) [-4294967295|4294967295] "" Vector__XXX
SG_ Status : 63|8@0+ (1,0) [0|255] "" Vector__XXX

BO_ 2659160064 RACE_SHIFT_MASTER_ENABLE_STATUS: 8 Vector__XXX
SG_ RACE_SHIFT_MASTER_ENABLE_STATUS : 7|32@0- (1,0) [-4294967295|4294967295] "" Vector__XXX
SG_ Status : 63|8@0+ (1,0) [0|255] "" Vector__XXX

BO_ 2659176448 RACE_SHIFT_IGNITION_CUT_STATUS: 8 Vector__XXX
SG_ RACE_SHIFT_IGNITION_CUT_STATUS : 7|32@0- (1,0) [-4294967295|4294967295] "" Vector__XXX
SG_ Status : 63|8@0+ (1,0) [0|255] "" Vector__XXX

BO_ 2659192832 RACE_SHIFT_TIMING_MODIFIER: 8 Vector__XXX
SG_ RACE_SHIFT_TIMING_MODIFIER : 7|32@0- (1,0) [-4294967295|4294967295] "" Vector__XXX
SG_ Status : 63|8@0+ (1,0) [0|255] "" Vector__XXX

BO_ 2659209216 RACE_SHIFT_TIMER: 8 Vector__XXX
SG_ RACE_SHIFT_TIMER : 7|32@0- (1,0) [-4294967295|4294967295] "" Vector__XXX
SG_ Status : 63|8@0+ (1,0) [0|255] "" Vector__XXX

BO_ 2659225600 RACE_CONVERTER_LOCK1: 8 Vector__XXX
SG_ RACE_CONVERTER_LOCK1 : 7|32@0- (1,0) [-4294967295|4294967295] "" Vector__XXX
SG_ Status : 63|8@0+ (1,0) [0|255] "" Vector__XXX

BO_ 2659241984 RACE_CONVERTER_LOCK2: 8 Vector__XXX
SG_ RACE_CONVERTER_LOCK2 : 7|32@0- (1,0) [-4294967295|4294967295] "" Vector__XXX
SG_ Status : 63|8@0+ (1,0) [0|255] "" Vector__XXX

BO_ 2659258368 RACE_CONVERTER_LOCK3: 8 Vector__XXX
SG_ RACE_CONVERTER_LOCK3 : 7|32@0- (1,0) [-4294967295|4294967295] "" Vector__XXX
SG_ Status : 63|8@0+ (1,0) [0|255] "" Vector__XXX

BO_ 2659274752 RACE_CONVERTER_LOCK4: 8 Vector__XXX
SG_ RACE_CONVERTER_LOCK4 : 7|32@0- (1,0) [-4294967295|4294967295] "" Vector__XXX
SG_ Status : 63|8@0+ (1,0) [0|255] "" Vector__XXX

BO_ 2659291136 RACE_CONVERTER_LOCK_DISABLE_STAT: 8 Vector__XXX
SG_ RACE_CONVERTER_LOCK_DISABLE_STAT : 7|32@0- (1,0) [-4294967295|4294967295] "" Vector__XXX
SG_ Status : 63|8@0+ (1,0) [0|255] "" Vector__XXX

BO_ 2659307520 RACE_SPOOL_ASSIST_OUTPUT_STATUS: 8 Vector__XXX
SG_ RACE_SPOOL_ASSIST_OUTPUT_STATUS : 7|32@0- (1,0) [-4294967295|4294967295] "" Vector__XXX
SG_ Status : 63|8@0+ (1,0) [0|255] "" Vector__XXX

BO_ 2659323904 RACE_TRANS_DUMP_VALVE1: 8 Vector__XXX
SG_ RACE_TRANS_DUMP_VALVE1 : 7|32@0- (1,0) [-4294967295|4294967295] "" Vector__XXX
SG_ Status : 63|8@0+ (1,0) [0|255] "" Vector__XXX

BO_ 2659340288 RACE_TRANS_DUMP_VALVE2: 8 Vector__XXX
SG_ RACE_TRANS_DUMP_VALVE2 : 7|32@0- (1,0) [-4294967295|4294967295] "" Vector__XXX
SG_ Status : 63|8@0+ (1,0) [0|255] "" Vector__XXX

BO_ 2659356672 RACE_TRANS_DUMP_VALVE3: 8 Vector__XXX
SG_ RACE_TRANS_DUMP_VALVE3 : 7|32@0- (1,0) [-4294967295|4294967295] "" Vector__XXX
SG_ Status : 63|8@0+ (1,0) [0|255] "" Vector__XXX

BO_ 2659373056 RACE_TRANS_DUMP_VALVE4: 8 Vector__XXX
SG_ RACE_TRANS_DUMP_VALVE4 : 7|32@0- (1,0) [-4294967295|4294967295] "" Vector__XXX
SG_ Status : 63|8@0+ (1,0) [0|255] "" Vector__XXX

BO_ 2659389440 RACE_TRANS_DUMP_DISABLE_STATUS: 8 Vector__XXX
SG_ RACE_TRANS_DUMP_DISABLE_STATUS : 7|32@0- (1,0) [-4294967295|4294967295] "" Vector__XXX
SG_ Status : 63|8@0+ (1,0) [0|255] "" Vector__XXX

VAL_ 2657357824 Status 0 "OK" 1 "Disabled" 2 "Initializing" 3 "Heating" 4 "WB_Active" 5 "Too Cold" 6 "Too Hot" 7 "Unplugged" 8 "Slow!" 9 "Uncal Yellow" 10 "Uncal Red" 11 "Replace" 12 "Disabled" 13 "Shorted" 14 "Open" 15 "Over Range" 16 "Under Range" 17 "Undefined" 18 "Error!" 19 "Low Error" 20 "High Error" 21 "Non Critical No LED" 27 "Critical Green LED" 32 "Stall!" 33 "Synchronized" 34 "Syncing" 35 "Error!" 36 "Error!" 37 "Uncalibrated" 38 "Open Loop" 39 "Closed Loop" 40 "Not Learn" 41 "Learning" 42 "Off" 43 "On" 44 "Not Rev Limiting" 45 "Rev Limit" 46 "No Cut Off" 47 "CutOff!" 48 "Off" 49 "Warning!" 50 "Caution!" 51 "No Timing modifier" 52 "Timing is being modified" 53 "Timing Value is being replaced" 54 "Acq Sat" 55 "No GPS" 56 "No Data" 22 "Non Critical Green LED" 23 "Non Critical Yellow LED" 24 "Non Critical Red LED" 25 "Non Critical Blue LED" 26 "Non Critical Grey LED" 28 "Critical Yellow LED" 29 "Critical Red LED" 30 "Critical Blue LED" 31 "Critical Grey LED";
VAL_ 2657374208 Status 0 "OK" 1 "Disabled" 2 "Initializing" 3 "Heating" 4 "WB_Active" 5 "Too Cold" 6 "Too Hot" 7 "Unplugged" 8 "Slow!" 9 "Uncal Yellow" 10 "Uncal Red" 11 "Replace" 12 "Disabled" 13 "Shorted" 14 "Open" 15 "Over Range" 16 "Under Range" 17 "Undefined" 18 "Error!" 19 "Low Error" 20 "High Error" 21 "Non Critical No LED" 27 "Critical Green LED" 32 "Stall!" 33 "Synchronized" 34 "Syncing" 35 "Error!" 36 "Error!" 37 "Uncalibrated" 38 "Open Loop" 39 "Closed Loop" 40 "Not Learn" 41 "Learning" 42 "Off" 43 "On" 44 "Not Rev Limiting" 45 "Rev Limit" 46 "No Cut Off" 47 "CutOff!" 48 "Off" 49 "Warning!" 50 "Caution!" 51 "No Timing modifier" 52 "Timing is being modified" 53 "Timing Value is being replaced" 54 "Acq Sat" 55 "No GPS" 56 "No Data" 22 "Non Critical Green LED" 23 "Non Critical Yellow LED" 24 "Non Critical Red LED" 25 "Non Critical Blue LED" 26 "Non Critical Grey LED" 28 "Critical Yellow LED" 29 "Critical Red LED" 30 "Critical Blue LED" 31 "Critical Grey LED";
VAL_ 2657390592 Status 0 "OK" 1 "Disabled" 2 "Initializing" 3 "Heating" 4 "WB_Active" 5 "Too Cold" 6 "Too Hot" 7 "Unplugged" 8 "Slow!" 9 "Uncal Yellow" 10 "Uncal Red" 11 "Replace" 12 "Disabled" 13 "Shorted" 14 "Open" 15 "Over Range" 16 "Under Range" 17 "Undefined" 18 "Error!" 19 "Low Error" 20 "High Error" 21 "Non Critical No LED" 27 "Critical Green LED" 32 "Stall!" 33 "Synchronized" 34 "Syncing" 35 "Error!" 36 "Error!" 37 "Uncalibrated" 38 "Open Loop" 39 "Closed Loop" 40 "Not Learn" 41 "Learning" 42 "Off" 43 "On" 44 "Not Rev Limiting" 45 "Rev Limit" 46 "No Cut Off" 47 "CutOff!" 48 "Off" 49 "Warning!" 50 "Caution!" 51 "No Timing modifier" 52 "Timing is being modified" 53 "Timing Value is being replaced" 54 "Acq Sat" 55 "No GPS" 56 "No Data" 22 "Non Critical Green LED" 23 "Non Critical Yellow LED" 24 "Non Critical Red LED" 25 "Non Critical Blue LED" 26 "Non Critical Grey LED" 28 "Critical Yellow LED" 29 "Critical Red LED" 30 "Critical Blue LED" 31 "Critical Grey LED";
VAL_ 2657406976 Status 0 "OK" 1 "Disabled" 2 "Initializing" 3 "Heating" 4 "WB_Active" 5 "Too Cold" 6 "Too Hot" 7 "Unplugged" 8 "Slow!" 9 "Uncal Yellow" 10 "Uncal Red" 11 "Replace" 12 "Disabled" 13 "Shorted" 14 "Open" 15 "Over Range" 16 "Under Range" 17 "Undefined" 18 "Error!" 19 "Low Error" 20 "High Error" 21 "Non Critical No LED" 27 "Critical Green LED" 32 "Stall!" 33 "Synchronized" 34 "Syncing" 35 "Error!" 36 "Error!" 37 "Uncalibrated" 38 "Open Loop" 39 "Closed Loop" 40 "Not Learn" 41 "Learning" 42 "Off" 43 "On" 44 "Not Rev Limiting" 45 "Rev Limit" 46 "No Cut Off" 47 "CutOff!" 48 "Off" 49 "Warning!" 50 "Caution!" 51 "No Timing modifier" 52 "Timing is being modified" 53 "Timing Value is being replaced" 54 "Acq Sat" 55 "No GPS" 56 "No Data" 22 "Non Critical Green LED" 23 "Non Critical Yellow LED" 24 "Non Critical Red LED" 25 "Non Critical Blue LED" 26 "Non Critical Grey LED" 28 "Critical Yellow LED" 29 "Critical Red LED" 30 "Critical Blue LED" 31 "Critical Grey LED";
VAL_ 2657423360 Status 0 "OK" 1 "Disabled" 2 "Initializing" 3 "Heating" 4 "WB_Active" 5 "Too Cold" 6 "Too Hot" 7 "Unplugged" 8 "Slow!" 9 "Uncal Yellow" 10 "Uncal Red" 11 "Replace" 12 "Disabled" 13 "Shorted" 14 "Open" 15 "Over Range" 16 "Under Range" 17 "Undefined" 18 "Error!" 19 "Low Error" 20 "High Error" 21 "Non Critical No LED" 27 "Critical Green LED" 32 "Stall!" 33 "Synchronized" 34 "Syncing" 35 "Error!" 36 "Error!" 37 "Uncalibrated" 38 "Open Loop" 39 "Closed Loop" 40 "Not Learn" 41 "Learning" 42 "Off" 43 "On" 44 "Not Rev Limiting" 45 "Rev Limit" 46 "No Cut Off" 47 "CutOff!" 48 "Off" 49 "Warning!" 50 "Caution!" 51 "No Timing modifier" 52 "Timing is being modified" 53 "Timing Value is being replaced" 54 "Acq Sat" 55 "No GPS" 56 "No Data" 22 "Non Critical Green LED" 23 "Non Critical Yellow LED" 24 "Non Critical Red LED" 25 "Non Critical Blue LED" 26 "Non Critical Grey LED" 28 "Critical Yellow LED" 29 "Critical Red LED" 30 "Critical Blue LED" 31 "Critical Grey LED";
VAL_ 2657439744 Status 0 "OK" 1 "Disabled" 2 "Initializing" 3 "Heating" 4 "WB_Active" 5 "Too Cold" 6 "Too Hot" 7 "Unplugged" 8 "Slow!" 9 "Uncal Yellow" 10 "Uncal Red" 11 "Replace" 12 "Disabled" 13 "Shorted" 14 "Open" 15 "Over Range" 16 "Under Range" 17 "Undefined" 18 "Error!" 19 "Low Error" 20 "High Error" 21 "Non Critical No LED" 27 "Critical Green LED" 32 "Stall!" 33 "Synchronized" 34 "Syncing" 35 "Error!" 36 "Error!" 37 "Uncalibrated" 38 "Open Loop" 39 "Closed Loop" 40 "Not Learn" 41 "Learning" 42 "Off" 43 "On" 44 "Not Rev Limiting" 45 "Rev Limit" 46 "No Cut Off" 47 "CutOff!" 48 "Off" 49 "Warning!" 50 "Caution!" 51 "No Timing modifier" 52 "Timing is being modified" 53 "Timing Value is being replaced" 54 "Acq Sat" 55 "No GPS" 56 "No Data" 22 "Non Critical Green LED" 23 "Non Critical Yellow LED" 24 "Non Critical Red LED" 25 "Non Critical Blue LED" 26 "Non Critical Grey LED" 28 "Critical Yellow LED" 29 "Critical Red LED" 30 "Critical Blue LED" 31 "Critical Grey LED";
VAL_ 2657456128 Status 0 "OK" 1 "Disabled" 2 "Initializing" 3 "Heating" 4 "WB_Active" 5 "Too Cold" 6 "Too Hot" 7 "Unplugged" 8 "Slow!" 9 "Uncal Yellow" 10 "Uncal Red" 11 "Replace" 12 "Disabled" 13 "Shorted" 14 "Open" 15 "Over Range" 16 "Under Range" 17 "Undefined" 18 "Error!" 19 "Low Error" 20 "High Error" 21 "Non Critical No LED" 27 "Critical Green LED" 32 "Stall!" 33 "Synchronized" 34 "Syncing" 35 "Error!" 36 "Error!" 37 "Uncalibrated" 38 "Open Loop" 39 "Closed Loop" 40 "Not Learn" 41 "Learning" 42 "Off" 43 "On" 44 "Not Rev Limiting" 45 "Rev Limit" 46 "No Cut Off" 47 "CutOff!" 48 "Off" 49 "Warning!" 50 "Caution!" 51 "No Timing modifier" 52 "Timing is being modified" 53 "Timing Value is being replaced" 54 "Acq Sat" 55 "No GPS" 56 "No Data" 22 "Non Critical Green LED" 23 "Non Critical Yellow LED" 24 "Non Critical Red LED" 25 "Non Critical Blue LED" 26 "Non Critical Grey LED" 28 "Critical Yellow LED" 29 "Critical Red LED" 30 "Critical Blue LED" 31 "Critical Grey LED";
VAL_ 2657472512 Status 0 "OK" 1 "Disabled" 2 "Initializing" 3 "Heating" 4 "WB_Active" 5 "Too Cold" 6 "Too Hot" 7 "Unplugged" 8 "Slow!" 9 "Uncal Yellow" 10 "Uncal Red" 11 "Replace" 12 "Disabled" 13 "Shorted" 14 "Open" 15 "Over Range" 16 "Under Range" 17 "Undefined" 18 "Error!" 19 "Low Error" 20 "High Error" 21 "Non Critical No LED" 27 "Critical Green LED" 32 "Stall!" 33 "Synchronized" 34 "Syncing" 35 "Error!" 36 "Error!" 37 "Uncalibrated" 38 "Open Loop" 39 "Closed Loop" 40 "Not Learn" 41 "Learning" 42 "Off" 43 "On" 44 "Not Rev Limiting" 45 "Rev Limit" 46 "No Cut Off" 47 "CutOff!" 48 "Off" 49 "Warning!" 50 "Caution!" 51 "No Timing modifier" 52 "Timing is being modified" 53 "Timing Value is being replaced" 54 "Acq Sat" 55 "No GPS" 56 "No Data" 22 "Non Critical Green LED" 23 "Non Critical Yellow LED" 24 "Non Critical Red LED" 25 "Non Critical Blue LED" 26 "Non Critical Grey LED" 28 "Critical Yellow LED" 29 "Critical Red LED" 30 "Critical Blue LED" 31 "Critical Grey LED";
VAL_ 2657488896 Status 0 "OK" 1 "Disabled" 2 "Initializing" 3 "Heating" 4 "WB_Active" 5 "Too Cold" 6 "Too Hot" 7 "Unplugged" 8 "Slow!" 9 "Uncal Yellow" 10 "Uncal Red" 11 "Replace" 12 "Disabled" 13 "Shorted" 14 "Open" 15 "Over Range" 16 "Under Range" 17 "Undefined" 18 "Error!" 19 "Low Error" 20 "High Error" 21 "Non Critical No LED" 27 "Critical Green LED" 32 "Stall!" 33 "Synchronized" 34 "Syncing" 35 "Error!" 36 "Error!" 37 "Uncalibrated" 38 "Open Loop" 39 "Closed Loop" 40 "Not Learn" 41 "Learning" 42 "Off" 43 "On" 44 "Not Rev Limiting" 45 "Rev Limit" 46 "No Cut Off" 47 "CutOff!" 48 "Off" 49 "Warning!" 50 "Caution!" 51 "No Timing modifier" 52 "Timing is being modified" 53 "Timing Value is being replaced" 54 "Acq Sat" 55 "No GPS" 56 "No Data" 22 "Non Critical Green LED" 23 "Non Critical Yellow LED" 24 "Non Critical Red LED" 25 "Non Critical Blue LED" 26 "Non Critical Grey LED" 28 "Critical Yellow LED" 29 "Critical Red LED" 30 "Critical Blue LED" 31 "Critical Grey LED";
VAL_ 2657505280 Status 0 "OK" 1 "Disabled" 2 "Initializing" 3 "Heating" 4 "WB_Active" 5 "Too Cold" 6 "Too Hot" 7 "Unplugged" 8 "Slow!" 9 "Uncal Yellow" 10 "Uncal Red" 11 "Replace" 12 "Disabled" 13 "Shorted" 14 "Open" 15 "Over Range" 16 "Under Range" 17 "Undefined" 18 "Error!" 19 "Low Error" 20 "High Error" 21 "Non Critical No LED" 27 "Critical Green LED" 32 "Stall!" 33 "Synchronized" 34 "Syncing" 35 "Error!" 36 "Error!" 37 "Uncalibrated" 38 "Open Loop" 39 "Closed Loop" 40 "Not Learn" 41 "Learning" 42 "Off" 43 "On" 44 "Not Rev Limiting" 45 "Rev Limit" 46 "No Cut Off" 47 "CutOff!" 48 "Off" 49 "Warning!" 50 "Caution!" 51 "No Timing modifier" 52 "Timing is being modified" 53 "Timing Value is being replaced" 54 "Acq Sat" 55 "No GPS" 56 "No Data" 22 "Non Critical Green LED" 23 "Non Critical Yellow LED" 24 "Non Critical Red LED" 25 "Non Critical Blue LED" 26 "Non Critical Grey LED" 28 "Critical Yellow LED" 29 "Critical Red LED" 30 "Critical Blue LED" 31 "Critical Grey LED";
VAL_ 2657521664 Status 0 "OK" 1 "Disabled" 2 "Initializing" 3 "Heating" 4 "WB_Active" 5 "Too Cold" 6 "Too Hot" 7 "Unplugged" 8 "Slow!" 9 "Uncal Yellow" 10 "Uncal Red" 11 "Replace" 12 "Disabled" 13 "Shorted" 14 "Open" 15 "Over Range" 16 "Under Range" 17 "Undefined" 18 "Error!" 19 "Low Error" 20 "High Error" 21 "Non Critical No LED" 27 "Critical Green LED" 32 "Stall!" 33 "Synchronized" 34 "Syncing" 35 "Error!" 36 "Error!" 37 "Uncalibrated" 38 "Open Loop" 39 "Closed Loop" 40 "Not Learn" 41 "Learning" 42 "Off" 43 "On" 44 "Not Rev Limiting" 45 "Rev Limit" 46 "No Cut Off" 47 "CutOff!" 48 "Off" 49 "Warning!" 50 "Caution!" 51 "No Timing modifier" 52 "Timing is being modified" 53 "Timing Value is being replaced" 54 "Acq Sat" 55 "No GPS" 56 "No Data" 22 "Non Critical Green LED" 23 "Non Critical Yellow LED" 24 "Non Critical Red LED" 25 "Non Critical Blue LED" 26 "Non Critical Grey LED" 28 "Critical Yellow LED" 29 "Critical Red LED" 30 "Critical Blue LED" 31 "Critical Grey LED";
VAL_ 2657538048 Status 0 "OK" 1 "Disabled" 2 "Initializing" 3 "Heating" 4 "WB_Active" 5 "Too Cold" 6 "Too Hot" 7 "Unplugged" 8 "Slow!" 9 "Uncal Yellow" 10 "Uncal Red" 11 "Replace" 12 "Disabled" 13 "Shorted" 14 "Open" 15 "Over Range" 16 "Under Range" 17 "Undefined" 18 "Error!" 19 "Low Error" 20 "High Error" 21 "Non Critical No LED" 27 "Critical Green LED" 32 "Stall!" 33 "Synchronized" 34 "Syncing" 35 "Error!" 36 "Error!" 37 "Uncalibrated" 38 "Open Loop" 39 "Closed Loop" 40 "Not Learn" 41 "Learning" 42 "Off" 43 "On" 44 "Not Rev Limiting" 45 "Rev Limit" 46 "No Cut Off" 47 "CutOff!" 48 "Off" 49 "Warning!" 50 "Caution!" 51 "No Timing modifier" 52 "Timing is being modified" 53 "Timing Value is being replaced" 54 "Acq Sat" 55 "No GPS" 56 "No Data" 22 "Non Critical Green LED" 23 "Non Critical Yellow LED" 24 "Non Critical Red LED" 25 "Non Critical Blue LED" 26 "Non Critical Grey LED" 28 "Critical Yellow LED" 29 "Critical Red LED" 30 "Critical Blue LED" 31 "Critical Grey LED";
VAL_ 2657554432 Status 0 "OK" 1 "Disabled" 2 "Initializing" 3 "Heating" 4 "WB_Active" 5 "Too Cold" 6 "Too Hot" 7 "Unplugged" 8 "Slow!" 9 "Uncal Yellow" 10 "Uncal Red" 11 "Replace" 12 "Disabled" 13 "Shorted" 14 "Open" 15 "Over Range" 16 "Under Range" 17 "Undefined" 18 "Error!" 19 "Low Error" 20 "High Error" 21 "Non Critical No LED" 27 "Critical Green LED" 32 "Stall!" 33 "Synchronized" 34 "Syncing" 35 "Error!" 36 "Error!" 37 "Uncalibrated" 38 "Open Loop" 39 "Closed Loop" 40 "Not Learn" 41 "Learning" 42 "Off" 43 "On" 44 "Not Rev Limiting" 45 "Rev Limit" 46 "No Cut Off" 47 "CutOff!" 48 "Off" 49 "Warning!" 50 "Caution!" 51 "No Timing modifier" 52 "Timing is being modified" 53 "Timing Value is being replaced" 54 "Acq Sat" 55 "No GPS" 56 "No Data" 22 "Non Critical Green LED" 23 "Non Critical Yellow LED" 24 "Non Critical Red LED" 25 "Non Critical Blue LED" 26 "Non Critical Grey LED" 28 "Critical Yellow LED" 29 "Critical Red LED" 30 "Critical Blue LED" 31 "Critical Grey LED";
VAL_ 2657570816 Status 0 "OK" 1 "Disabled" 2 "Initializing" 3 "Heating" 4 "WB_Active" 5 "Too Cold" 6 "Too Hot" 7 "Unplugged" 8 "Slow!" 9 "Uncal Yellow" 10 "Uncal Red" 11 "Replace" 12 "Disabled" 13 "Shorted" 14 "Open" 15 "Over Range" 16 "Under Range" 17 "Undefined" 18 "Error!" 19 "Low Error" 20 "High Error" 21 "Non Critical No LED" 27 "Critical Green LED" 32 "Stall!" 33 "Synchronized" 34 "Syncing" 35 "Error!" 36 "Error!" 37 "Uncalibrated" 38 "Open Loop" 39 "Closed Loop" 40 "Not Learn" 41 "Learning" 42 "Off" 43 "On" 44 "Not Rev Limiting" 45 "Rev Limit" 46 "No Cut Off" 47 "CutOff!" 48 "Off" 49 "Warning!" 50 "Caution!" 51 "No Timing modifier" 52 "Timing is being modified" 53 "Timing Value is being replaced" 54 "Acq Sat" 55 "No GPS" 56 "No Data" 22 "Non Critical Green LED" 23 "Non Critical Yellow LED" 24 "Non Critical Red LED" 25 "Non Critical Blue LED" 26 "Non Critical Grey LED" 28 "Critical Yellow LED" 29 "Critical Red LED" 30 "Critical Blue LED" 31 "Critical Grey LED";
VAL_ 2657587200 Status 0 "OK" 1 "Disabled" 2 "Initializing" 3 "Heating" 4 "WB_Active" 5 "Too Cold" 6 "Too Hot" 7 "Unplugged" 8 "Slow!" 9 "Uncal Yellow" 10 "Uncal Red" 11 "Replace" 12 "Disabled" 13 "Shorted" 14 "Open" 15 "Over Range" 16 "Under Range" 17 "Undefined" 18 "Error!" 19 "Low Error" 20 "High Error" 21 "Non Critical No LED" 27 "Critical Green LED" 32 "Stall!" 33 "Synchronized" 34 "Syncing" 35 "Error!" 36 "Error!" 37 "Uncalibrated" 38 "Open Loop" 39 "Closed Loop" 40 "Not Learn" 41 "Learning" 42 "Off" 43 "On" 44 "Not Rev Limiting" 45 "Rev Limit" 46 "No Cut Off" 47 "CutOff!" 48 "Off" 49 "Warning!" 50 "Caution!" 51 "No Timing modifier" 52 "Timing is being modified" 53 "Timing Value is being replaced" 54 "Acq Sat" 55 "No GPS" 56 "No Data" 22 "Non Critical Green LED" 23 "Non Critical Yellow LED" 24 "Non Critical Red LED" 25 "Non Critical Blue LED" 26 "Non Critical Grey LED" 28 "Critical Yellow LED" 29 "Critical Red LED" 30 "Critical Blue LED" 31 "Critical Grey LED";
VAL_ 2657603584 Status 0 "OK" 1 "Disabled" 2 "Initializing" 3 "Heating" 4 "WB_Active" 5 "Too Cold" 6 "Too Hot" 7 "Unplugged" 8 "Slow!" 9 "Uncal Yellow" 10 "Uncal Red" 11 "Replace" 12 "Disabled" 13 "Shorted" 14 "Open" 15 "Over Range" 16 "Under Range" 17 "Undefined" 18 "Error!" 19 "Low Error" 20 "High Error" 21 "Non Critical No LED" 27 "Critical Green LED" 32 "Stall!" 33 "Synchronized" 34 "Syncing" 35 "Error!" 36 "Error!" 37 "Uncalibrated" 38 "Open Loop" 39 "Closed Loop" 40 "Not Learn" 41 "Learning" 42 "Off" 43 "On" 44 "Not Rev Limiting" 45 "Rev Limit" 46 "No Cut Off" 47 "CutOff!" 48 "Off" 49 "Warning!" 50 "Caution!" 51 "No Timing modifier" 52 "Timing is being modified" 53 "Timing Value is being replaced" 54 "Acq Sat" 55 "No GPS" 56 "No Data" 22 "Non Critical Green LED" 23 "Non Critical Yellow LED" 24 "Non Critical Red LED" 25 "Non Critical Blue LED" 26 "Non Critical Grey LED" 28 "Critical Yellow LED" 29 "Critical Red LED" 30 "Critical Blue LED" 31 "Critical Grey LED";
VAL_ 2657619968 Status 0 "OK" 1 "Disabled" 2 "Initializing" 3 "Heating" 4 "WB_Active" 5 "Too Cold" 6 "Too Hot" 7 "Unplugged" 8 "Slow!" 9 "Uncal Yellow" 10 "Uncal Red" 11 "Replace" 12 "Disabled" 13 "Shorted" 14 "Open" 15 "Over Range" 16 "Under Range" 17 "Undefined" 18 "Error!" 19 "Low Error" 20 "High Error" 21 "Non Critical No LED" 27 "Critical Green LED" 32 "Stall!" 33 "Synchronized" 34 "Syncing" 35 "Error!" 36 "Error!" 37 "Uncalibrated" 38 "Open Loop" 39 "Closed Loop" 40 "Not Learn" 41 "Learning" 42 "Off" 43 "On" 44 "Not Rev Limiting" 45 "Rev Limit" 46 "No Cut Off" 47 "CutOff!" 48 "Off" 49 "Warning!" 50 "Caution!" 51 "No Timing modifier" 52 "Timing is being modified" 53 "Timing Value is being replaced" 54 "Acq Sat" 55 "No GPS" 56 "No Data" 22 "Non Critical Green LED" 23 "Non Critical Yellow LED" 24 "Non Critical Red LED" 25 "Non Critical Blue LED" 26 "Non Critical Grey LED" 28 "Critical Yellow LED" 29 "Critical Red LED" 30 "Critical Blue LED" 31 "Critical Grey LED";
VAL_ 2657636352 Status 0 "OK" 1 "Disabled" 2 "Initializing" 3 "Heating" 4 "WB_Active" 5 "Too Cold" 6 "Too Hot" 7 "Unplugged" 8 "Slow!" 9 "Uncal Yellow" 10 "Uncal Red" 11 "Replace" 12 "Disabled" 13 "Shorted" 14 "Open" 15 "Over Range" 16 "Under Range" 17 "Undefined" 18 "Error!" 19 "Low Error" 20 "High Error" 21 "Non Critical No LED" 27 "Critical Green LED" 32 "Stall!" 33 "Synchronized" 34 "Syncing" 35 "Error!" 36 "Error!" 37 "Uncalibrated" 38 "Open Loop" 39 "Closed Loop" 40 "Not Learn" 41 "Learning" 42 "Off" 43 "On" 44 "Not Rev Limiting" 45 "Rev Limit" 46 "No Cut Off" 47 "CutOff!" 48 "Off" 49 "Warning!" 50 "Caution!" 51 "No Timing modifier" 52 "Timing is being modified" 53 "Timing Value is being replaced" 54 "Acq Sat" 55 "No GPS" 56 "No Data" 22 "Non Critical Green LED" 23 "Non Critical Yellow LED" 24 "Non Critical Red LED" 25 "Non Critical Blue LED" 26 "Non Critical Grey LED" 28 "Critical Yellow LED" 29 "Critical Red LED" 30 "Critical Blue LED" 31 "Critical Grey LED";
VAL_ 2657652736 Status 0 "OK" 1 "Disabled" 2 "Initializing" 3 "Heating" 4 "WB_Active" 5 "Too Cold" 6 "Too Hot" 7 "Unplugged" 8 "Slow!" 9 "Uncal Yellow" 10 "Uncal Red" 11 "Replace" 12 "Disabled" 13 "Shorted" 14 "Open" 15 "Over Range" 16 "Under Range" 17 "Undefined" 18 "Error!" 19 "Low Error" 20 "High Error" 21 "Non Critical No LED" 27 "Critical Green LED" 32 "Stall!" 33 "Synchronized" 34 "Syncing" 35 "Error!" 36 "Error!" 37 "Uncalibrated" 38 "Open Loop" 39 "Closed Loop" 40 "Not Learn" 41 "Learning" 42 "Off" 43 "On" 44 "Not Rev Limiting" 45 "Rev Limit" 46 "No Cut Off" 47 "CutOff!" 48 "Off" 49 "Warning!" 50 "Caution!" 51 "No Timing modifier" 52 "Timing is being modified" 53 "Timing Value is being replaced" 54 "Acq Sat" 55 "No GPS" 56 "No Data" 22 "Non Critical Green LED" 23 "Non Critical Yellow LED" 24 "Non Critical Red LED" 25 "Non Critical Blue LED" 26 "Non Critical Grey LED" 28 "Critical Yellow LED" 29 "Critical Red LED" 30 "Critical Blue LED" 31 "Critical Grey LED";
VAL_ 2657669120 Status 0 "OK" 1 "Disabled" 2 "Initializing" 3 "Heating" 4 "WB_Active" 5 "Too Cold" 6 "Too Hot" 7 "Unplugged" 8 "Slow!" 9 "Uncal Yellow" 10 "Uncal Red" 11 "Replace" 12 "Disabled" 13 "Shorted" 14 "Open" 15 "Over Range" 16 "Under Range" 17 "Undefined" 18 "Error!" 19 "Low Error" 20 "High Error" 21 "Non Critical No LED" 27 "Critical Green LED" 32 "Stall!" 33 "Synchronized" 34 "Syncing" 35 "Error!" 36 "Error!" 37 "Uncalibrated" 38 "Open Loop" 39 "Closed Loop" 40 "Not Learn" 41 "Learning" 42 "Off" 43 "On" 44 "Not Rev Limiting" 45 "Rev Limit" 46 "No Cut Off" 47 "CutOff!" 48 "Off" 49 "Warning!" 50 "Caution!" 51 "No Timing modifier" 52 "Timing is being modified" 53 "Timing Value is being replaced" 54 "Acq Sat" 55 "No GPS" 56 "No Data" 22 "Non Critical Green LED" 23 "Non Critical Yellow LED" 24 "Non Critical Red LED" 25 "Non Critical Blue LED" 26 "Non Critical Grey LED" 28 "Critical Yellow LED" 29 "Critical Red LED" 30 "Critical Blue LED" 31 "Critical Grey LED";
VAL_ 2657685504 Status 0 "OK" 1 "Disabled" 2 "Initializing" 3 "Heating" 4 "WB_Active" 5 "Too Cold" 6 "Too Hot" 7 "Unplugged" 8 "Slow!" 9 "Uncal Yellow" 10 "Uncal Red" 11 "Replace" 12 "Disabled" 13 "Shorted" 14 "Open" 15 "Over Range" 16 "Under Range" 17 "Undefined" 18 "Error!" 19 "Low Error" 20 "High Error" 21 "Non Critical No LED" 27 "Critical Green LED" 32 "Stall!" 33 "Synchronized" 34 "Syncing" 35 "Error!" 36 "Error!" 37 "Uncalibrated" 38 "Open Loop" 39 "Closed Loop" 40 "Not Learn" 41 "Learning" 42 "Off" 43 "On" 44 "Not Rev Limiting" 45 "Rev Limit" 46 "No Cut Off" 47 "CutOff!" 48 "Off" 49 "Warning!" 50 "Caution!" 51 "No Timing modifier" 52 "Timing is being modified" 53 "Timing Value is being replaced" 54 "Acq Sat" 55 "No GPS" 56 "No Data" 22 "Non Critical Green LED" 23 "Non Critical Yellow LED" 24 "Non Critical Red LED" 25 "Non Critical Blue LED" 26 "Non Critical Grey LED" 28 "Critical Yellow LED" 29 "Critical Red LED" 30 "Critical Blue LED" 31 "Critical Grey LED";
VAL_ 2657701888 Status 0 "OK" 1 "Disabled" 2 "Initializing" 3 "Heating" 4 "WB_Active" 5 "Too Cold" 6 "Too Hot" 7 "Unplugged" 8 "Slow!" 9 "Uncal Yellow" 10 "Uncal Red" 11 "Replace" 12 "Disabled" 13 "Shorted" 14 "Open" 15 "Over Range" 16 "Under Range" 17 "Undefined" 18 "Error!" 19 "Low Error" 20 "High Error" 21 "Non Critical No LED" 27 "Critical Green LED" 32 "Stall!" 33 "Synchronized" 34 "Syncing" 35 "Error!" 36 "Error!" 37 "Uncalibrated" 38 "Open Loop" 39 "Closed Loop" 40 "Not Learn" 41 "Learning" 42 "Off" 43 "On" 44 "Not Rev Limiting" 45 "Rev Limit" 46 "No Cut Off" 47 "CutOff!" 48 "Off" 49 "Warning!" 50 "Caution!" 51 "No Timing modifier" 52 "Timing is being modified" 53 "Timing Value is being replaced" 54 "Acq Sat" 55 "No GPS" 56 "No Data" 22 "Non Critical Green LED" 23 "Non Critical Yellow LED" 24 "Non Critical Red LED" 25 "Non Critical Blue LED" 26 "Non Critical Grey LED" 28 "Critical Yellow LED" 29 "Critical Red LED" 30 "Critical Blue LED" 31 "Critical Grey LED";
VAL_ 2657718272 Status 0 "OK" 1 "Disabled" 2 "Initializing" 3 "Heating" 4 "WB_Active" 5 "Too Cold" 6 "Too Hot" 7 "Unplugged" 8 "Slow!" 9 "Uncal Yellow" 10 "Uncal Red" 11 "Replace" 12 "Disabled" 13 "Shorted" 14 "Open" 15 "Over Range" 16 "Under Range" 17 "Undefined" 18 "Error!" 19 "Low Error" 20 "High Error" 21 "Non Critical No LED" 27 "Critical Green LED" 32 "Stall!" 33 "Synchronized" 34 "Syncing" 35 "Error!" 36 "Error!" 37 "Uncalibrated" 38 "Open Loop" 39 "Closed Loop" 40 "Not Learn" 41 "Learning" 42 "Off" 43 "On" 44 "Not Rev Limiting" 45 "Rev Limit" 46 "No Cut Off" 47 "CutOff!" 48 "Off" 49 "Warning!" 50 "Caution!" 51 "No Timing modifier" 52 "Timing is being modified" 53 "Timing Value is being replaced" 54 "Acq Sat" 55 "No GPS" 56 "No Data" 22 "Non Critical Green LED" 23 "Non Critical Yellow LED" 24 "Non Critical Red LED" 25 "Non Critical Blue LED" 26 "Non Critical Grey LED" 28 "Critical Yellow LED" 29 "Critical Red LED" 30 "Critical Blue LED" 31 "Critical Grey LED";
VAL_ 2657734656 Status 0 "OK" 1 "Disabled" 2 "Initializing" 3 "Heating" 4 "WB_Active" 5 "Too Cold" 6 "Too Hot" 7 "Unplugged" 8 "Slow!" 9 "Uncal Yellow" 10 "Uncal Red" 11 "Replace" 12 "Disabled" 13 "Shorted" 14 "Open" 15 "Over Range" 16 "Under Range" 17 "Undefined" 18 "Error!" 19 "Low Error" 20 "High Error" 21 "Non Critical No LED" 27 "Critical Green LED" 32 "Stall!" 33 "Synchronized" 34 "Syncing" 35 "Error!" 36 "Error!" 37 "Uncalibrated" 38 "Open Loop" 39 "Closed Loop" 40 "Not Learn" 41 "Learning" 42 "Off" 43 "On" 44 "Not Rev Limiting" 45 "Rev Limit" 46 "No Cut Off" 47 "CutOff!" 48 "Off" 49 "Warning!" 50 "Caution!" 51 "No Timing modifier" 52 "Timing is being modified" 53 "Timing Value is being replaced" 54 "Acq Sat" 55 "No GPS" 56 "No Data" 22 "Non Critical Green LED" 23 "Non Critical Yellow LED" 24 "Non Critical Red LED" 25 "Non Critical Blue LED" 26 "Non Critical Grey LED" 28 "Critical Yellow LED" 29 "Critical Red LED" 30 "Critical Blue LED" 31 "Critical Grey LED";
VAL_ 2657751040 Status 0 "OK" 1 "Disabled" 2 "Initializing" 3 "Heating" 4 "WB_Active" 5 "Too Cold" 6 "Too Hot" 7 "Unplugged" 8 "Slow!" 9 "Uncal Yellow" 10 "Uncal Red" 11 "Replace" 12 "Disabled" 13 "Shorted" 14 "Open" 15 "Over Range" 16 "Under Range" 17 "Undefined" 18 "Error!" 19 "Low Error" 20 "High Error" 21 "Non Critical No LED" 27 "Critical Green LED" 32 "Stall!" 33 "Synchronized" 34 "Syncing" 35 "Error!" 36 "Error!" 37 "Uncalibrated" 38 "Open Loop" 39 "Closed Loop" 40 "Not Learn" 41 "Learning" 42 "Off" 43 "On" 44 "Not Rev Limiting" 45 "Rev Limit" 46 "No Cut Off" 47 "CutOff!" 48 "Off" 49 "Warning!" 50 "Caution!" 51 "No Timing modifier" 52 "Timing is being modified" 53 "Timing Value is being replaced" 54 "Acq Sat" 55 "No GPS" 56 "No Data" 22 "Non Critical Green LED" 23 "Non Critical Yellow LED" 24 "Non Critical Red LED" 25 "Non Critical Blue LED" 26 "Non Critical Grey LED" 28 "Critical Yellow LED" 29 "Critical Red LED" 30 "Critical Blue LED" 31 "Critical Grey LED";
VAL_ 2657767424 Status 0 "OK" 1 "Disabled" 2 "Initializing" 3 "Heating" 4 "WB_Active" 5 "Too Cold" 6 "Too Hot" 7 "Unplugged" 8 "Slow!" 9 "Uncal Yellow" 10 "Uncal Red" 11 "Replace" 12 "Disabled" 13 "Shorted" 14 "Open" 15 "Over Range" 16 "Under Range" 17 "Undefined" 18 "Error!" 19 "Low Error" 20 "High Error" 21 "Non Critical No LED" 27 "Critical Green LED" 32 "Stall!" 33 "Synchronized" 34 "Syncing" 35 "Error!" 36 "Error!" 37 "Uncalibrated" 38 "Open Loop" 39 "Closed Loop" 40 "Not Learn" 41 "Learning" 42 "Off" 43 "On" 44 "Not Rev Limiting" 45 "Rev Limit" 46 "No Cut Off" 47 "CutOff!" 48 "Off" 49 "Warning!" 50 "Caution!" 51 "No Timing modifier" 52 "Timing is being modified" 53 "Timing Value is being replaced" 54 "Acq Sat" 55 "No GPS" 56 "No Data" 22 "Non Critical Green LED" 23 "Non Critical Yellow LED" 24 "Non Critical Red LED" 25 "Non Critical Blue LED" 26 "Non Critical Grey LED" 28 "Critical Yellow LED" 29 "Critical Red LED" 30 "Critical Blue LED" 31 "Critical Grey LED";
VAL_ 2657783808 Status 0 "OK" 1 "Disabled" 2 "Initializing" 3 "Heating" 4 "WB_Active" 5 "Too Cold" 6 "Too Hot" 7 "Unplugged" 8 "Slow!" 9 "Uncal Yellow" 10 "Uncal Red" 11 "Replace" 12 "Disabled" 13 "Shorted" 14 "Open" 15 "Over Range" 16 "Under Range" 17 "Undefined" 18 "Error!" 19 "Low Error" 20 "High Error" 21 "Non Critical No LED" 27 "Critical Green LED" 32 "Stall!" 33 "Synchronized" 34 "Syncing" 35 "Error!" 36 "Error!" 37 "Uncalibrated" 38 "Open Loop" 39 "Closed Loop" 40 "Not Learn" 41 "Learning" 42 "Off" 43 "On" 44 "Not Rev Limiting" 45 "Rev Limit" 46 "No Cut Off" 47 "CutOff!" 48 "Off" 49 "Warning!" 50 "Caution!" 51 "No Timing modifier" 52 "Timing is being modified" 53 "Timing Value is being replaced" 54 "Acq Sat" 55 "No GPS" 56 "No Data" 22 "Non Critical Green LED" 23 "Non Critical Yellow LED" 24 "Non Critical Red LED" 25 "Non Critical Blue LED" 26 "Non Critical Grey LED" 28 "Critical Yellow LED" 29 "Critical Red LED" 30 "Critical Blue LED" 31 "Critical Grey LED";
VAL_ 2657800192 Status 0 "OK" 1 "Disabled" 2 "Initializing" 3 "Heating" 4 "WB_Active" 5 "Too Cold" 6 "Too Hot" 7 "Unplugged" 8 "Slow!" 9 "Uncal Yellow" 10 "Uncal Red" 11 "Replace" 12 "Disabled" 13 "Shorted" 14 "Open" 15 "Over Range" 16 "Under Range" 17 "Undefined" 18 "Error!" 19 "Low Error" 20 "High Error" 21 "Non Critical No LED" 27 "Critical Green LED" 32 "Stall!" 33 "Synchronized" 34 "Syncing" 35 "Error!" 36 "Error!" 37 "Uncalibrated" 38 "Open Loop" 39 "Closed Loop" 40 "Not Learn" 41 "Learning" 42 "Off" 43 "On" 44 "Not Rev Limiting" 45 "Rev Limit" 46 "No Cut Off" 47 "CutOff!" 48 "Off" 49 "Warning!" 50 "Caution!" 51 "No Timing modifier" 52 "Timing is being modified" 53 "Timing Value is being replaced" 54 "Acq Sat" 55 "No GPS" 56 "No Data" 22 "Non Critical Green LED" 23 "Non Critical Yellow LED" 24 "Non Critical Red LED" 25 "Non Critical Blue LED" 26 "Non Critical Grey LED" 28 "Critical Yellow LED" 29 "Critical Red LED" 30 "Critical Blue LED" 31 "Critical Grey LED";
VAL_ 2657816576 Status 0 "OK" 1 "Disabled" 2 "Initializing" 3 "Heating" 4 "WB_Active" 5 "Too Cold" 6 "Too Hot" 7 "Unplugged" 8 "Slow!" 9 "Uncal Yellow" 10 "Uncal Red" 11 "Replace" 12 "Disabled" 13 "Shorted" 14 "Open" 15 "Over Range" 16 "Under Range" 17 "Undefined" 18 "Error!" 19 "Low Error" 20 "High Error" 21 "Non Critical No LED" 27 "Critical Green LED" 32 "Stall!" 33 "Synchronized" 34 "Syncing" 35 "Error!" 36 "Error!" 37 "Uncalibrated" 38 "Open Loop" 39 "Closed Loop" 40 "Not Learn" 41 "Learning" 42 "Off" 43 "On" 44 "Not Rev Limiting" 45 "Rev Limit" 46 "No Cut Off" 47 "CutOff!" 48 "Off" 49 "Warning!" 50 "Caution!" 51 "No Timing modifier" 52 "Timing is being modified" 53 "Timing Value is being replaced" 54 "Acq Sat" 55 "No GPS" 56 "No Data" 22 "Non Critical Green LED" 23 "Non Critical Yellow LED" 24 "Non Critical Red LED" 25 "Non Critical Blue LED" 26 "Non Critical Grey LED" 28 "Critical Yellow LED" 29 "Critical Red LED" 30 "Critical Blue LED" 31 "Critical Grey LED";
VAL_ 2657832960 Status 0 "OK" 1 "Disabled" 2 "Initializing" 3 "Heating" 4 "WB_Active" 5 "Too Cold" 6 "Too Hot" 7 "Unplugged" 8 "Slow!" 9 "Uncal Yellow" 10 "Uncal Red" 11 "Replace" 12 "Disabled" 13 "Shorted" 14 "Open" 15 "Over Range" 16 "Under Range" 17 "Undefined" 18 "Error!" 19 "Low Error" 20 "High Error" 21 "Non Critical No LED" 27 "Critical Green LED" 32 "Stall!" 33 "Synchronized" 34 "Syncing" 35 "Error!" 36 "Error!" 37 "Uncalibrated" 38 "Open Loop" 39 "Closed Loop" 40 "Not Learn" 41 "Learning" 42 "Off" 43 "On" 44 "Not Rev Limiting" 45 "Rev Limit" 46 "No Cut Off" 47 "CutOff!" 48 "Off" 49 "Warning!" 50 "Caution!" 51 "No Timing modifier" 52 "Timing is being modified" 53 "Timing Value is being replaced" 54 "Acq Sat" 55 "No GPS" 56 "No Data" 22 "Non Critical Green LED" 23 "Non Critical Yellow LED" 24 "Non Critical Red LED" 25 "Non Critical Blue LED" 26 "Non Critical Grey LED" 28 "Critical Yellow LED" 29 "Critical Red LED" 30 "Critical Blue LED" 31 "Critical Grey LED";
VAL_ 2657849344 Status 0 "OK" 1 "Disabled" 2 "Initializing" 3 "Heating" 4 "WB_Active" 5 "Too Cold" 6 "Too Hot" 7 "Unplugged" 8 "Slow!" 9 "Uncal Yellow" 10 "Uncal Red" 11 "Replace" 12 "Disabled" 13 "Shorted" 14 "Open" 15 "Over Range" 16 "Under Range" 17 "Undefined" 18 "Error!" 19 "Low Error" 20 "High Error" 21 "Non Critical No LED" 27 "Critical Green LED" 32 "Stall!" 33 "Synchronized" 34 "Syncing" 35 "Error!" 36 "Error!" 37 "Uncalibrated" 38 "Open Loop" 39 "Closed Loop" 40 "Not Learn" 41 "Learning" 42 "Off" 43 "On" 44 "Not Rev Limiting" 45 "Rev Limit" 46 "No Cut Off" 47 "CutOff!" 48 "Off" 49 "Warning!" 50 "Caution!" 51 "No Timing modifier" 52 "Timing is being modified" 53 "Timing Value is being replaced" 54 "Acq Sat" 55 "No GPS" 56 "No Data" 22 "Non Critical Green LED" 23 "Non Critical Yellow LED" 24 "Non Critical Red LED" 25 "Non Critical Blue LED" 26 "Non Critical Grey LED" 28 "Critical Yellow LED" 29 "Critical Red LED" 30 "Critical Blue LED" 31 "Critical Grey LED";
VAL_ 2657865728 Status 0 "OK" 1 "Disabled" 2 "Initializing" 3 "Heating" 4 "WB_Active" 5 "Too Cold" 6 "Too Hot" 7 "Unplugged" 8 "Slow!" 9 "Uncal Yellow" 10 "Uncal Red" 11 "Replace" 12 "Disabled" 13 "Shorted" 14 "Open" 15 "Over Range" 16 "Under Range" 17 "Undefined" 18 "Error!" 19 "Low Error" 20 "High Error" 21 "Non Critical No LED" 27 "Critical Green LED" 32 "Stall!" 33 "Synchronized" 34 "Syncing" 35 "Error!" 36 "Error!" 37 "Uncalibrated" 38 "Open Loop" 39 "Closed Loop" 40 "Not Learn" 41 "Learning" 42 "Off" 43 "On" 44 "Not Rev Limiting" 45 "Rev Limit" 46 "No Cut Off" 47 "CutOff!" 48 "Off" 49 "Warning!" 50 "Caution!" 51 "No Timing modifier" 52 "Timing is being modified" 53 "Timing Value is being replaced" 54 "Acq Sat" 55 "No GPS" 56 "No Data" 22 "Non Critical Green LED" 23 "Non Critical Yellow LED" 24 "Non Critical Red LED" 25 "Non Critical Blue LED" 26 "Non Critical Grey LED" 28 "Critical Yellow LED" 29 "Critical Red LED" 30 "Critical Blue LED" 31 "Critical Grey LED";
VAL_ 2657882112 Status 0 "OK" 1 "Disabled" 2 "Initializing" 3 "Heating" 4 "WB_Active" 5 "Too Cold" 6 "Too Hot" 7 "Unplugged" 8 "Slow!" 9 "Uncal Yellow" 10 "Uncal Red" 11 "Replace" 12 "Disabled" 13 "Shorted" 14 "Open" 15 "Over Range" 16 "Under Range" 17 "Undefined" 18 "Error!" 19 "Low Error" 20 "High Error" 21 "Non Critical No LED" 27 "Critical Green LED" 32 "Stall!" 33 "Synchronized" 34 "Syncing" 35 "Error!" 36 "Error!" 37 "Uncalibrated" 38 "Open Loop" 39 "Closed Loop" 40 "Not Learn" 41 "Learning" 42 "Off" 43 "On" 44 "Not Rev Limiting" 45 "Rev Limit" 46 "No Cut Off" 47 "CutOff!" 48 "Off" 49 "Warning!" 50 "Caution!" 51 "No Timing modifier" 52 "Timing is being modified" 53 "Timing Value is being replaced" 54 "Acq Sat" 55 "No GPS" 56 "No Data" 22 "Non Critical Green LED" 23 "Non Critical Yellow LED" 24 "Non Critical Red LED" 25 "Non Critical Blue LED" 26 "Non Critical Grey LED" 28 "Critical Yellow LED" 29 "Critical Red LED" 30 "Critical Blue LED" 31 "Critical Grey LED";
VAL_ 2657898496 Status 0 "OK" 1 "Disabled" 2 "Initializing" 3 "Heating" 4 "WB_Active" 5 "Too Cold" 6 "Too Hot" 7 "Unplugged" 8 "Slow!" 9 "Uncal Yellow" 10 "Uncal Red" 11 "Replace" 12 "Disabled" 13 "Shorted" 14 "Open" 15 "Over Range" 16 "Under Range" 17 "Undefined" 18 "Error!" 19 "Low Error" 20 "High Error" 21 "Non Critical No LED" 27 "Critical Green LED" 32 "Stall!" 33 "Synchronized" 34 "Syncing" 35 "Error!" 36 "Error!" 37 "Uncalibrated" 38 "Open Loop" 39 "Closed Loop" 40 "Not Learn" 41 "Learning" 42 "Off" 43 "On" 44 "Not Rev Limiting" 45 "Rev Limit" 46 "No Cut Off" 47 "CutOff!" 48 "Off" 49 "Warning!" 50 "Caution!" 51 "No Timing modifier" 52 "Timing is being modified" 53 "Timing Value is being replaced" 54 "Acq Sat" 55 "No GPS" 56 "No Data" 22 "Non Critical Green LED" 23 "Non Critical Yellow LED" 24 "Non Critical Red LED" 25 "Non Critical Blue LED" 26 "Non Critical Grey LED" 28 "Critical Yellow LED" 29 "Critical Red LED" 30 "Critical Blue LED" 31 "Critical Grey LED";
VAL_ 2657914880 Status 0 "OK" 1 "Disabled" 2 "Initializing" 3 "Heating" 4 "WB_Active" 5 "Too Cold" 6 "Too Hot" 7 "Unplugged" 8 "Slow!" 9 "Uncal Yellow" 10 "Uncal Red" 11 "Replace" 12 "Disabled" 13 "Shorted" 14 "Open" 15 "Over Range" 16 "Under Range" 17 "Undefined" 18 "Error!" 19 "Low Error" 20 "High Error" 21 "Non Critical No LED" 27 "Critical Green LED" 32 "Stall!" 33 "Synchronized" 34 "Syncing" 35 "Error!" 36 "Error!" 37 "Uncalibrated" 38 "Open Loop" 39 "Closed Loop" 40 "Not Learn" 41 "Learning" 42 "Off" 43 "On" 44 "Not Rev Limiting" 45 "Rev Limit" 46 "No Cut Off" 47 "CutOff!" 48 "Off" 49 "Warning!" 50 "Caution!" 51 "No Timing modifier" 52 "Timing is being modified" 53 "Timing Value is being replaced" 54 "Acq Sat" 55 "No GPS" 56 "No Data" 22 "Non Critical Green LED" 23 "Non Critical Yellow LED" 24 "Non Critical Red LED" 25 "Non Critical Blue LED" 26 "Non Critical Grey LED" 28 "Critical Yellow LED" 29 "Critical Red LED" 30 "Critical Blue LED" 31 "Critical Grey LED";
VAL_ 2657931264 Status 0 "OK" 1 "Disabled" 2 "Initializing" 3 "Heating" 4 "WB_Active" 5 "Too Cold" 6 "Too Hot" 7 "Unplugged" 8 "Slow!" 9 "Uncal Yellow" 10 "Uncal Red" 11 "Replace" 12 "Disabled" 13 "Shorted" 14 "Open" 15 "Over Range" 16 "Under Range" 17 "Undefined" 18 "Error!" 19 "Low Error" 20 "High Error" 21 "Non Critical No LED" 27 "Critical Green LED" 32 "Stall!" 33 "Synchronized" 34 "Syncing" 35 "Error!" 36 "Error!" 37 "Uncalibrated" 38 "Open Loop" 39 "Closed Loop" 40 "Not Learn" 41 "Learning" 42 "Off" 43 "On" 44 "Not Rev Limiting" 45 "Rev Limit" 46 "No Cut Off" 47 "CutOff!" 48 "Off" 49 "Warning!" 50 "Caution!" 51 "No Timing modifier" 52 "Timing is being modified" 53 "Timing Value is being replaced" 54 "Acq Sat" 55 "No GPS" 56 "No Data" 22 "Non Critical Green LED" 23 "Non Critical Yellow LED" 24 "Non Critical Red LED" 25 "Non Critical Blue LED" 26 "Non Critical Grey LED" 28 "Critical Yellow LED" 29 "Critical Red LED" 30 "Critical Blue LED" 31 "Critical Grey LED";
VAL_ 2657947648 Status 0 "OK" 1 "Disabled" 2 "Initializing" 3 "Heating" 4 "WB_Active" 5 "Too Cold" 6 "Too Hot" 7 "Unplugged" 8 "Slow!" 9 "Uncal Yellow" 10 "Uncal Red" 11 "Replace" 12 "Disabled" 13 "Shorted" 14 "Open" 15 "Over Range" 16 "Under Range" 17 "Undefined" 18 "Error!" 19 "Low Error" 20 "High Error" 21 "Non Critical No LED" 27 "Critical Green LED" 32 "Stall!" 33 "Synchronized" 34 "Syncing" 35 "Error!" 36 "Error!" 37 "Uncalibrated" 38 "Open Loop" 39 "Closed Loop" 40 "Not Learn" 41 "Learning" 42 "Off" 43 "On" 44 "Not Rev Limiting" 45 "Rev Limit" 46 "No Cut Off" 47 "CutOff!" 48 "Off" 49 "Warning!" 50 "Caution!" 51 "No Timing modifier" 52 "Timing is being modified" 53 "Timing Value is being replaced" 54 "Acq Sat" 55 "No GPS" 56 "No Data" 22 "Non Critical Green LED" 23 "Non Critical Yellow LED" 24 "Non Critical Red LED" 25 "Non Critical Blue LED" 26 "Non Critical Grey LED" 28 "Critical Yellow LED" 29 "Critical Red LED" 30 "Critical Blue LED" 31 "Critical Grey LED";
VAL_ 2657964032 Status 0 "OK" 1 "Disabled" 2 "Initializing" 3 "Heating" 4 "WB_Active" 5 "Too Cold" 6 "Too Hot" 7 "Unplugged" 8 "Slow!" 9 "Uncal Yellow" 10 "Uncal Red" 11 "Replace" 12 "Disabled" 13 "Shorted" 14 "Open" 15 "Over Range" 16 "Under Range" 17 "Undefined" 18 "Error!" 19 "Low Error" 20 "High Error" 21 "Non Critical No LED" 27 "Critical Green LED" 32 "Stall!" 33 "Synchronized" 34 "Syncing" 35 "Error!" 36 "Error!" 37 "Uncalibrated" 38 "Open Loop" 39 "Closed Loop" 40 "Not Learn" 41 "Learning" 42 "Off" 43 "On" 44 "Not Rev Limiting" 45 "Rev Limit" 46 "No Cut Off" 47 "CutOff!" 48 "Off" 49 "Warning!" 50 "Caution!" 51 "No Timing modifier" 52 "Timing is being modified" 53 "Timing Value is being replaced" 54 "Acq Sat" 55 "No GPS" 56 "No Data" 22 "Non Critical Green LED" 23 "Non Critical Yellow LED" 24 "Non Critical Red LED" 25 "Non Critical Blue LED" 26 "Non Critical Grey LED" 28 "Critical Yellow LED" 29 "Critical Red LED" 30 "Critical Blue LED" 31 "Critical Grey LED";
VAL_ 2657980416 Status 0 "OK" 1 "Disabled" 2 "Initializing" 3 "Heating" 4 "WB_Active" 5 "Too Cold" 6 "Too Hot" 7 "Unplugged" 8 "Slow!" 9 "Uncal Yellow" 10 "Uncal Red" 11 "Replace" 12 "Disabled" 13 "Shorted" 14 "Open" 15 "Over Range" 16 "Under Range" 17 "Undefined" 18 "Error!" 19 "Low Error" 20 "High Error" 21 "Non Critical No LED" 27 "Critical Green LED" 32 "Stall!" 33 "Synchronized" 34 "Syncing" 35 "Error!" 36 "Error!" 37 "Uncalibrated" 38 "Open Loop" 39 "Closed Loop" 40 "Not Learn" 41 "Learning" 42 "Off" 43 "On" 44 "Not Rev Limiting" 45 "Rev Limit" 46 "No Cut Off" 47 "CutOff!" 48 "Off" 49 "Warning!" 50 "Caution!" 51 "No Timing modifier" 52 "Timing is being modified" 53 "Timing Value is being replaced" 54 "Acq Sat" 55 "No GPS" 56 "No Data" 22 "Non Critical Green LED" 23 "Non Critical Yellow LED" 24 "Non Critical Red LED" 25 "Non Critical Blue LED" 26 "Non Critical Grey LED" 28 "Critical Yellow LED" 29 "Critical Red LED" 30 "Critical Blue LED" 31 "Critical Grey LED";
VAL_ 2657996800 Status 0 "OK" 1 "Disabled" 2 "Initializing" 3 "Heating" 4 "WB_Active" 5 "Too Cold" 6 "Too Hot" 7 "Unplugged" 8 "Slow!" 9 "Uncal Yellow" 10 "Uncal Red" 11 "Replace" 12 "Disabled" 13 "Shorted" 14 "Open" 15 "Over Range" 16 "Under Range" 17 "Undefined" 18 "Error!" 19 "Low Error" 20 "High Error" 21 "Non Critical No LED" 27 "Critical Green LED" 32 "Stall!" 33 "Synchronized" 34 "Syncing" 35 "Error!" 36 "Error!" 37 "Uncalibrated" 38 "Open Loop" 39 "Closed Loop" 40 "Not Learn" 41 "Learning" 42 "Off" 43 "On" 44 "Not Rev Limiting" 45 "Rev Limit" 46 "No Cut Off" 47 "CutOff!" 48 "Off" 49 "Warning!" 50 "Caution!" 51 "No Timing modifier" 52 "Timing is being modified" 53 "Timing Value is being replaced" 54 "Acq Sat" 55 "No GPS" 56 "No Data" 22 "Non Critical Green LED" 23 "Non Critical Yellow LED" 24 "Non Critical Red LED" 25 "Non Critical Blue LED" 26 "Non Critical Grey LED" 28 "Critical Yellow LED" 29 "Critical Red LED" 30 "Critical Blue LED" 31 "Critical Grey LED";
VAL_ 2658013184 Status 0 "OK" 1 "Disabled" 2 "Initializing" 3 "Heating" 4 "WB_Active" 5 "Too Cold" 6 "Too Hot" 7 "Unplugged" 8 "Slow!" 9 "Uncal Yellow" 10 "Uncal Red" 11 "Replace" 12 "Disabled" 13 "Shorted" 14 "Open" 15 "Over Range" 16 "Under Range" 17 "Undefined" 18 "Error!" 19 "Low Error" 20 "High Error" 21 "Non Critical No LED" 27 "Critical Green LED" 32 "Stall!" 33 "Synchronized" 34 "Syncing" 35 "Error!" 36 "Error!" 37 "Uncalibrated" 38 "Open Loop" 39 "Closed Loop" 40 "Not Learn" 41 "Learning" 42 "Off" 43 "On" 44 "Not Rev Limiting" 45 "Rev Limit" 46 "No Cut Off" 47 "CutOff!" 48 "Off" 49 "Warning!" 50 "Caution!" 51 "No Timing modifier" 52 "Timing is being modified" 53 "Timing Value is being replaced" 54 "Acq Sat" 55 "No GPS" 56 "No Data" 22 "Non Critical Green LED" 23 "Non Critical Yellow LED" 24 "Non Critical Red LED" 25 "Non Critical Blue LED" 26 "Non Critical Grey LED" 28 "Critical Yellow LED" 29 "Critical Red LED" 30 "Critical Blue LED" 31 "Critical Grey LED";
VAL_ 2658029568 Status 0 "OK" 1 "Disabled" 2 "Initializing" 3 "Heating" 4 "WB_Active" 5 "Too Cold" 6 "Too Hot" 7 "Unplugged" 8 "Slow!" 9 "Uncal Yellow" 10 "Uncal Red" 11 "Replace" 12 "Disabled" 13 "Shorted" 14 "Open" 15 "Over Range" 16 "Under Range" 17 "Undefined" 18 "Error!" 19 "Low Error" 20 "High Error" 21 "Non Critical No LED" 27 "Critical Green LED" 32 "Stall!" 33 "Synchronized" 34 "Syncing" 35 "Error!" 36 "Error!" 37 "Uncalibrated" 38 "Open Loop" 39 "Closed Loop" 40 "Not Learn" 41 "Learning" 42 "Off" 43 "On" 44 "Not Rev Limiting" 45 "Rev Limit" 46 "No Cut Off" 47 "CutOff!" 48 "Off" 49 "Warning!" 50 "Caution!" 51 "No Timing modifier" 52 "Timing is being modified" 53 "Timing Value is being replaced" 54 "Acq Sat" 55 "No GPS" 56 "No Data" 22 "Non Critical Green LED" 23 "Non Critical Yellow LED" 24 "Non Critical Red LED" 25 "Non Critical Blue LED" 26 "Non Critical Grey LED" 28 "Critical Yellow LED" 29 "Critical Red LED" 30 "Critical Blue LED" 31 "Critical Grey LED";
VAL_ 2658045952 Status 0 "OK" 1 "Disabled" 2 "Initializing" 3 "Heating" 4 "WB_Active" 5 "Too Cold" 6 "Too Hot" 7 "Unplugged" 8 "Slow!" 9 "Uncal Yellow" 10 "Uncal Red" 11 "Replace" 12 "Disabled" 13 "Shorted" 14 "Open" 15 "Over Range" 16 "Under Range" 17 "Undefined" 18 "Error!" 19 "Low Error" 20 "High Error" 21 "Non Critical No LED" 27 "Critical Green LED" 32 "Stall!" 33 "Synchronized" 34 "Syncing" 35 "Error!" 36 "Error!" 37 "Uncalibrated" 38 "Open Loop" 39 "Closed Loop" 40 "Not Learn" 41 "Learning" 42 "Off" 43 "On" 44 "Not Rev Limiting" 45 "Rev Limit" 46 "No Cut Off" 47 "CutOff!" 48 "Off" 49 "Warning!" 50 "Caution!" 51 "No Timing modifier" 52 "Timing is being modified" 53 "Timing Value is being replaced" 54 "Acq Sat" 55 "No GPS" 56 "No Data" 22 "Non Critical Green LED" 23 "Non Critical Yellow LED" 24 "Non Critical Red LED" 25 "Non Critical Blue LED" 26 "Non Critical Grey LED" 28 "Critical Yellow LED" 29 "Critical Red LED" 30 "Critical Blue LED" 31 "Critical Grey LED";
VAL_ 2658062336 Status 0 "OK" 1 "Disabled" 2 "Initializing" 3 "Heating" 4 "WB_Active" 5 "Too Cold" 6 "Too Hot" 7 "Unplugged" 8 "Slow!" 9 "Uncal Yellow" 10 "Uncal Red" 11 "Replace" 12 "Disabled" 13 "Shorted" 14 "Open" 15 "Over Range" 16 "Under Range" 17 "Undefined" 18 "Error!" 19 "Low Error" 20 "High Error" 21 "Non Critical No LED" 27 "Critical Green LED" 32 "Stall!" 33 "Synchronized" 34 "Syncing" 35 "Error!" 36 "Error!" 37 "Uncalibrated" 38 "Open Loop" 39 "Closed Loop" 40 "Not Learn" 41 "Learning" 42 "Off" 43 "On" 44 "Not Rev Limiting" 45 "Rev Limit" 46 "No Cut Off" 47 "CutOff!" 48 "Off" 49 "Warning!" 50 "Caution!" 51 "No Timing modifier" 52 "Timing is being modified" 53 "Timing Value is being replaced" 54 "Acq Sat" 55 "No GPS" 56 "No Data" 22 "Non Critical Green LED" 23 "Non Critical Yellow LED" 24 "Non Critical Red LED" 25 "Non Critical Blue LED" 26 "Non Critical Grey LED" 28 "Critical Yellow LED" 29 "Critical Red LED" 30 "Critical Blue LED" 31 "Critical Grey LED";
VAL_ 2658078720 Status 0 "OK" 1 "Disabled" 2 "Initializing" 3 "Heating" 4 "WB_Active" 5 "Too Cold" 6 "Too Hot" 7 "Unplugged" 8 "Slow!" 9 "Uncal Yellow" 10 "Uncal Red" 11 "Replace" 12 "Disabled" 13 "Shorted" 14 "Open" 15 "Over Range" 16 "Under Range" 17 "Undefined" 18 "Error!" 19 "Low Error" 20 "High Error" 21 "Non Critical No LED" 27 "Critical Green LED" 32 "Stall!" 33 "Synchronized" 34 "Syncing" 35 "Error!" 36 "Error!" 37 "Uncalibrated" 38 "Open Loop" 39 "Closed Loop" 40 "Not Learn" 41 "Learning" 42 "Off" 43 "On" 44 "Not Rev Limiting" 45 "Rev Limit" 46 "No Cut Off" 47 "CutOff!" 48 "Off" 49 "Warning!" 50 "Caution!" 51 "No Timing modifier" 52 "Timing is being modified" 53 "Timing Value is being replaced" 54 "Acq Sat" 55 "No GPS" 56 "No Data" 22 "Non Critical Green LED" 23 "Non Critical Yellow LED" 24 "Non Critical Red LED" 25 "Non Critical Blue LED" 26 "Non Critical Grey LED" 28 "Critical Yellow LED" 29 "Critical Red LED" 30 "Critical Blue LED" 31 "Critical Grey LED";
VAL_ 2658095104 Status 0 "OK" 1 "Disabled" 2 "Initializing" 3 "Heating" 4 "WB_Active" 5 "Too Cold" 6 "Too Hot" 7 "Unplugged" 8 "Slow!" 9 "Uncal Yellow" 10 "Uncal Red" 11 "Replace" 12 "Disabled" 13 "Shorted" 14 "Open" 15 "Over Range" 16 "Under Range" 17 "Undefined" 18 "Error!" 19 "Low Error" 20 "High Error" 21 "Non Critical No LED" 27 "Critical Green LED" 32 "Stall!" 33 "Synchronized" 34 "Syncing" 35 "Error!" 36 "Error!" 37 "Uncalibrated" 38 "Open Loop" 39 "Closed Loop" 40 "Not Learn" 41 "Learning" 42 "Off" 43 "On" 44 "Not Rev Limiting" 45 "Rev Limit" 46 "No Cut Off" 47 "CutOff!" 48 "Off" 49 "Warning!" 50 "Caution!" 51 "No Timing modifier" 52 "Timing is being modified" 53 "Timing Value is being replaced" 54 "Acq Sat" 55 "No GPS" 56 "No Data" 22 "Non Critical Green LED" 23 "Non Critical Yellow LED" 24 "Non Critical Red LED" 25 "Non Critical Blue LED" 26 "Non Critical Grey LED" 28 "Critical Yellow LED" 29 "Critical Red LED" 30 "Critical Blue LED" 31 "Critical Grey LED";
VAL_ 2658111488 Status 0 "OK" 1 "Disabled" 2 "Initializing" 3 "Heating" 4 "WB_Active" 5 "Too Cold" 6 "Too Hot" 7 "Unplugged" 8 "Slow!" 9 "Uncal Yellow" 10 "Uncal Red" 11 "Replace" 12 "Disabled" 13 "Shorted" 14 "Open" 15 "Over Range" 16 "Under Range" 17 "Undefined" 18 "Error!" 19 "Low Error" 20 "High Error" 21 "Non Critical No LED" 27 "Critical Green LED" 32 "Stall!" 33 "Synchronized" 34 "Syncing" 35 "Error!" 36 "Error!" 37 "Uncalibrated" 38 "Open Loop" 39 "Closed Loop" 40 "Not Learn" 41 "Learning" 42 "Off" 43 "On" 44 "Not Rev Limiting" 45 "Rev Limit" 46 "No Cut Off" 47 "CutOff!" 48 "Off" 49 "Warning!" 50 "Caution!" 51 "No Timing modifier" 52 "Timing is being modified" 53 "Timing Value is being replaced" 54 "Acq Sat" 55 "No GPS" 56 "No Data" 22 "Non Critical Green LED" 23 "Non Critical Yellow LED" 24 "Non Critical Red LED" 25 "Non Critical Blue LED" 26 "Non Critical Grey LED" 28 "Critical Yellow LED" 29 "Critical Red LED" 30 "Critical Blue LED" 31 "Critical Grey LED";
VAL_ 2658127872 Status 0 "OK" 1 "Disabled" 2 "Initializing" 3 "Heating" 4 "WB_Active" 5 "Too Cold" 6 "Too Hot" 7 "Unplugged" 8 "Slow!" 9 "Uncal Yellow" 10 "Uncal Red" 11 "Replace" 12 "Disabled" 13 "Shorted" 14 "Open" 15 "Over Range" 16 "Under Range" 17 "Undefined" 18 "Error!" 19 "Low Error" 20 "High Error" 21 "Non Critical No LED" 27 "Critical Green LED" 32 "Stall!" 33 "Synchronized" 34 "Syncing" 35 "Error!" 36 "Error!" 37 "Uncalibrated" 38 "Open Loop" 39 "Closed Loop" 40 "Not Learn" 41 "Learning" 42 "Off" 43 "On" 44 "Not Rev Limiting" 45 "Rev Limit" 46 "No Cut Off" 47 "CutOff!" 48 "Off" 49 "Warning!" 50 "Caution!" 51 "No Timing modifier" 52 "Timing is being modified" 53 "Timing Value is being replaced" 54 "Acq Sat" 55 "No GPS" 56 "No Data" 22 "Non Critical Green LED" 23 "Non Critical Yellow LED" 24 "Non Critical Red LED" 25 "Non Critical Blue LED" 26 "Non Critical Grey LED" 28 "Critical Yellow LED" 29 "Critical Red LED" 30 "Critical Blue LED" 31 "Critical Grey LED";
VAL_ 2658144256 Status 0 "OK" 1 "Disabled" 2 "Initializing" 3 "Heating" 4 "WB_Active" 5 "Too Cold" 6 "Too Hot" 7 "Unplugged" 8 "Slow!" 9 "Uncal Yellow" 10 "Uncal Red" 11 "Replace" 12 "Disabled" 13 "Shorted" 14 "Open" 15 "Over Range" 16 "Under Range" 17 "Undefined" 18 "Error!" 19 "Low Error" 20 "High Error" 21 "Non Critical No LED" 27 "Critical Green LED" 32 "Stall!" 33 "Synchronized" 34 "Syncing" 35 "Error!" 36 "Error!" 37 "Uncalibrated" 38 "Open Loop" 39 "Closed Loop" 40 "Not Learn" 41 "Learning" 42 "Off" 43 "On" 44 "Not Rev Limiting" 45 "Rev Limit" 46 "No Cut Off" 47 "CutOff!" 48 "Off" 49 "Warning!" 50 "Caution!" 51 "No Timing modifier" 52 "Timing is being modified" 53 "Timing Value is being replaced" 54 "Acq Sat" 55 "No GPS" 56 "No Data" 22 "Non Critical Green LED" 23 "Non Critical Yellow LED" 24 "Non Critical Red LED" 25 "Non Critical Blue LED" 26 "Non Critical Grey LED" 28 "Critical Yellow LED" 29 "Critical Red LED" 30 "Critical Blue LED" 31 "Critical Grey LED";
VAL_ 2658160640 Status 0 "OK" 1 "Disabled" 2 "Initializing" 3 "Heating" 4 "WB_Active" 5 "Too Cold" 6 "Too Hot" 7 "Unplugged" 8 "Slow!" 9 "Uncal Yellow" 10 "Uncal Red" 11 "Replace" 12 "Disabled" 13 "Shorted" 14 "Open" 15 "Over Range" 16 "Under Range" 17 "Undefined" 18 "Error!" 19 "Low Error" 20 "High Error" 21 "Non Critical No LED" 27 "Critical Green LED" 32 "Stall!" 33 "Synchronized" 34 "Syncing" 35 "Error!" 36 "Error!" 37 "Uncalibrated" 38 "Open Loop" 39 "Closed Loop" 40 "Not Learn" 41 "Learning" 42 "Off" 43 "On" 44 "Not Rev Limiting" 45 "Rev Limit" 46 "No Cut Off" 47 "CutOff!" 48 "Off" 49 "Warning!" 50 "Caution!" 51 "No Timing modifier" 52 "Timing is being modified" 53 "Timing Value is being replaced" 54 "Acq Sat" 55 "No GPS" 56 "No Data" 22 "Non Critical Green LED" 23 "Non Critical Yellow LED" 24 "Non Critical Red LED" 25 "Non Critical Blue LED" 26 "Non Critical Grey LED" 28 "Critical Yellow LED" 29 "Critical Red LED" 30 "Critical Blue LED" 31 "Critical Grey LED";
VAL_ 2658177024 Status 0 "OK" 1 "Disabled" 2 "Initializing" 3 "Heating" 4 "WB_Active" 5 "Too Cold" 6 "Too Hot" 7 "Unplugged" 8 "Slow!" 9 "Uncal Yellow" 10 "Uncal Red" 11 "Replace" 12 "Disabled" 13 "Shorted" 14 "Open" 15 "Over Range" 16 "Under Range" 17 "Undefined" 18 "Error!" 19 "Low Error" 20 "High Error" 21 "Non Critical No LED" 27 "Critical Green LED" 32 "Stall!" 33 "Synchronized" 34 "Syncing" 35 "Error!" 36 "Error!" 37 "Uncalibrated" 38 "Open Loop" 39 "Closed Loop" 40 "Not Learn" 41 "Learning" 42 "Off" 43 "On" 44 "Not Rev Limiting" 45 "Rev Limit" 46 "No Cut Off" 47 "CutOff!" 48 "Off" 49 "Warning!" 50 "Caution!" 51 "No Timing modifier" 52 "Timing is being modified" 53 "Timing Value is being replaced" 54 "Acq Sat" 55 "No GPS" 56 "No Data" 22 "Non Critical Green LED" 23 "Non Critical Yellow LED" 24 "Non Critical Red LED" 25 "Non Critical Blue LED" 26 "Non Critical Grey LED" 28 "Critical Yellow LED" 29 "Critical Red LED" 30 "Critical Blue LED" 31 "Critical Grey LED";
VAL_ 2658193408 Status 0 "OK" 1 "Disabled" 2 "Initializing" 3 "Heating" 4 "WB_Active" 5 "Too Cold" 6 "Too Hot" 7 "Unplugged" 8 "Slow!" 9 "Uncal Yellow" 10 "Uncal Red" 11 "Replace" 12 "Disabled" 13 "Shorted" 14 "Open" 15 "Over Range" 16 "Under Range" 17 "Undefined" 18 "Error!" 19 "Low Error" 20 "High Error" 21 "Non Critical No LED" 27 "Critical Green LED" 32 "Stall!" 33 "Synchronized" 34 "Syncing" 35 "Error!" 36 "Error!" 37 "Uncalibrated" 38 "Open Loop" 39 "Closed Loop" 40 "Not Learn" 41 "Learning" 42 "Off" 43 "On" 44 "Not Rev Limiting" 45 "Rev Limit" 46 "No Cut Off" 47 "CutOff!" 48 "Off" 49 "Warning!" 50 "Caution!" 51 "No Timing modifier" 52 "Timing is being modified" 53 "Timing Value is being replaced" 54 "Acq Sat" 55 "No GPS" 56 "No Data" 22 "Non Critical Green LED" 23 "Non Critical Yellow LED" 24 "Non Critical Red LED" 25 "Non Critical Blue LED" 26 "Non Critical Grey LED" 28 "Critical Yellow LED" 29 "Critical Red LED" 30 "Critical Blue LED" 31 "Critical Grey LED";
VAL_ 2658209792 Status 0 "OK" 1 "Disabled" 2 "Initializing" 3 "Heating" 4 "WB_Active" 5 "Too Cold" 6 "Too Hot" 7 "Unplugged" 8 "Slow!" 9 "Uncal Yellow" 10 "Uncal Red" 11 "Replace" 12 "Disabled" 13 "Shorted" 14 "Open" 15 "Over Range" 16 "Under Range" 17 "Undefined" 18 "Error!" 19 "Low Error" 20 "High Error" 21 "Non Critical No LED" 27 "Critical Green LED" 32 "Stall!" 33 "Synchronized" 34 "Syncing" 35 "Error!" 36 "Error!" 37 "Uncalibrated" 38 "Open Loop" 39 "Closed Loop" 40 "Not Learn" 41 "Learning" 42 "Off" 43 "On" 44 "Not Rev Limiting" 45 "Rev Limit" 46 "No Cut Off" 47 "CutOff!" 48 "Off" 49 "Warning!" 50 "Caution!" 51 "No Timing modifier" 52 "Timing is being modified" 53 "Timing Value is being replaced" 54 "Acq Sat" 55 "No GPS" 56 "No Data" 22 "Non Critical Green LED" 23 "Non Critical Yellow LED" 24 "Non Critical Red LED" 25 "Non Critical Blue LED" 26 "Non Critical Grey LED" 28 "Critical Yellow LED" 29 "Critical Red LED" 30 "Critical Blue LED" 31 "Critical Grey LED";
VAL_ 2658226176 Status 0 "OK" 1 "Disabled" 2 "Initializing" 3 "Heating" 4 "WB_Active" 5 "Too Cold" 6 "Too Hot" 7 "Unplugged" 8 "Slow!" 9 "Uncal Yellow" 10 "Uncal Red" 11 "Replace" 12 "Disabled" 13 "Shorted" 14 "Open" 15 "Over Range" 16 "Under Range" 17 "Undefined" 18 "Error!" 19 "Low Error" 20 "High Error" 21 "Non Critical No LED" 27 "Critical Green LED" 32 "Stall!" 33 "Synchronized" 34 "Syncing" 35 "Error!" 36 "Error!" 37 "Uncalibrated" 38 "Open Loop" 39 "Closed Loop" 40 "Not Learn" 41 "Learning" 42 "Off" 43 "On" 44 "Not Rev Limiting" 45 "Rev Limit" 46 "No Cut Off" 47 "CutOff!" 48 "Off" 49 "Warning!" 50 "Caution!" 51 "No Timing modifier" 52 "Timing is being modified" 53 "Timing Value is being replaced" 54 "Acq Sat" 55 "No GPS" 56 "No Data" 22 "Non Critical Green LED" 23 "Non Critical Yellow LED" 24 "Non Critical Red LED" 25 "Non Critical Blue LED" 26 "Non Critical Grey LED" 28 "Critical Yellow LED" 29 "Critical Red LED" 30 "Critical Blue LED" 31 "Critical Grey LED";
VAL_ 2658242560 Status 0 "OK" 1 "Disabled" 2 "Initializing" 3 "Heating" 4 "WB_Active" 5 "Too Cold" 6 "Too Hot" 7 "Unplugged" 8 "Slow!" 9 "Uncal Yellow" 10 "Uncal Red" 11 "Replace" 12 "Disabled" 13 "Shorted" 14 "Open" 15 "Over Range" 16 "Under Range" 17 "Undefined" 18 "Error!" 19 "Low Error" 20 "High Error" 21 "Non Critical No LED" 27 "Critical Green LED" 32 "Stall!" 33 "Synchronized" 34 "Syncing" 35 "Error!" 36 "Error!" 37 "Uncalibrated" 38 "Open Loop" 39 "Closed Loop" 40 "Not Learn" 41 "Learning" 42 "Off" 43 "On" 44 "Not Rev Limiting" 45 "Rev Limit" 46 "No Cut Off" 47 "CutOff!" 48 "Off" 49 "Warning!" 50 "Caution!" 51 "No Timing modifier" 52 "Timing is being modified" 53 "Timing Value is being replaced" 54 "Acq Sat" 55 "No GPS" 56 "No Data" 22 "Non Critical Green LED" 23 "Non Critical Yellow LED" 24 "Non Critical Red LED" 25 "Non Critical Blue LED" 26 "Non Critical Grey LED" 28 "Critical Yellow LED" 29 "Critical Red LED" 30 "Critical Blue LED" 31 "Critical Grey LED";
VAL_ 2658258944 Status 0 "OK" 1 "Disabled" 2 "Initializing" 3 "Heating" 4 "WB_Active" 5 "Too Cold" 6 "Too Hot" 7 "Unplugged" 8 "Slow!" 9 "Uncal Yellow" 10 "Uncal Red" 11 "Replace" 12 "Disabled" 13 "Shorted" 14 "Open" 15 "Over Range" 16 "Under Range" 17 "Undefined" 18 "Error!" 19 "Low Error" 20 "High Error" 21 "Non Critical No LED" 27 "Critical Green LED" 32 "Stall!" 33 "Synchronized" 34 "Syncing" 35 "Error!" 36 "Error!" 37 "Uncalibrated" 38 "Open Loop" 39 "Closed Loop" 40 "Not Learn" 41 "Learning" 42 "Off" 43 "On" 44 "Not Rev Limiting" 45 "Rev Limit" 46 "No Cut Off" 47 "CutOff!" 48 "Off" 49 "Warning!" 50 "Caution!" 51 "No Timing modifier" 52 "Timing is being modified" 53 "Timing Value is being replaced" 54 "Acq Sat" 55 "No GPS" 56 "No Data" 22 "Non Critical Green LED" 23 "Non Critical Yellow LED" 24 "Non Critical Red LED" 25 "Non Critical Blue LED" 26 "Non Critical Grey LED" 28 "Critical Yellow LED" 29 "Critical Red LED" 30 "Critical Blue LED" 31 "Critical Grey LED";
VAL_ 2658275328 Status 0 "OK" 1 "Disabled" 2 "Initializing" 3 "Heating" 4 "WB_Active" 5 "Too Cold" 6 "Too Hot" 7 "Unplugged" 8 "Slow!" 9 "Uncal Yellow" 10 "Uncal Red" 11 "Replace" 12 "Disabled" 13 "Shorted" 14 "Open" 15 "Over Range" 16 "Under Range" 17 "Undefined" 18 "Error!" 19 "Low Error" 20 "High Error" 21 "Non Critical No LED" 27 "Critical Green LED" 32 "Stall!" 33 "Synchronized" 34 "Syncing" 35 "Error!" 36 "Error!" 37 "Uncalibrated" 38 "Open Loop" 39 "Closed Loop" 40 "Not Learn" 41 "Learning" 42 "Off" 43 "On" 44 "Not Rev Limiting" 45 "Rev Limit" 46 "No Cut Off" 47 "CutOff!" 48 "Off" 49 "Warning!" 50 "Caution!" 51 "No Timing modifier" 52 "Timing is being modified" 53 "Timing Value is being replaced" 54 "Acq Sat" 55 "No GPS" 56 "No Data" 22 "Non Critical Green LED" 23 "Non Critical Yellow LED" 24 "Non Critical Red LED" 25 "Non Critical Blue LED" 26 "Non Critical Grey LED" 28 "Critical Yellow LED" 29 "Critical Red LED" 30 "Critical Blue LED" 31 "Critical Grey LED";
VAL_ 2658291712 Status 0 "OK" 1 "Disabled" 2 "Initializing" 3 "Heating" 4 "WB_Active" 5 "Too Cold" 6 "Too Hot" 7 "Unplugged" 8 "Slow!" 9 "Uncal Yellow" 10 "Uncal Red" 11 "Replace" 12 "Disabled" 13 "Shorted" 14 "Open" 15 "Over Range" 16 "Under Range" 17 "Undefined" 18 "Error!" 19 "Low Error" 20 "High Error" 21 "Non Critical No LED" 27 "Critical Green LED" 32 "Stall!" 33 "Synchronized" 34 "Syncing" 35 "Error!" 36 "Error!" 37 "Uncalibrated" 38 "Open Loop" 39 "Closed Loop" 40 "Not Learn" 41 "Learning" 42 "Off" 43 "On" 44 "Not Rev Limiting" 45 "Rev Limit" 46 "No Cut Off" 47 "CutOff!" 48 "Off" 49 "Warning!" 50 "Caution!" 51 "No Timing modifier" 52 "Timing is being modified" 53 "Timing Value is being replaced" 54 "Acq Sat" 55 "No GPS" 56 "No Data" 22 "Non Critical Green LED" 23 "Non Critical Yellow LED" 24 "Non Critical Red LED" 25 "Non Critical Blue LED" 26 "Non Critical Grey LED" 28 "Critical Yellow LED" 29 "Critical Red LED" 30 "Critical Blue LED" 31 "Critical Grey LED";
VAL_ 2658308096 Status 0 "OK" 1 "Disabled" 2 "Initializing" 3 "Heating" 4 "WB_Active" 5 "Too Cold" 6 "Too Hot" 7 "Unplugged" 8 "Slow!" 9 "Uncal Yellow" 10 "Uncal Red" 11 "Replace" 12 "Disabled" 13 "Shorted" 14 "Open" 15 "Over Range" 16 "Under Range" 17 "Undefined" 18 "Error!" 19 "Low Error" 20 "High Error" 21 "Non Critical No LED" 27 "Critical Green LED" 32 "Stall!" 33 "Synchronized" 34 "Syncing" 35 "Error!" 36 "Error!" 37 "Uncalibrated" 38 "Open Loop" 39 "Closed Loop" 40 "Not Learn" 41 "Learning" 42 "Off" 43 "On" 44 "Not Rev Limiting" 45 "Rev Limit" 46 "No Cut Off" 47 "CutOff!" 48 "Off" 49 "Warning!" 50 "Caution!" 51 "No Timing modifier" 52 "Timing is being modified" 53 "Timing Value is being replaced" 54 "Acq Sat" 55 "No GPS" 56 "No Data" 22 "Non Critical Green LED" 23 "Non Critical Yellow LED" 24 "Non Critical Red LED" 25 "Non Critical Blue LED" 26 "Non Critical Grey LED" 28 "Critical Yellow LED" 29 "Critical Red LED" 30 "Critical Blue LED" 31 "Critical Grey LED";
VAL_ 2658324480 Status 0 "OK" 1 "Disabled" 2 "Initializing" 3 "Heating" 4 "WB_Active" 5 "Too Cold" 6 "Too Hot" 7 "Unplugged" 8 "Slow!" 9 "Uncal Yellow" 10 "Uncal Red" 11 "Replace" 12 "Disabled" 13 "Shorted" 14 "Open" 15 "Over Range" 16 "Under Range" 17 "Undefined" 18 "Error!" 19 "Low Error" 20 "High Error" 21 "Non Critical No LED" 27 "Critical Green LED" 32 "Stall!" 33 "Synchronized" 34 "Syncing" 35 "Error!" 36 "Error!" 37 "Uncalibrated" 38 "Open Loop" 39 "Closed Loop" 40 "Not Learn" 41 "Learning" 42 "Off" 43 "On" 44 "Not Rev Limiting" 45 "Rev Limit" 46 "No Cut Off" 47 "CutOff!" 48 "Off" 49 "Warning!" 50 "Caution!" 51 "No Timing modifier" 52 "Timing is being modified" 53 "Timing Value is being replaced" 54 "Acq Sat" 55 "No GPS" 56 "No Data" 22 "Non Critical Green LED" 23 "Non Critical Yellow LED" 24 "Non Critical Red LED" 25 "Non Critical Blue LED" 26 "Non Critical Grey LED" 28 "Critical Yellow LED" 29 "Critical Red LED" 30 "Critical Blue LED" 31 "Critical Grey LED";
VAL_ 2658340864 Status 0 "OK" 1 "Disabled" 2 "Initializing" 3 "Heating" 4 "WB_Active" 5 "Too Cold" 6 "Too Hot" 7 "Unplugged" 8 "Slow!" 9 "Uncal Yellow" 10 "Uncal Red" 11 "Replace" 12 "Disabled" 13 "Shorted" 14 "Open" 15 "Over Range" 16 "Under Range" 17 "Undefined" 18 "Error!" 19 "Low Error" 20 "High Error" 21 "Non Critical No LED" 27 "Critical Green LED" 32 "Stall!" 33 "Synchronized" 34 "Syncing" 35 "Error!" 36 "Error!" 37 "Uncalibrated" 38 "Open Loop" 39 "Closed Loop" 40 "Not Learn" 41 "Learning" 42 "Off" 43 "On" 44 "Not Rev Limiting" 45 "Rev Limit" 46 "No Cut Off" 47 "CutOff!" 48 "Off" 49 "Warning!" 50 "Caution!" 51 "No Timing modifier" 52 "Timing is being modified" 53 "Timing Value is being replaced" 54 "Acq Sat" 55 "No GPS" 56 "No Data" 22 "Non Critical Green LED" 23 "Non Critical Yellow LED" 24 "Non Critical Red LED" 25 "Non Critical Blue LED" 26 "Non Critical Grey LED" 28 "Critical Yellow LED" 29 "Critical Red LED" 30 "Critical Blue LED" 31 "Critical Grey LED";
VAL_ 2658357248 Status 0 "OK" 1 "Disabled" 2 "Initializing" 3 "Heating" 4 "WB_Active" 5 "Too Cold" 6 "Too Hot" 7 "Unplugged" 8 "Slow!" 9 "Uncal Yellow" 10 "Uncal Red" 11 "Replace" 12 "Disabled" 13 "Shorted" 14 "Open" 15 "Over Range" 16 "Under Range" 17 "Undefined" 18 "Error!" 19 "Low Error" 20 "High Error" 21 "Non Critical No LED" 27 "Critical Green LED" 32 "Stall!" 33 "Synchronized" 34 "Syncing" 35 "Error!" 36 "Error!" 37 "Uncalibrated" 38 "Open Loop" 39 "Closed Loop" 40 "Not Learn" 41 "Learning" 42 "Off" 43 "On" 44 "Not Rev Limiting" 45 "Rev Limit" 46 "No Cut Off" 47 "CutOff!" 48 "Off" 49 "Warning!" 50 "Caution!" 51 "No Timing modifier" 52 "Timing is being modified" 53 "Timing Value is being replaced" 54 "Acq Sat" 55 "No GPS" 56 "No Data" 22 "Non Critical Green LED" 23 "Non Critical Yellow LED" 24 "Non Critical Red LED" 25 "Non Critical Blue LED" 26 "Non Critical Grey LED" 28 "Critical Yellow LED" 29 "Critical Red LED" 30 "Critical Blue LED" 31 "Critical Grey LED";
VAL_ 2658373632 Status 0 "OK" 1 "Disabled" 2 "Initializing" 3 "Heating" 4 "WB_Active" 5 "Too Cold" 6 "Too Hot" 7 "Unplugged" 8 "Slow!" 9 "Uncal Yellow" 10 "Uncal Red" 11 "Replace" 12 "Disabled" 13 "Shorted" 14 "Open" 15 "Over Range" 16 "Under Range" 17 "Undefined" 18 "Error!" 19 "Low Error" 20 "High Error" 21 "Non Critical No LED" 27 "Critical Green LED" 32 "Stall!" 33 "Synchronized" 34 "Syncing" 35 "Error!" 36 "Error!" 37 "Uncalibrated" 38 "Open Loop" 39 "Closed Loop" 40 "Not Learn" 41 "Learning" 42 "Off" 43 "On" 44 "Not Rev Limiting" 45 "Rev Limit" 46 "No Cut Off" 47 "CutOff!" 48 "Off" 49 "Warning!" 50 "Caution!" 51 "No Timing modifier" 52 "Timing is being modified" 53 "Timing Value is being replaced" 54 "Acq Sat" 55 "No GPS" 56 "No Data" 22 "Non Critical Green LED" 23 "Non Critical Yellow LED" 24 "Non Critical Red LED" 25 "Non Critical Blue LED" 26 "Non Critical Grey LED" 28 "Critical Yellow LED" 29 "Critical Red LED" 30 "Critical Blue LED" 31 "Critical Grey LED";
VAL_ 2658390016 Status 0 "OK" 1 "Disabled" 2 "Initializing" 3 "Heating" 4 "WB_Active" 5 "Too Cold" 6 "Too Hot" 7 "Unplugged" 8 "Slow!" 9 "Uncal Yellow" 10 "Uncal Red" 11 "Replace" 12 "Disabled" 13 "Shorted" 14 "Open" 15 "Over Range" 16 "Under Range" 17 "Undefined" 18 "Error!" 19 "Low Error" 20 "High Error" 21 "Non Critical No LED" 27 "Critical Green LED" 32 "Stall!" 33 "Synchronized" 34 "Syncing" 35 "Error!" 36 "Error!" 37 "Uncalibrated" 38 "Open Loop" 39 "Closed Loop" 40 "Not Learn" 41 "Learning" 42 "Off" 43 "On" 44 "Not Rev Limiting" 45 "Rev Limit" 46 "No Cut Off" 47 "CutOff!" 48 "Off" 49 "Warning!" 50 "Caution!" 51 "No Timing modifier" 52 "Timing is being modified" 53 "Timing Value is being replaced" 54 "Acq Sat" 55 "No GPS" 56 "No Data" 22 "Non Critical Green LED" 23 "Non Critical Yellow LED" 24 "Non Critical Red LED" 25 "Non Critical Blue LED" 26 "Non Critical Grey LED" 28 "Critical Yellow LED" 29 "Critical Red LED" 30 "Critical Blue LED" 31 "Critical Grey LED";
VAL_ 2658406400 Status 0 "OK" 1 "Disabled" 2 "Initializing" 3 "Heating" 4 "WB_Active" 5 "Too Cold" 6 "Too Hot" 7 "Unplugged" 8 "Slow!" 9 "Uncal Yellow" 10 "Uncal Red" 11 "Replace" 12 "Disabled" 13 "Shorted" 14 "Open" 15 "Over Range" 16 "Under Range" 17 "Undefined" 18 "Error!" 19 "Low Error" 20 "High Error" 21 "Non Critical No LED" 27 "Critical Green LED" 32 "Stall!" 33 "Synchronized" 34 "Syncing" 35 "Error!" 36 "Error!" 37 "Uncalibrated" 38 "Open Loop" 39 "Closed Loop" 40 "Not Learn" 41 "Learning" 42 "Off" 43 "On" 44 "Not Rev Limiting" 45 "Rev Limit" 46 "No Cut Off" 47 "CutOff!" 48 "Off" 49 "Warning!" 50 "Caution!" 51 "No Timing modifier" 52 "Timing is being modified" 53 "Timing Value is being replaced" 54 "Acq Sat" 55 "No GPS" 56 "No Data" 22 "Non Critical Green LED" 23 "Non Critical Yellow LED" 24 "Non Critical Red LED" 25 "Non Critical Blue LED" 26 "Non Critical Grey LED" 28 "Critical Yellow LED" 29 "Critical Red LED" 30 "Critical Blue LED" 31 "Critical Grey LED";
VAL_ 2658422784 Status 0 "OK" 1 "Disabled" 2 "Initializing" 3 "Heating" 4 "WB_Active" 5 "Too Cold" 6 "Too Hot" 7 "Unplugged" 8 "Slow!" 9 "Uncal Yellow" 10 "Uncal Red" 11 "Replace" 12 "Disabled" 13 "Shorted" 14 "Open" 15 "Over Range" 16 "Under Range" 17 "Undefined" 18 "Error!" 19 "Low Error" 20 "High Error" 21 "Non Critical No LED" 27 "Critical Green LED" 32 "Stall!" 33 "Synchronized" 34 "Syncing" 35 "Error!" 36 "Error!" 37 "Uncalibrated" 38 "Open Loop" 39 "Closed Loop" 40 "Not Learn" 41 "Learning" 42 "Off" 43 "On" 44 "Not Rev Limiting" 45 "Rev Limit" 46 "No Cut Off" 47 "CutOff!" 48 "Off" 49 "Warning!" 50 "Caution!" 51 "No Timing modifier" 52 "Timing is being modified" 53 "Timing Value is being replaced" 54 "Acq Sat" 55 "No GPS" 56 "No Data" 22 "Non Critical Green LED" 23 "Non Critical Yellow LED" 24 "Non Critical Red LED" 25 "Non Critical Blue LED" 26 "Non Critical Grey LED" 28 "Critical Yellow LED" 29 "Critical Red LED" 30 "Critical Blue LED" 31 "Critical Grey LED";
VAL_ 2658439168 Status 0 "OK" 1 "Disabled" 2 "Initializing" 3 "Heating" 4 "WB_Active" 5 "Too Cold" 6 "Too Hot" 7 "Unplugged" 8 "Slow!" 9 "Uncal Yellow" 10 "Uncal Red" 11 "Replace" 12 "Disabled" 13 "Shorted" 14 "Open" 15 "Over Range" 16 "Under Range" 17 "Undefined" 18 "Error!" 19 "Low Error" 20 "High Error" 21 "Non Critical No LED" 27 "Critical Green LED" 32 "Stall!" 33 "Synchronized" 34 "Syncing" 35 "Error!" 36 "Error!" 37 "Uncalibrated" 38 "Open Loop" 39 "Closed Loop" 40 "Not Learn" 41 "Learning" 42 "Off" 43 "On" 44 "Not Rev Limiting" 45 "Rev Limit" 46 "No Cut Off" 47 "CutOff!" 48 "Off" 49 "Warning!" 50 "Caution!" 51 "No Timing modifier" 52 "Timing is being modified" 53 "Timing Value is being replaced" 54 "Acq Sat" 55 "No GPS" 56 "No Data" 22 "Non Critical Green LED" 23 "Non Critical Yellow LED" 24 "Non Critical Red LED" 25 "Non Critical Blue LED" 26 "Non Critical Grey LED" 28 "Critical Yellow LED" 29 "Critical Red LED" 30 "Critical Blue LED" 31 "Critical Grey LED";
VAL_ 2658455552 Status 0 "OK" 1 "Disabled" 2 "Initializing" 3 "Heating" 4 "WB_Active" 5 "Too Cold" 6 "Too Hot" 7 "Unplugged" 8 "Slow!" 9 "Uncal Yellow" 10 "Uncal Red" 11 "Replace" 12 "Disabled" 13 "Shorted" 14 "Open" 15 "Over Range" 16 "Under Range" 17 "Undefined" 18 "Error!" 19 "Low Error" 20 "High Error" 21 "Non Critical No LED" 27 "Critical Green LED" 32 "Stall!" 33 "Synchronized" 34 "Syncing" 35 "Error!" 36 "Error!" 37 "Uncalibrated" 38 "Open Loop" 39 "Closed Loop" 40 "Not Learn" 41 "Learning" 42 "Off" 43 "On" 44 "Not Rev Limiting" 45 "Rev Limit" 46 "No Cut Off" 47 "CutOff!" 48 "Off" 49 "Warning!" 50 "Caution!" 51 "No Timing modifier" 52 "Timing is being modified" 53 "Timing Value is being replaced" 54 "Acq Sat" 55 "No GPS" 56 "No Data" 22 "Non Critical Green LED" 23 "Non Critical Yellow LED" 24 "Non Critical Red LED" 25 "Non Critical Blue LED" 26 "Non Critical Grey LED" 28 "Critical Yellow LED" 29 "Critical Red LED" 30 "Critical Blue LED" 31 "Critical Grey LED";
VAL_ 2658471936 Status 0 "OK" 1 "Disabled" 2 "Initializing" 3 "Heating" 4 "WB_Active" 5 "Too Cold" 6 "Too Hot" 7 "Unplugged" 8 "Slow!" 9 "Uncal Yellow" 10 "Uncal Red" 11 "Replace" 12 "Disabled" 13 "Shorted" 14 "Open" 15 "Over Range" 16 "Under Range" 17 "Undefined" 18 "Error!" 19 "Low Error" 20 "High Error" 21 "Non Critical No LED" 27 "Critical Green LED" 32 "Stall!" 33 "Synchronized" 34 "Syncing" 35 "Error!" 36 "Error!" 37 "Uncalibrated" 38 "Open Loop" 39 "Closed Loop" 40 "Not Learn" 41 "Learning" 42 "Off" 43 "On" 44 "Not Rev Limiting" 45 "Rev Limit" 46 "No Cut Off" 47 "CutOff!" 48 "Off" 49 "Warning!" 50 "Caution!" 51 "No Timing modifier" 52 "Timing is being modified" 53 "Timing Value is being replaced" 54 "Acq Sat" 55 "No GPS" 56 "No Data" 22 "Non Critical Green LED" 23 "Non Critical Yellow LED" 24 "Non Critical Red LED" 25 "Non Critical Blue LED" 26 "Non Critical Grey LED" 28 "Critical Yellow LED" 29 "Critical Red LED" 30 "Critical Blue LED" 31 "Critical Grey LED";
VAL_ 2658488320 Status 0 "OK" 1 "Disabled" 2 "Initializing" 3 "Heating" 4 "WB_Active" 5 "Too Cold" 6 "Too Hot" 7 "Unplugged" 8 "Slow!" 9 "Uncal Yellow" 10 "Uncal Red" 11 "Replace" 12 "Disabled" 13 "Shorted" 14 "Open" 15 "Over Range" 16 "Under Range" 17 "Undefined" 18 "Error!" 19 "Low Error" 20 "High Error" 21 "Non Critical No LED" 27 "Critical Green LED" 32 "Stall!" 33 "Synchronized" 34 "Syncing" 35 "Error!" 36 "Error!" 37 "Uncalibrated" 38 "Open Loop" 39 "Closed Loop" 40 "Not Learn" 41 "Learning" 42 "Off" 43 "On" 44 "Not Rev Limiting" 45 "Rev Limit" 46 "No Cut Off" 47 "CutOff!" 48 "Off" 49 "Warning!" 50 "Caution!" 51 "No Timing modifier" 52 "Timing is being modified" 53 "Timing Value is being replaced" 54 "Acq Sat" 55 "No GPS" 56 "No Data" 22 "Non Critical Green LED" 23 "Non Critical Yellow LED" 24 "Non Critical Red LED" 25 "Non Critical Blue LED" 26 "Non Critical Grey LED" 28 "Critical Yellow LED" 29 "Critical Red LED" 30 "Critical Blue LED" 31 "Critical Grey LED";
VAL_ 2658504704 Status 0 "OK" 1 "Disabled" 2 "Initializing" 3 "Heating" 4 "WB_Active" 5 "Too Cold" 6 "Too Hot" 7 "Unplugged" 8 "Slow!" 9 "Uncal Yellow" 10 "Uncal Red" 11 "Replace" 12 "Disabled" 13 "Shorted" 14 "Open" 15 "Over Range" 16 "Under Range" 17 "Undefined" 18 "Error!" 19 "Low Error" 20 "High Error" 21 "Non Critical No LED" 27 "Critical Green LED" 32 "Stall!" 33 "Synchronized" 34 "Syncing" 35 "Error!" 36 "Error!" 37 "Uncalibrated" 38 "Open Loop" 39 "Closed Loop" 40 "Not Learn" 41 "Learning" 42 "Off" 43 "On" 44 "Not Rev Limiting" 45 "Rev Limit" 46 "No Cut Off" 47 "CutOff!" 48 "Off" 49 "Warning!" 50 "Caution!" 51 "No Timing modifier" 52 "Timing is being modified" 53 "Timing Value is being replaced" 54 "Acq Sat" 55 "No GPS" 56 "No Data" 22 "Non Critical Green LED" 23 "Non Critical Yellow LED" 24 "Non Critical Red LED" 25 "Non Critical Blue LED" 26 "Non Critical Grey LED" 28 "Critical Yellow LED" 29 "Critical Red LED" 30 "Critical Blue LED" 31 "Critical Grey LED";
VAL_ 2658521088 Status 0 "OK" 1 "Disabled" 2 "Initializing" 3 "Heating" 4 "WB_Active" 5 "Too Cold" 6 "Too Hot" 7 "Unplugged" 8 "Slow!" 9 "Uncal Yellow" 10 "Uncal Red" 11 "Replace" 12 "Disabled" 13 "Shorted" 14 "Open" 15 "Over Range" 16 "Under Range" 17 "Undefined" 18 "Error!" 19 "Low Error" 20 "High Error" 21 "Non Critical No LED" 27 "Critical Green LED" 32 "Stall!" 33 "Synchronized" 34 "Syncing" 35 "Error!" 36 "Error!" 37 "Uncalibrated" 38 "Open Loop" 39 "Closed Loop" 40 "Not Learn" 41 "Learning" 42 "Off" 43 "On" 44 "Not Rev Limiting" 45 "Rev Limit" 46 "No Cut Off" 47 "CutOff!" 48 "Off" 49 "Warning!" 50 "Caution!" 51 "No Timing modifier" 52 "Timing is being modified" 53 "Timing Value is being replaced" 54 "Acq Sat" 55 "No GPS" 56 "No Data" 22 "Non Critical Green LED" 23 "Non Critical Yellow LED" 24 "Non Critical Red LED" 25 "Non Critical Blue LED" 26 "Non Critical Grey LED" 28 "Critical Yellow LED" 29 "Critical Red LED" 30 "Critical Blue LED" 31 "Critical Grey LED";
VAL_ 2658537472 Status 0 "OK" 1 "Disabled" 2 "Initializing" 3 "Heating" 4 "WB_Active" 5 "Too Cold" 6 "Too Hot" 7 "Unplugged" 8 "Slow!" 9 "Uncal Yellow" 10 "Uncal Red" 11 "Replace" 12 "Disabled" 13 "Shorted" 14 "Open" 15 "Over Range" 16 "Under Range" 17 "Undefined" 18 "Error!" 19 "Low Error" 20 "High Error" 21 "Non Critical No LED" 27 "Critical Green LED" 32 "Stall!" 33 "Synchronized" 34 "Syncing" 35 "Error!" 36 "Error!" 37 "Uncalibrated" 38 "Open Loop" 39 "Closed Loop" 40 "Not Learn" 41 "Learning" 42 "Off" 43 "On" 44 "Not Rev Limiting" 45 "Rev Limit" 46 "No Cut Off" 47 "CutOff!" 48 "Off" 49 "Warning!" 50 "Caution!" 51 "No Timing modifier" 52 "Timing is being modified" 53 "Timing Value is being replaced" 54 "Acq Sat" 55 "No GPS" 56 "No Data" 22 "Non Critical Green LED" 23 "Non Critical Yellow LED" 24 "Non Critical Red LED" 25 "Non Critical Blue LED" 26 "Non Critical Grey LED" 28 "Critical Yellow LED" 29 "Critical Red LED" 30 "Critical Blue LED" 31 "Critical Grey LED";
VAL_ 2658553856 Status 0 "OK" 1 "Disabled" 2 "Initializing" 3 "Heating" 4 "WB_Active" 5 "Too Cold" 6 "Too Hot" 7 "Unplugged" 8 "Slow!" 9 "Uncal Yellow" 10 "Uncal Red" 11 "Replace" 12 "Disabled" 13 "Shorted" 14 "Open" 15 "Over Range" 16 "Under Range" 17 "Undefined" 18 "Error!" 19 "Low Error" 20 "High Error" 21 "Non Critical No LED" 27 "Critical Green LED" 32 "Stall!" 33 "Synchronized" 34 "Syncing" 35 "Error!" 36 "Error!" 37 "Uncalibrated" 38 "Open Loop" 39 "Closed Loop" 40 "Not Learn" 41 "Learning" 42 "Off" 43 "On" 44 "Not Rev Limiting" 45 "Rev Limit" 46 "No Cut Off" 47 "CutOff!" 48 "Off" 49 "Warning!" 50 "Caution!" 51 "No Timing modifier" 52 "Timing is being modified" 53 "Timing Value is being replaced" 54 "Acq Sat" 55 "No GPS" 56 "No Data" 22 "Non Critical Green LED" 23 "Non Critical Yellow LED" 24 "Non Critical Red LED" 25 "Non Critical Blue LED" 26 "Non Critical Grey LED" 28 "Critical Yellow LED" 29 "Critical Red LED" 30 "Critical Blue LED" 31 "Critical Grey LED";
VAL_ 2658570240 Status 0 "OK" 1 "Disabled" 2 "Initializing" 3 "Heating" 4 "WB_Active" 5 "Too Cold" 6 "Too Hot" 7 "Unplugged" 8 "Slow!" 9 "Uncal Yellow" 10 "Uncal Red" 11 "Replace" 12 "Disabled" 13 "Shorted" 14 "Open" 15 "Over Range" 16 "Under Range" 17 "Undefined" 18 "Error!" 19 "Low Error" 20 "High Error" 21 "Non Critical No LED" 27 "Critical Green LED" 32 "Stall!" 33 "Synchronized" 34 "Syncing" 35 "Error!" 36 "Error!" 37 "Uncalibrated" 38 "Open Loop" 39 "Closed Loop" 40 "Not Learn" 41 "Learning" 42 "Off" 43 "On" 44 "Not Rev Limiting" 45 "Rev Limit" 46 "No Cut Off" 47 "CutOff!" 48 "Off" 49 "Warning!" 50 "Caution!" 51 "No Timing modifier" 52 "Timing is being modified" 53 "Timing Value is being replaced" 54 "Acq Sat" 55 "No GPS" 56 "No Data" 22 "Non Critical Green LED" 23 "Non Critical Yellow LED" 24 "Non Critical Red LED" 25 "Non Critical Blue LED" 26 "Non Critical Grey LED" 28 "Critical Yellow LED" 29 "Critical Red LED" 30 "Critical Blue LED" 31 "Critical Grey LED";
VAL_ 2658586624 Status 0 "OK" 1 "Disabled" 2 "Initializing" 3 "Heating" 4 "WB_Active" 5 "Too Cold" 6 "Too Hot" 7 "Unplugged" 8 "Slow!" 9 "Uncal Yellow" 10 "Uncal Red" 11 "Replace" 12 "Disabled" 13 "Shorted" 14 "Open" 15 "Over Range" 16 "Under Range" 17 "Undefined" 18 "Error!" 19 "Low Error" 20 "High Error" 21 "Non Critical No LED" 27 "Critical Green LED" 32 "Stall!" 33 "Synchronized" 34 "Syncing" 35 "Error!" 36 "Error!" 37 "Uncalibrated" 38 "Open Loop" 39 "Closed Loop" 40 "Not Learn" 41 "Learning" 42 "Off" 43 "On" 44 "Not Rev Limiting" 45 "Rev Limit" 46 "No Cut Off" 47 "CutOff!" 48 "Off" 49 "Warning!" 50 "Caution!" 51 "No Timing modifier" 52 "Timing is being modified" 53 "Timing Value is being replaced" 54 "Acq Sat" 55 "No GPS" 56 "No Data" 22 "Non Critical Green LED" 23 "Non Critical Yellow LED" 24 "Non Critical Red LED" 25 "Non Critical Blue LED" 26 "Non Critical Grey LED" 28 "Critical Yellow LED" 29 "Critical Red LED" 30 "Critical Blue LED" 31 "Critical Grey LED";
VAL_ 2658603008 Status 0 "OK" 1 "Disabled" 2 "Initializing" 3 "Heating" 4 "WB_Active" 5 "Too Cold" 6 "Too Hot" 7 "Unplugged" 8 "Slow!" 9 "Uncal Yellow" 10 "Uncal Red" 11 "Replace" 12 "Disabled" 13 "Shorted" 14 "Open" 15 "Over Range" 16 "Under Range" 17 "Undefined" 18 "Error!" 19 "Low Error" 20 "High Error" 21 "Non Critical No LED" 27 "Critical Green LED" 32 "Stall!" 33 "Synchronized" 34 "Syncing" 35 "Error!" 36 "Error!" 37 "Uncalibrated" 38 "Open Loop" 39 "Closed Loop" 40 "Not Learn" 41 "Learning" 42 "Off" 43 "On" 44 "Not Rev Limiting" 45 "Rev Limit" 46 "No Cut Off" 47 "CutOff!" 48 "Off" 49 "Warning!" 50 "Caution!" 51 "No Timing modifier" 52 "Timing is being modified" 53 "Timing Value is being replaced" 54 "Acq Sat" 55 "No GPS" 56 "No Data" 22 "Non Critical Green LED" 23 "Non Critical Yellow LED" 24 "Non Critical Red LED" 25 "Non Critical Blue LED" 26 "Non Critical Grey LED" 28 "Critical Yellow LED" 29 "Critical Red LED" 30 "Critical Blue LED" 31 "Critical Grey LED";
VAL_ 2658619392 Status 0 "OK" 1 "Disabled" 2 "Initializing" 3 "Heating" 4 "WB_Active" 5 "Too Cold" 6 "Too Hot" 7 "Unplugged" 8 "Slow!" 9 "Uncal Yellow" 10 "Uncal Red" 11 "Replace" 12 "Disabled" 13 "Shorted" 14 "Open" 15 "Over Range" 16 "Under Range" 17 "Undefined" 18 "Error!" 19 "Low Error" 20 "High Error" 21 "Non Critical No LED" 27 "Critical Green LED" 32 "Stall!" 33 "Synchronized" 34 "Syncing" 35 "Error!" 36 "Error!" 37 "Uncalibrated" 38 "Open Loop" 39 "Closed Loop" 40 "Not Learn" 41 "Learning" 42 "Off" 43 "On" 44 "Not Rev Limiting" 45 "Rev Limit" 46 "No Cut Off" 47 "CutOff!" 48 "Off" 49 "Warning!" 50 "Caution!" 51 "No Timing modifier" 52 "Timing is being modified" 53 "Timing Value is being replaced" 54 "Acq Sat" 55 "No GPS" 56 "No Data" 22 "Non Critical Green LED" 23 "Non Critical Yellow LED" 24 "Non Critical Red LED" 25 "Non Critical Blue LED" 26 "Non Critical Grey LED" 28 "Critical Yellow LED" 29 "Critical Red LED" 30 "Critical Blue LED" 31 "Critical Grey LED";
VAL_ 2658635776 Status 0 "OK" 1 "Disabled" 2 "Initializing" 3 "Heating" 4 "WB_Active" 5 "Too Cold" 6 "Too Hot" 7 "Unplugged" 8 "Slow!" 9 "Uncal Yellow" 10 "Uncal Red" 11 "Replace" 12 "Disabled" 13 "Shorted" 14 "Open" 15 "Over Range" 16 "Under Range" 17 "Undefined" 18 "Error!" 19 "Low Error" 20 "High Error" 21 "Non Critical No LED" 27 "Critical Green LED" 32 "Stall!" 33 "Synchronized" 34 "Syncing" 35 "Error!" 36 "Error!" 37 "Uncalibrated" 38 "Open Loop" 39 "Closed Loop" 40 "Not Learn" 41 "Learning" 42 "Off" 43 "On" 44 "Not Rev Limiting" 45 "Rev Limit" 46 "No Cut Off" 47 "CutOff!" 48 "Off" 49 "Warning!" 50 "Caution!" 51 "No Timing modifier" 52 "Timing is being modified" 53 "Timing Value is being replaced" 54 "Acq Sat" 55 "No GPS" 56 "No Data" 22 "Non Critical Green LED" 23 "Non Critical Yellow LED" 24 "Non Critical Red LED" 25 "Non Critical Blue LED" 26 "Non Critical Grey LED" 28 "Critical Yellow LED" 29 "Critical Red LED" 30 "Critical Blue LED" 31 "Critical Grey LED";
VAL_ 2658652160 Status 0 "OK" 1 "Disabled" 2 "Initializing" 3 "Heating" 4 "WB_Active" 5 "Too Cold" 6 "Too Hot" 7 "Unplugged" 8 "Slow!" 9 "Uncal Yellow" 10 "Uncal Red" 11 "Replace" 12 "Disabled" 13 "Shorted" 14 "Open" 15 "Over Range" 16 "Under Range" 17 "Undefined" 18 "Error!" 19 "Low Error" 20 "High Error" 21 "Non Critical No LED" 27 "Critical Green LED" 32 "Stall!" 33 "Synchronized" 34 "Syncing" 35 "Error!" 36 "Error!" 37 "Uncalibrated" 38 "Open Loop" 39 "Closed Loop" 40 "Not Learn" 41 "Learning" 42 "Off" 43 "On" 44 "Not Rev Limiting" 45 "Rev Limit" 46 "No Cut Off" 47 "CutOff!" 48 "Off" 49 "Warning!" 50 "Caution!" 51 "No Timing modifier" 52 "Timing is being modified" 53 "Timing Value is being replaced" 54 "Acq Sat" 55 "No GPS" 56 "No Data" 22 "Non Critical Green LED" 23 "Non Critical Yellow LED" 24 "Non Critical Red LED" 25 "Non Critical Blue LED" 26 "Non Critical Grey LED" 28 "Critical Yellow LED" 29 "Critical Red LED" 30 "Critical Blue LED" 31 "Critical Grey LED";
VAL_ 2658668544 Status 0 "OK" 1 "Disabled" 2 "Initializing" 3 "Heating" 4 "WB_Active" 5 "Too Cold" 6 "Too Hot" 7 "Unplugged" 8 "Slow!" 9 "Uncal Yellow" 10 "Uncal Red" 11 "Replace" 12 "Disabled" 13 "Shorted" 14 "Open" 15 "Over Range" 16 "Under Range" 17 "Undefined" 18 "Error!" 19 "Low Error" 20 "High Error" 21 "Non Critical No LED" 27 "Critical Green LED" 32 "Stall!" 33 "Synchronized" 34 "Syncing" 35 "Error!" 36 "Error!" 37 "Uncalibrated" 38 "Open Loop" 39 "Closed Loop" 40 "Not Learn" 41 "Learning" 42 "Off" 43 "On" 44 "Not Rev Limiting" 45 "Rev Limit" 46 "No Cut Off" 47 "CutOff!" 48 "Off" 49 "Warning!" 50 "Caution!" 51 "No Timing modifier" 52 "Timing is being modified" 53 "Timing Value is being replaced" 54 "Acq Sat" 55 "No GPS" 56 "No Data" 22 "Non Critical Green LED" 23 "Non Critical Yellow LED" 24 "Non Critical Red LED" 25 "Non Critical Blue LED" 26 "Non Critical Grey LED" 28 "Critical Yellow LED" 29 "Critical Red LED" 30 "Critical Blue LED" 31 "Critical Grey LED";
VAL_ 2658684928 Status 0 "OK" 1 "Disabled" 2 "Initializing" 3 "Heating" 4 "WB_Active" 5 "Too Cold" 6 "Too Hot" 7 "Unplugged" 8 "Slow!" 9 "Uncal Yellow" 10 "Uncal Red" 11 "Replace" 12 "Disabled" 13 "Shorted" 14 "Open" 15 "Over Range" 16 "Under Range" 17 "Undefined" 18 "Error!" 19 "Low Error" 20 "High Error" 21 "Non Critical No LED" 27 "Critical Green LED" 32 "Stall!" 33 "Synchronized" 34 "Syncing" 35 "Error!" 36 "Error!" 37 "Uncalibrated" 38 "Open Loop" 39 "Closed Loop" 40 "Not Learn" 41 "Learning" 42 "Off" 43 "On" 44 "Not Rev Limiting" 45 "Rev Limit" 46 "No Cut Off" 47 "CutOff!" 48 "Off" 49 "Warning!" 50 "Caution!" 51 "No Timing modifier" 52 "Timing is being modified" 53 "Timing Value is being replaced" 54 "Acq Sat" 55 "No GPS" 56 "No Data" 22 "Non Critical Green LED" 23 "Non Critical Yellow LED" 24 "Non Critical Red LED" 25 "Non Critical Blue LED" 26 "Non Critical Grey LED" 28 "Critical Yellow LED" 29 "Critical Red LED" 30 "Critical Blue LED" 31 "Critical Grey LED";
VAL_ 2658701312 Status 0 "OK" 1 "Disabled" 2 "Initializing" 3 "Heating" 4 "WB_Active" 5 "Too Cold" 6 "Too Hot" 7 "Unplugged" 8 "Slow!" 9 "Uncal Yellow" 10 "Uncal Red" 11 "Replace" 12 "Disabled" 13 "Shorted" 14 "Open" 15 "Over Range" 16 "Under Range" 17 "Undefined" 18 "Error!" 19 "Low Error" 20 "High Error" 21 "Non Critical No LED" 27 "Critical Green LED" 32 "Stall!" 33 "Synchronized" 34 "Syncing" 35 "Error!" 36 "Error!" 37 "Uncalibrated" 38 "Open Loop" 39 "Closed Loop" 40 "Not Learn" 41 "Learning" 42 "Off" 43 "On" 44 "Not Rev Limiting" 45 "Rev Limit" 46 "No Cut Off" 47 "CutOff!" 48 "Off" 49 "Warning!" 50 "Caution!" 51 "No Timing modifier" 52 "Timing is being modified" 53 "Timing Value is being replaced" 54 "Acq Sat" 55 "No GPS" 56 "No Data" 22 "Non Critical Green LED" 23 "Non Critical Yellow LED" 24 "Non Critical Red LED" 25 "Non Critical Blue LED" 26 "Non Critical Grey LED" 28 "Critical Yellow LED" 29 "Critical Red LED" 30 "Critical Blue LED" 31 "Critical Grey LED";
VAL_ 2658717696 Status 0 "OK" 1 "Disabled" 2 "Initializing" 3 "Heating" 4 "WB_Active" 5 "Too Cold" 6 "Too Hot" 7 "Unplugged" 8 "Slow!" 9 "Uncal Yellow" 10 "Uncal Red" 11 "Replace" 12 "Disabled" 13 "Shorted" 14 "Open" 15 "Over Range" 16 "Under Range" 17 "Undefined" 18 "Error!" 19 "Low Error" 20 "High Error" 21 "Non Critical No LED" 27 "Critical Green LED" 32 "Stall!" 33 "Synchronized" 34 "Syncing" 35 "Error!" 36 "Error!" 37 "Uncalibrated" 38 "Open Loop" 39 "Closed Loop" 40 "Not Learn" 41 "Learning" 42 "Off" 43 "On" 44 "Not Rev Limiting" 45 "Rev Limit" 46 "No Cut Off" 47 "CutOff!" 48 "Off" 49 "Warning!" 50 "Caution!" 51 "No Timing modifier" 52 "Timing is being modified" 53 "Timing Value is being replaced" 54 "Acq Sat" 55 "No GPS" 56 "No Data" 22 "Non Critical Green LED" 23 "Non Critical Yellow LED" 24 "Non Critical Red LED" 25 "Non Critical Blue LED" 26 "Non Critical Grey LED" 28 "Critical Yellow LED" 29 "Critical Red LED" 30 "Critical Blue LED" 31 "Critical Grey LED";
VAL_ 2658734080 Status 0 "OK" 1 "Disabled" 2 "Initializing" 3 "Heating" 4 "WB_Active" 5 "Too Cold" 6 "Too Hot" 7 "Unplugged" 8 "Slow!" 9 "Uncal Yellow" 10 "Uncal Red" 11 "Replace" 12 "Disabled" 13 "Shorted" 14 "Open" 15 "Over Range" 16 "Under Range" 17 "Undefined" 18 "Error!" 19 "Low Error" 20 "High Error" 21 "Non Critical No LED" 27 "Critical Green LED" 32 "Stall!" 33 "Synchronized" 34 "Syncing" 35 "Error!" 36 "Error!" 37 "Uncalibrated" 38 "Open Loop" 39 "Closed Loop" 40 "Not Learn" 41 "Learning" 42 "Off" 43 "On" 44 "Not Rev Limiting" 45 "Rev Limit" 46 "No Cut Off" 47 "CutOff!" 48 "Off" 49 "Warning!" 50 "Caution!" 51 "No Timing modifier" 52 "Timing is being modified" 53 "Timing Value is being replaced" 54 "Acq Sat" 55 "No GPS" 56 "No Data" 22 "Non Critical Green LED" 23 "Non Critical Yellow LED" 24 "Non Critical Red LED" 25 "Non Critical Blue LED" 26 "Non Critical Grey LED" 28 "Critical Yellow LED" 29 "Critical Red LED" 30 "Critical Blue LED" 31 "Critical Grey LED";
VAL_ 2658750464 Status 0 "OK" 1 "Disabled" 2 "Initializing" 3 "Heating" 4 "WB_Active" 5 "Too Cold" 6 "Too Hot" 7 "Unplugged" 8 "Slow!" 9 "Uncal Yellow" 10 "Uncal Red" 11 "Replace" 12 "Disabled" 13 "Shorted" 14 "Open" 15 "Over Range" 16 "Under Range" 17 "Undefined" 18 "Error!" 19 "Low Error" 20 "High Error" 21 "Non Critical No LED" 27 "Critical Green LED" 32 "Stall!" 33 "Synchronized" 34 "Syncing" 35 "Error!" 36 "Error!" 37 "Uncalibrated" 38 "Open Loop" 39 "Closed Loop" 40 "Not Learn" 41 "Learning" 42 "Off" 43 "On" 44 "Not Rev Limiting" 45 "Rev Limit" 46 "No Cut Off" 47 "CutOff!" 48 "Off" 49 "Warning!" 50 "Caution!" 51 "No Timing modifier" 52 "Timing is being modified" 53 "Timing Value is being replaced" 54 "Acq Sat" 55 "No GPS" 56 "No Data" 22 "Non Critical Green LED" 23 "Non Critical Yellow LED" 24 "Non Critical Red LED" 25 "Non Critical Blue LED" 26 "Non Critical Grey LED" 28 "Critical Yellow LED" 29 "Critical Red LED" 30 "Critical Blue LED" 31 "Critical Grey LED";
VAL_ 2658766848 Status 0 "OK" 1 "Disabled" 2 "Initializing" 3 "Heating" 4 "WB_Active" 5 "Too Cold" 6 "Too Hot" 7 "Unplugged" 8 "Slow!" 9 "Uncal Yellow" 10 "Uncal Red" 11 "Replace" 12 "Disabled" 13 "Shorted" 14 "Open" 15 "Over Range" 16 "Under Range" 17 "Undefined" 18 "Error!" 19 "Low Error" 20 "High Error" 21 "Non Critical No LED" 27 "Critical Green LED" 32 "Stall!" 33 "Synchronized" 34 "Syncing" 35 "Error!" 36 "Error!" 37 "Uncalibrated" 38 "Open Loop" 39 "Closed Loop" 40 "Not Learn" 41 "Learning" 42 "Off" 43 "On" 44 "Not Rev Limiting" 45 "Rev Limit" 46 "No Cut Off" 47 "CutOff!" 48 "Off" 49 "Warning!" 50 "Caution!" 51 "No Timing modifier" 52 "Timing is being modified" 53 "Timing Value is being replaced" 54 "Acq Sat" 55 "No GPS" 56 "No Data" 22 "Non Critical Green LED" 23 "Non Critical Yellow LED" 24 "Non Critical Red LED" 25 "Non Critical Blue LED" 26 "Non Critical Grey LED" 28 "Critical Yellow LED" 29 "Critical Red LED" 30 "Critical Blue LED" 31 "Critical Grey LED";
VAL_ 2658783232 Status 0 "OK" 1 "Disabled" 2 "Initializing" 3 "Heating" 4 "WB_Active" 5 "Too Cold" 6 "Too Hot" 7 "Unplugged" 8 "Slow!" 9 "Uncal Yellow" 10 "Uncal Red" 11 "Replace" 12 "Disabled" 13 "Shorted" 14 "Open" 15 "Over Range" 16 "Under Range" 17 "Undefined" 18 "Error!" 19 "Low Error" 20 "High Error" 21 "Non Critical No LED" 27 "Critical Green LED" 32 "Stall!" 33 "Synchronized" 34 "Syncing" 35 "Error!" 36 "Error!" 37 "Uncalibrated" 38 "Open Loop" 39 "Closed Loop" 40 "Not Learn" 41 "Learning" 42 "Off" 43 "On" 44 "Not Rev Limiting" 45 "Rev Limit" 46 "No Cut Off" 47 "CutOff!" 48 "Off" 49 "Warning!" 50 "Caution!" 51 "No Timing modifier" 52 "Timing is being modified" 53 "Timing Value is being replaced" 54 "Acq Sat" 55 "No GPS" 56 "No Data" 22 "Non Critical Green LED" 23 "Non Critical Yellow LED" 24 "Non Critical Red LED" 25 "Non Critical Blue LED" 26 "Non Critical Grey LED" 28 "Critical Yellow LED" 29 "Critical Red LED" 30 "Critical Blue LED" 31 "Critical Grey LED";
VAL_ 2658799616 Status 0 "OK" 1 "Disabled" 2 "Initializing" 3 "Heating" 4 "WB_Active" 5 "Too Cold" 6 "Too Hot" 7 "Unplugged" 8 "Slow!" 9 "Uncal Yellow" 10 "Uncal Red" 11 "Replace" 12 "Disabled" 13 "Shorted" 14 "Open" 15 "Over Range" 16 "Under Range" 17 "Undefined" 18 "Error!" 19 "Low Error" 20 "High Error" 21 "Non Critical No LED" 27 "Critical Green LED" 32 "Stall!" 33 "Synchronized" 34 "Syncing" 35 "Error!" 36 "Error!" 37 "Uncalibrated" 38 "Open Loop" 39 "Closed Loop" 40 "Not Learn" 41 "Learning" 42 "Off" 43 "On" 44 "Not Rev Limiting" 45 "Rev Limit" 46 "No Cut Off" 47 "CutOff!" 48 "Off" 49 "Warning!" 50 "Caution!" 51 "No Timing modifier" 52 "Timing is being modified" 53 "Timing Value is being replaced" 54 "Acq Sat" 55 "No GPS" 56 "No Data" 22 "Non Critical Green LED" 23 "Non Critical Yellow LED" 24 "Non Critical Red LED" 25 "Non Critical Blue LED" 26 "Non Critical Grey LED" 28 "Critical Yellow LED" 29 "Critical Red LED" 30 "Critical Blue LED" 31 "Critical Grey LED";
VAL_ 2658816000 Status 0 "OK" 1 "Disabled" 2 "Initializing" 3 "Heating" 4 "WB_Active" 5 "Too Cold" 6 "Too Hot" 7 "Unplugged" 8 "Slow!" 9 "Uncal Yellow" 10 "Uncal Red" 11 "Replace" 12 "Disabled" 13 "Shorted" 14 "Open" 15 "Over Range" 16 "Under Range" 17 "Undefined" 18 "Error!" 19 "Low Error" 20 "High Error" 21 "Non Critical No LED" 27 "Critical Green LED" 32 "Stall!" 33 "Synchronized" 34 "Syncing" 35 "Error!" 36 "Error!" 37 "Uncalibrated" 38 "Open Loop" 39 "Closed Loop" 40 "Not Learn" 41 "Learning" 42 "Off" 43 "On" 44 "Not Rev Limiting" 45 "Rev Limit" 46 "No Cut Off" 47 "CutOff!" 48 "Off" 49 "Warning!" 50 "Caution!" 51 "No Timing modifier" 52 "Timing is being modified" 53 "Timing Value is being replaced" 54 "Acq Sat" 55 "No GPS" 56 "No Data" 22 "Non Critical Green LED" 23 "Non Critical Yellow LED" 24 "Non Critical Red LED" 25 "Non Critical Blue LED" 26 "Non Critical Grey LED" 28 "Critical Yellow LED" 29 "Critical Red LED" 30 "Critical Blue LED" 31 "Critical Grey LED";
VAL_ 2658832384 Status 0 "OK" 1 "Disabled" 2 "Initializing" 3 "Heating" 4 "WB_Active" 5 "Too Cold" 6 "Too Hot" 7 "Unplugged" 8 "Slow!" 9 "Uncal Yellow" 10 "Uncal Red" 11 "Replace" 12 "Disabled" 13 "Shorted" 14 "Open" 15 "Over Range" 16 "Under Range" 17 "Undefined" 18 "Error!" 19 "Low Error" 20 "High Error" 21 "Non Critical No LED" 27 "Critical Green LED" 32 "Stall!" 33 "Synchronized" 34 "Syncing" 35 "Error!" 36 "Error!" 37 "Uncalibrated" 38 "Open Loop" 39 "Closed Loop" 40 "Not Learn" 41 "Learning" 42 "Off" 43 "On" 44 "Not Rev Limiting" 45 "Rev Limit" 46 "No Cut Off" 47 "CutOff!" 48 "Off" 49 "Warning!" 50 "Caution!" 51 "No Timing modifier" 52 "Timing is being modified" 53 "Timing Value is being replaced" 54 "Acq Sat" 55 "No GPS" 56 "No Data" 22 "Non Critical Green LED" 23 "Non Critical Yellow LED" 24 "Non Critical Red LED" 25 "Non Critical Blue LED" 26 "Non Critical Grey LED" 28 "Critical Yellow LED" 29 "Critical Red LED" 30 "Critical Blue LED" 31 "Critical Grey LED";
VAL_ 2658848768 Status 0 "OK" 1 "Disabled" 2 "Initializing" 3 "Heating" 4 "WB_Active" 5 "Too Cold" 6 "Too Hot" 7 "Unplugged" 8 "Slow!" 9 "Uncal Yellow" 10 "Uncal Red" 11 "Replace" 12 "Disabled" 13 "Shorted" 14 "Open" 15 "Over Range" 16 "Under Range" 17 "Undefined" 18 "Error!" 19 "Low Error" 20 "High Error" 21 "Non Critical No LED" 27 "Critical Green LED" 32 "Stall!" 33 "Synchronized" 34 "Syncing" 35 "Error!" 36 "Error!" 37 "Uncalibrated" 38 "Open Loop" 39 "Closed Loop" 40 "Not Learn" 41 "Learning" 42 "Off" 43 "On" 44 "Not Rev Limiting" 45 "Rev Limit" 46 "No Cut Off" 47 "CutOff!" 48 "Off" 49 "Warning!" 50 "Caution!" 51 "No Timing modifier" 52 "Timing is being modified" 53 "Timing Value is being replaced" 54 "Acq Sat" 55 "No GPS" 56 "No Data" 22 "Non Critical Green LED" 23 "Non Critical Yellow LED" 24 "Non Critical Red LED" 25 "Non Critical Blue LED" 26 "Non Critical Grey LED" 28 "Critical Yellow LED" 29 "Critical Red LED" 30 "Critical Blue LED" 31 "Critical Grey LED";
VAL_ 2658865152 Status 0 "OK" 1 "Disabled" 2 "Initializing" 3 "Heating" 4 "WB_Active" 5 "Too Cold" 6 "Too Hot" 7 "Unplugged" 8 "Slow!" 9 "Uncal Yellow" 10 "Uncal Red" 11 "Replace" 12 "Disabled" 13 "Shorted" 14 "Open" 15 "Over Range" 16 "Under Range" 17 "Undefined" 18 "Error!" 19 "Low Error" 20 "High Error" 21 "Non Critical No LED" 27 "Critical Green LED" 32 "Stall!" 33 "Synchronized" 34 "Syncing" 35 "Error!" 36 "Error!" 37 "Uncalibrated" 38 "Open Loop" 39 "Closed Loop" 40 "Not Learn" 41 "Learning" 42 "Off" 43 "On" 44 "Not Rev Limiting" 45 "Rev Limit" 46 "No Cut Off" 47 "CutOff!" 48 "Off" 49 "Warning!" 50 "Caution!" 51 "No Timing modifier" 52 "Timing is being modified" 53 "Timing Value is being replaced" 54 "Acq Sat" 55 "No GPS" 56 "No Data" 22 "Non Critical Green LED" 23 "Non Critical Yellow LED" 24 "Non Critical Red LED" 25 "Non Critical Blue LED" 26 "Non Critical Grey LED" 28 "Critical Yellow LED" 29 "Critical Red LED" 30 "Critical Blue LED" 31 "Critical Grey LED";
VAL_ 2658881536 Status 0 "OK" 1 "Disabled" 2 "Initializing" 3 "Heating" 4 "WB_Active" 5 "Too Cold" 6 "Too Hot" 7 "Unplugged" 8 "Slow!" 9 "Uncal Yellow" 10 "Uncal Red" 11 "Replace" 12 "Disabled" 13 "Shorted" 14 "Open" 15 "Over Range" 16 "Under Range" 17 "Undefined" 18 "Error!" 19 "Low Error" 20 "High Error" 21 "Non Critical No LED" 27 "Critical Green LED" 32 "Stall!" 33 "Synchronized" 34 "Syncing" 35 "Error!" 36 "Error!" 37 "Uncalibrated" 38 "Open Loop" 39 "Closed Loop" 40 "Not Learn" 41 "Learning" 42 "Off" 43 "On" 44 "Not Rev Limiting" 45 "Rev Limit" 46 "No Cut Off" 47 "CutOff!" 48 "Off" 49 "Warning!" 50 "Caution!" 51 "No Timing modifier" 52 "Timing is being modified" 53 "Timing Value is being replaced" 54 "Acq Sat" 55 "No GPS" 56 "No Data" 22 "Non Critical Green LED" 23 "Non Critical Yellow LED" 24 "Non Critical Red LED" 25 "Non Critical Blue LED" 26 "Non Critical Grey LED" 28 "Critical Yellow LED" 29 "Critical Red LED" 30 "Critical Blue LED" 31 "Critical Grey LED";
VAL_ 2658897920 Status 0 "OK" 1 "Disabled" 2 "Initializing" 3 "Heating" 4 "WB_Active" 5 "Too Cold" 6 "Too Hot" 7 "Unplugged" 8 "Slow!" 9 "Uncal Yellow" 10 "Uncal Red" 11 "Replace" 12 "Disabled" 13 "Shorted" 14 "Open" 15 "Over Range" 16 "Under Range" 17 "Undefined" 18 "Error!" 19 "Low Error" 20 "High Error" 21 "Non Critical No LED" 27 "Critical Green LED" 32 "Stall!" 33 "Synchronized" 34 "Syncing" 35 "Error!" 36 "Error!" 37 "Uncalibrated" 38 "Open Loop" 39 "Closed Loop" 40 "Not Learn" 41 "Learning" 42 "Off" 43 "On" 44 "Not Rev Limiting" 45 "Rev Limit" 46 "No Cut Off" 47 "CutOff!" 48 "Off" 49 "Warning!" 50 "Caution!" 51 "No Timing modifier" 52 "Timing is being modified" 53 "Timing Value is being replaced" 54 "Acq Sat" 55 "No GPS" 56 "No Data" 22 "Non Critical Green LED" 23 "Non Critical Yellow LED" 24 "Non Critical Red LED" 25 "Non Critical Blue LED" 26 "Non Critical Grey LED" 28 "Critical Yellow LED" 29 "Critical Red LED" 30 "Critical Blue LED" 31 "Critical Grey LED";
VAL_ 2658914304 Status 0 "OK" 1 "Disabled" 2 "Initializing" 3 "Heating" 4 "WB_Active" 5 "Too Cold" 6 "Too Hot" 7 "Unplugged" 8 "Slow!" 9 "Uncal Yellow" 10 "Uncal Red" 11 "Replace" 12 "Disabled" 13 "Shorted" 14 "Open" 15 "Over Range" 16 "Under Range" 17 "Undefined" 18 "Error!" 19 "Low Error" 20 "High Error" 21 "Non Critical No LED" 27 "Critical Green LED" 32 "Stall!" 33 "Synchronized" 34 "Syncing" 35 "Error!" 36 "Error!" 37 "Uncalibrated" 38 "Open Loop" 39 "Closed Loop" 40 "Not Learn" 41 "Learning" 42 "Off" 43 "On" 44 "Not Rev Limiting" 45 "Rev Limit" 46 "No Cut Off" 47 "CutOff!" 48 "Off" 49 "Warning!" 50 "Caution!" 51 "No Timing modifier" 52 "Timing is being modified" 53 "Timing Value is being replaced" 54 "Acq Sat" 55 "No GPS" 56 "No Data" 22 "Non Critical Green LED" 23 "Non Critical Yellow LED" 24 "Non Critical Red LED" 25 "Non Critical Blue LED" 26 "Non Critical Grey LED" 28 "Critical Yellow LED" 29 "Critical Red LED" 30 "Critical Blue LED" 31 "Critical Grey LED";
VAL_ 2658930688 Status 0 "OK" 1 "Disabled" 2 "Initializing" 3 "Heating" 4 "WB_Active" 5 "Too Cold" 6 "Too Hot" 7 "Unplugged" 8 "Slow!" 9 "Uncal Yellow" 10 "Uncal Red" 11 "Replace" 12 "Disabled" 13 "Shorted" 14 "Open" 15 "Over Range" 16 "Under Range" 17 "Undefined" 18 "Error!" 19 "Low Error" 20 "High Error" 21 "Non Critical No LED" 27 "Critical Green LED" 32 "Stall!" 33 "Synchronized" 34 "Syncing" 35 "Error!" 36 "Error!" 37 "Uncalibrated" 38 "Open Loop" 39 "Closed Loop" 40 "Not Learn" 41 "Learning" 42 "Off" 43 "On" 44 "Not Rev Limiting" 45 "Rev Limit" 46 "No Cut Off" 47 "CutOff!" 48 "Off" 49 "Warning!" 50 "Caution!" 51 "No Timing modifier" 52 "Timing is being modified" 53 "Timing Value is being replaced" 54 "Acq Sat" 55 "No GPS" 56 "No Data" 22 "Non Critical Green LED" 23 "Non Critical Yellow LED" 24 "Non Critical Red LED" 25 "Non Critical Blue LED" 26 "Non Critical Grey LED" 28 "Critical Yellow LED" 29 "Critical Red LED" 30 "Critical Blue LED" 31 "Critical Grey LED";
VAL_ 2658947072 Status 0 "OK" 1 "Disabled" 2 "Initializing" 3 "Heating" 4 "WB_Active" 5 "Too Cold" 6 "Too Hot" 7 "Unplugged" 8 "Slow!" 9 "Uncal Yellow" 10 "Uncal Red" 11 "Replace" 12 "Disabled" 13 "Shorted" 14 "Open" 15 "Over Range" 16 "Under Range" 17 "Undefined" 18 "Error!" 19 "Low Error" 20 "High Error" 21 "Non Critical No LED" 27 "Critical Green LED" 32 "Stall!" 33 "Synchronized" 34 "Syncing" 35 "Error!" 36 "Error!" 37 "Uncalibrated" 38 "Open Loop" 39 "Closed Loop" 40 "Not Learn" 41 "Learning" 42 "Off" 43 "On" 44 "Not Rev Limiting" 45 "Rev Limit" 46 "No Cut Off" 47 "CutOff!" 48 "Off" 49 "Warning!" 50 "Caution!" 51 "No Timing modifier" 52 "Timing is being modified" 53 "Timing Value is being replaced" 54 "Acq Sat" 55 "No GPS" 56 "No Data" 22 "Non Critical Green LED" 23 "Non Critical Yellow LED" 24 "Non Critical Red LED" 25 "Non Critical Blue LED" 26 "Non Critical Grey LED" 28 "Critical Yellow LED" 29 "Critical Red LED" 30 "Critical Blue LED" 31 "Critical Grey LED";
VAL_ 2658963456 Status 0 "OK" 1 "Disabled" 2 "Initializing" 3 "Heating" 4 "WB_Active" 5 "Too Cold" 6 "Too Hot" 7 "Unplugged" 8 "Slow!" 9 "Uncal Yellow" 10 "Uncal Red" 11 "Replace" 12 "Disabled" 13 "Shorted" 14 "Open" 15 "Over Range" 16 "Under Range" 17 "Undefined" 18 "Error!" 19 "Low Error" 20 "High Error" 21 "Non Critical No LED" 27 "Critical Green LED" 32 "Stall!" 33 "Synchronized" 34 "Syncing" 35 "Error!" 36 "Error!" 37 "Uncalibrated" 38 "Open Loop" 39 "Closed Loop" 40 "Not Learn" 41 "Learning" 42 "Off" 43 "On" 44 "Not Rev Limiting" 45 "Rev Limit" 46 "No Cut Off" 47 "CutOff!" 48 "Off" 49 "Warning!" 50 "Caution!" 51 "No Timing modifier" 52 "Timing is being modified" 53 "Timing Value is being replaced" 54 "Acq Sat" 55 "No GPS" 56 "No Data" 22 "Non Critical Green LED" 23 "Non Critical Yellow LED" 24 "Non Critical Red LED" 25 "Non Critical Blue LED" 26 "Non Critical Grey LED" 28 "Critical Yellow LED" 29 "Critical Red LED" 30 "Critical Blue LED" 31 "Critical Grey LED";
VAL_ 2658979840 Status 0 "OK" 1 "Disabled" 2 "Initializing" 3 "Heating" 4 "WB_Active" 5 "Too Cold" 6 "Too Hot" 7 "Unplugged" 8 "Slow!" 9 "Uncal Yellow" 10 "Uncal Red" 11 "Replace" 12 "Disabled" 13 "Shorted" 14 "Open" 15 "Over Range" 16 "Under Range" 17 "Undefined" 18 "Error!" 19 "Low Error" 20 "High Error" 21 "Non Critical No LED" 27 "Critical Green LED" 32 "Stall!" 33 "Synchronized" 34 "Syncing" 35 "Error!" 36 "Error!" 37 "Uncalibrated" 38 "Open Loop" 39 "Closed Loop" 40 "Not Learn" 41 "Learning" 42 "Off" 43 "On" 44 "Not Rev Limiting" 45 "Rev Limit" 46 "No Cut Off" 47 "CutOff!" 48 "Off" 49 "Warning!" 50 "Caution!" 51 "No Timing modifier" 52 "Timing is being modified" 53 "Timing Value is being replaced" 54 "Acq Sat" 55 "No GPS" 56 "No Data" 22 "Non Critical Green LED" 23 "Non Critical Yellow LED" 24 "Non Critical Red LED" 25 "Non Critical Blue LED" 26 "Non Critical Grey LED" 28 "Critical Yellow LED" 29 "Critical Red LED" 30 "Critical Blue LED" 31 "Critical Grey LED";
VAL_ 2658996224 Status 0 "OK" 1 "Disabled" 2 "Initializing" 3 "Heating" 4 "WB_Active" 5 "Too Cold" 6 "Too Hot" 7 "Unplugged" 8 "Slow!" 9 "Uncal Yellow" 10 "Uncal Red" 11 "Replace" 12 "Disabled" 13 "Shorted" 14 "Open" 15 "Over Range" 16 "Under Range" 17 "Undefined" 18 "Error!" 19 "Low Error" 20 "High Error" 21 "Non Critical No LED" 27 "Critical Green LED" 32 "Stall!" 33 "Synchronized" 34 "Syncing" 35 "Error!" 36 "Error!" 37 "Uncalibrated" 38 "Open Loop" 39 "Closed Loop" 40 "Not Learn" 41 "Learning" 42 "Off" 43 "On" 44 "Not Rev Limiting" 45 "Rev Limit" 46 "No Cut Off" 47 "CutOff!" 48 "Off" 49 "Warning!" 50 "Caution!" 51 "No Timing modifier" 52 "Timing is being modified" 53 "Timing Value is being replaced" 54 "Acq Sat" 55 "No GPS" 56 "No Data" 22 "Non Critical Green LED" 23 "Non Critical Yellow LED" 24 "Non Critical Red LED" 25 "Non Critical Blue LED" 26 "Non Critical Grey LED" 28 "Critical Yellow LED" 29 "Critical Red LED" 30 "Critical Blue LED" 31 "Critical Grey LED";
VAL_ 2659012608 Status 0 "OK" 1 "Disabled" 2 "Initializing" 3 "Heating" 4 "WB_Active" 5 "Too Cold" 6 "Too Hot" 7 "Unplugged" 8 "Slow!" 9 "Uncal Yellow" 10 "Uncal Red" 11 "Replace" 12 "Disabled" 13 "Shorted" 14 "Open" 15 "Over Range" 16 "Under Range" 17 "Undefined" 18 "Error!" 19 "Low Error" 20 "High Error" 21 "Non Critical No LED" 27 "Critical Green LED" 32 "Stall!" 33 "Synchronized" 34 "Syncing" 35 "Error!" 36 "Error!" 37 "Uncalibrated" 38 "Open Loop" 39 "Closed Loop" 40 "Not Learn" 41 "Learning" 42 "Off" 43 "On" 44 "Not Rev Limiting" 45 "Rev Limit" 46 "No Cut Off" 47 "CutOff!" 48 "Off" 49 "Warning!" 50 "Caution!" 51 "No Timing modifier" 52 "Timing is being modified" 53 "Timing Value is being replaced" 54 "Acq Sat" 55 "No GPS" 56 "No Data" 22 "Non Critical Green LED" 23 "Non Critical Yellow LED" 24 "Non Critical Red LED" 25 "Non Critical Blue LED" 26 "Non Critical Grey LED" 28 "Critical Yellow LED" 29 "Critical Red LED" 30 "Critical Blue LED" 31 "Critical Grey LED";
VAL_ 2659028992 Status 0 "OK" 1 "Disabled" 2 "Initializing" 3 "Heating" 4 "WB_Active" 5 "Too Cold" 6 "Too Hot" 7 "Unplugged" 8 "Slow!" 9 "Uncal Yellow" 10 "Uncal Red" 11 "Replace" 12 "Disabled" 13 "Shorted" 14 "Open" 15 "Over Range" 16 "Under Range" 17 "Undefined" 18 "Error!" 19 "Low Error" 20 "High Error" 21 "Non Critical No LED" 27 "Critical Green LED" 32 "Stall!" 33 "Synchronized" 34 "Syncing" 35 "Error!" 36 "Error!" 37 "Uncalibrated" 38 "Open Loop" 39 "Closed Loop" 40 "Not Learn" 41 "Learning" 42 "Off" 43 "On" 44 "Not Rev Limiting" 45 "Rev Limit" 46 "No Cut Off" 47 "CutOff!" 48 "Off" 49 "Warning!" 50 "Caution!" 51 "No Timing modifier" 52 "Timing is being modified" 53 "Timing Value is being replaced" 54 "Acq Sat" 55 "No GPS" 56 "No Data" 22 "Non Critical Green LED" 23 "Non Critical Yellow LED" 24 "Non Critical Red LED" 25 "Non Critical Blue LED" 26 "Non Critical Grey LED" 28 "Critical Yellow LED" 29 "Critical Red LED" 30 "Critical Blue LED" 31 "Critical Grey LED";
VAL_ 2659045376 Status 0 "OK" 1 "Disabled" 2 "Initializing" 3 "Heating" 4 "WB_Active" 5 "Too Cold" 6 "Too Hot" 7 "Unplugged" 8 "Slow!" 9 "Uncal Yellow" 10 "Uncal Red" 11 "Replace" 12 "Disabled" 13 "Shorted" 14 "Open" 15 "Over Range" 16 "Under Range" 17 "Undefined" 18 "Error!" 19 "Low Error" 20 "High Error" 21 "Non Critical No LED" 27 "Critical Green LED" 32 "Stall!" 33 "Synchronized" 34 "Syncing" 35 "Error!" 36 "Error!" 37 "Uncalibrated" 38 "Open Loop" 39 "Closed Loop" 40 "Not Learn" 41 "Learning" 42 "Off" 43 "On" 44 "Not Rev Limiting" 45 "Rev Limit" 46 "No Cut Off" 47 "CutOff!" 48 "Off" 49 "Warning!" 50 "Caution!" 51 "No Timing modifier" 52 "Timing is being modified" 53 "Timing Value is being replaced" 54 "Acq Sat" 55 "No GPS" 56 "No Data" 22 "Non Critical Green LED" 23 "Non Critical Yellow LED" 24 "Non Critical Red LED" 25 "Non Critical Blue LED" 26 "Non Critical Grey LED" 28 "Critical Yellow LED" 29 "Critical Red LED" 30 "Critical Blue LED" 31 "Critical Grey LED";
VAL_ 2659061760 Status 0 "OK" 1 "Disabled" 2 "Initializing" 3 "Heating" 4 "WB_Active" 5 "Too Cold" 6 "Too Hot" 7 "Unplugged" 8 "Slow!" 9 "Uncal Yellow" 10 "Uncal Red" 11 "Replace" 12 "Disabled" 13 "Shorted" 14 "Open" 15 "Over Range" 16 "Under Range" 17 "Undefined" 18 "Error!" 19 "Low Error" 20 "High Error" 21 "Non Critical No LED" 27 "Critical Green LED" 32 "Stall!" 33 "Synchronized" 34 "Syncing" 35 "Error!" 36 "Error!" 37 "Uncalibrated" 38 "Open Loop" 39 "Closed Loop" 40 "Not Learn" 41 "Learning" 42 "Off" 43 "On" 44 "Not Rev Limiting" 45 "Rev Limit" 46 "No Cut Off" 47 "CutOff!" 48 "Off" 49 "Warning!" 50 "Caution!" 51 "No Timing modifier" 52 "Timing is being modified" 53 "Timing Value is being replaced" 54 "Acq Sat" 55 "No GPS" 56 "No Data" 22 "Non Critical Green LED" 23 "Non Critical Yellow LED" 24 "Non Critical Red LED" 25 "Non Critical Blue LED" 26 "Non Critical Grey LED" 28 "Critical Yellow LED" 29 "Critical Red LED" 30 "Critical Blue LED" 31 "Critical Grey LED";
VAL_ 2659078144 Status 0 "OK" 1 "Disabled" 2 "Initializing" 3 "Heating" 4 "WB_Active" 5 "Too Cold" 6 "Too Hot" 7 "Unplugged" 8 "Slow!" 9 "Uncal Yellow" 10 "Uncal Red" 11 "Replace" 12 "Disabled" 13 "Shorted" 14 "Open" 15 "Over Range" 16 "Under Range" 17 "Undefined" 18 "Error!" 19 "Low Error" 20 "High Error" 21 "Non Critical No LED" 27 "Critical Green LED" 32 "Stall!" 33 "Synchronized" 34 "Syncing" 35 "Error!" 36 "Error!" 37 "Uncalibrated" 38 "Open Loop" 39 "Closed Loop" 40 "Not Learn" 41 "Learning" 42 "Off" 43 "On" 44 "Not Rev Limiting" 45 "Rev Limit" 46 "No Cut Off" 47 "CutOff!" 48 "Off" 49 "Warning!" 50 "Caution!" 51 "No Timing modifier" 52 "Timing is being modified" 53 "Timing Value is being replaced" 54 "Acq Sat" 55 "No GPS" 56 "No Data" 22 "Non Critical Green LED" 23 "Non Critical Yellow LED" 24 "Non Critical Red LED" 25 "Non Critical Blue LED" 26 "Non Critical Grey LED" 28 "Critical Yellow LED" 29 "Critical Red LED" 30 "Critical Blue LED" 31 "Critical Grey LED";
VAL_ 2659094528 Status 0 "OK" 1 "Disabled" 2 "Initializing" 3 "Heating" 4 "WB_Active" 5 "Too Cold" 6 "Too Hot" 7 "Unplugged" 8 "Slow!" 9 "Uncal Yellow" 10 "Uncal Red" 11 "Replace" 12 "Disabled" 13 "Shorted" 14 "Open" 15 "Over Range" 16 "Under Range" 17 "Undefined" 18 "Error!" 19 "Low Error" 20 "High Error" 21 "Non Critical No LED" 27 "Critical Green LED" 32 "Stall!" 33 "Synchronized" 34 "Syncing" 35 "Error!" 36 "Error!" 37 "Uncalibrated" 38 "Open Loop" 39 "Closed Loop" 40 "Not Learn" 41 "Learning" 42 "Off" 43 "On" 44 "Not Rev Limiting" 45 "Rev Limit" 46 "No Cut Off" 47 "CutOff!" 48 "Off" 49 "Warning!" 50 "Caution!" 51 "No Timing modifier" 52 "Timing is being modified" 53 "Timing Value is being replaced" 54 "Acq Sat" 55 "No GPS" 56 "No Data" 22 "Non Critical Green LED" 23 "Non Critical Yellow LED" 24 "Non Critical Red LED" 25 "Non Critical Blue LED" 26 "Non Critical Grey LED" 28 "Critical Yellow LED" 29 "Critical Red LED" 30 "Critical Blue LED" 31 "Critical Grey LED";
VAL_ 2659110912 Status 0 "OK" 1 "Disabled" 2 "Initializing" 3 "Heating" 4 "WB_Active" 5 "Too Cold" 6 "Too Hot" 7 "Unplugged" 8 "Slow!" 9 "Uncal Yellow" 10 "Uncal Red" 11 "Replace" 12 "Disabled" 13 "Shorted" 14 "Open" 15 "Over Range" 16 "Under Range" 17 "Undefined" 18 "Error!" 19 "Low Error" 20 "High Error" 21 "Non Critical No LED" 27 "Critical Green LED" 32 "Stall!" 33 "Synchronized" 34 "Syncing" 35 "Error!" 36 "Error!" 37 "Uncalibrated" 38 "Open Loop" 39 "Closed Loop" 40 "Not Learn" 41 "Learning" 42 "Off" 43 "On" 44 "Not Rev Limiting" 45 "Rev Limit" 46 "No Cut Off" 47 "CutOff!" 48 "Off" 49 "Warning!" 50 "Caution!" 51 "No Timing modifier" 52 "Timing is being modified" 53 "Timing Value is being replaced" 54 "Acq Sat" 55 "No GPS" 56 "No Data" 22 "Non Critical Green LED" 23 "Non Critical Yellow LED" 24 "Non Critical Red LED" 25 "Non Critical Blue LED" 26 "Non Critical Grey LED" 28 "Critical Yellow LED" 29 "Critical Red LED" 30 "Critical Blue LED" 31 "Critical Grey LED";
VAL_ 2659127296 Status 0 "OK" 1 "Disabled" 2 "Initializing" 3 "Heating" 4 "WB_Active" 5 "Too Cold" 6 "Too Hot" 7 "Unplugged" 8 "Slow!" 9 "Uncal Yellow" 10 "Uncal Red" 11 "Replace" 12 "Disabled" 13 "Shorted" 14 "Open" 15 "Over Range" 16 "Under Range" 17 "Undefined" 18 "Error!" 19 "Low Error" 20 "High Error" 21 "Non Critical No LED" 27 "Critical Green LED" 32 "Stall!" 33 "Synchronized" 34 "Syncing" 35 "Error!" 36 "Error!" 37 "Uncalibrated" 38 "Open Loop" 39 "Closed Loop" 40 "Not Learn" 41 "Learning" 42 "Off" 43 "On" 44 "Not Rev Limiting" 45 "Rev Limit" 46 "No Cut Off" 47 "CutOff!" 48 "Off" 49 "Warning!" 50 "Caution!" 51 "No Timing modifier" 52 "Timing is being modified" 53 "Timing Value is being replaced" 54 "Acq Sat" 55 "No GPS" 56 "No Data" 22 "Non Critical Green LED" 23 "Non Critical Yellow LED" 24 "Non Critical Red LED" 25 "Non Critical Blue LED" 26 "Non Critical Grey LED" 28 "Critical Yellow LED" 29 "Critical Red LED" 30 "Critical Blue LED" 31 "Critical Grey LED";
VAL_ 2659143680 Status 0 "OK" 1 "Disabled" 2 "Initializing" 3 "Heating" 4 "WB_Active" 5 "Too Cold" 6 "Too Hot" 7 "Unplugged" 8 "Slow!" 9 "Uncal Yellow" 10 "Uncal Red" 11 "Replace" 12 "Disabled" 13 "Shorted" 14 "Open" 15 "Over Range" 16 "Under Range" 17 "Undefined" 18 "Error!" 19 "Low Error" 20 "High Error" 21 "Non Critical No LED" 27 "Critical Green LED" 32 "Stall!" 33 "Synchronized" 34 "Syncing" 35 "Error!" 36 "Error!" 37 "Uncalibrated" 38 "Open Loop" 39 "Closed Loop" 40 "Not Learn" 41 "Learning" 42 "Off" 43 "On" 44 "Not Rev Limiting" 45 "Rev Limit" 46 "No Cut Off" 47 "CutOff!" 48 "Off" 49 "Warning!" 50 "Caution!" 51 "No Timing modifier" 52 "Timing is being modified" 53 "Timing Value is being replaced" 54 "Acq Sat" 55 "No GPS" 56 "No Data" 22 "Non Critical Green LED" 23 "Non Critical Yellow LED" 24 "Non Critical Red LED" 25 "Non Critical Blue LED" 26 "Non Critical Grey LED" 28 "Critical Yellow LED" 29 "Critical Red LED" 30 "Critical Blue LED" 31 "Critical Grey LED";
VAL_ 2659160064 Status 0 "OK" 1 "Disabled" 2 "Initializing" 3 "Heating" 4 "WB_Active" 5 "Too Cold" 6 "Too Hot" 7 "Unplugged" 8 "Slow!" 9 "Uncal Yellow" 10 "Uncal Red" 11 "Replace" 12 "Disabled" 13 "Shorted" 14 "Open" 15 "Over Range" 16 "Under Range" 17 "Undefined" 18 "Error!" 19 "Low Error" 20 "High Error" 21 "Non Critical No LED" 27 "Critical Green LED" 32 "Stall!" 33 "Synchronized" 34 "Syncing" 35 "Error!" 36 "Error!" 37 "Uncalibrated" 38 "Open Loop" 39 "Closed Loop" 40 "Not Learn" 41 "Learning" 42 "Off" 43 "On" 44 "Not Rev Limiting" 45 "Rev Limit" 46 "No Cut Off" 47 "CutOff!" 48 "Off" 49 "Warning!" 50 "Caution!" 51 "No Timing modifier" 52 "Timing is being modified" 53 "Timing Value is being replaced" 54 "Acq Sat" 55 "No GPS" 56 "No Data" 22 "Non Critical Green LED" 23 "Non Critical Yellow LED" 24 "Non Critical Red LED" 25 "Non Critical Blue LED" 26 "Non Critical Grey LED" 28 "Critical Yellow LED" 29 "Critical Red LED" 30 "Critical Blue LED" 31 "Critical Grey LED";
VAL_ 2659176448 Status 0 "OK" 1 "Disabled" 2 "Initializing" 3 "Heating" 4 "WB_Active" 5 "Too Cold" 6 "Too Hot" 7 "Unplugged" 8 "Slow!" 9 "Uncal Yellow" 10 "Uncal Red" 11 "Replace" 12 "Disabled" 13 "Shorted" 14 "Open" 15 "Over Range" 16 "Under Range" 17 "Undefined" 18 "Error!" 19 "Low Error" 20 "High Error" 21 "Non Critical No LED" 27 "Critical Green LED" 32 "Stall!" 33 "Synchronized" 34 "Syncing" 35 "Error!" 36 "Error!" 37 "Uncalibrated" 38 "Open Loop" 39 "Closed Loop" 40 "Not Learn" 41 "Learning" 42 "Off" 43 "On" 44 "Not Rev Limiting" 45 "Rev Limit" 46 "No Cut Off" 47 "CutOff!" 48 "Off" 49 "Warning!" 50 "Caution!" 51 "No Timing modifier" 52 "Timing is being modified" 53 "Timing Value is being replaced" 54 "Acq Sat" 55 "No GPS" 56 "No Data" 22 "Non Critical Green LED" 23 "Non Critical Yellow LED" 24 "Non Critical Red LED" 25 "Non Critical Blue LED" 26 "Non Critical Grey LED" 28 "Critical Yellow LED" 29 "Critical Red LED" 30 "Critical Blue LED" 31 "Critical Grey LED";
VAL_ 2659192832 Status 0 "OK" 1 "Disabled" 2 "Initializing" 3 "Heating" 4 "WB_Active" 5 "Too Cold" 6 "Too Hot" 7 "Unplugged" 8 "Slow!" 9 "Uncal Yellow" 10 "Uncal Red" 11 "Replace" 12 "Disabled" 13 "Shorted" 14 "Open" 15 "Over Range" 16 "Under Range" 17 "Undefined" 18 "Error!" 19 "Low Error" 20 "High Error" 21 "Non Critical No LED" 27 "Critical Green LED" 32 "Stall!" 33 "Synchronized" 34 "Syncing" 35 "Error!" 36 "Error!" 37 "Uncalibrated" 38 "Open Loop" 39 "Closed Loop" 40 "Not Learn" 41 "Learning" 42 "Off" 43 "On" 44 "Not Rev Limiting" 45 "Rev Limit" 46 "No Cut Off" 47 "CutOff!" 48 "Off" 49 "Warning!" 50 "Caution!" 51 "No Timing modifier" 52 "Timing is being modified" 53 "Timing Value is being replaced" 54 "Acq Sat" 55 "No GPS" 56 "No Data" 22 "Non Critical Green LED" 23 "Non Critical Yellow LED" 24 "Non Critical Red LED" 25 "Non Critical Blue LED" 26 "Non Critical Grey LED" 28 "Critical Yellow LED" 29 "Critical Red LED" 30 "Critical Blue LED" 31 "Critical Grey LED";
VAL_ 2659209216 Status 0 "OK" 1 "Disabled" 2 "Initializing" 3 "Heating" 4 "WB_Active" 5 "Too Cold" 6 "Too Hot" 7 "Unplugged" 8 "Slow!" 9 "Uncal Yellow" 10 "Uncal Red" 11 "Replace" 12 "Disabled" 13 "Shorted" 14 "Open" 15 "Over Range" 16 "Under Range" 17 "Undefined" 18 "Error!" 19 "Low Error" 20 "High Error" 21 "Non Critical No LED" 27 "Critical Green LED" 32 "Stall!" 33 "Synchronized" 34 "Syncing" 35 "Error!" 36 "Error!" 37 "Uncalibrated" 38 "Open Loop" 39 "Closed Loop" 40 "Not Learn" 41 "Learning" 42 "Off" 43 "On" 44 "Not Rev Limiting" 45 "Rev Limit" 46 "No Cut Off" 47 "CutOff!" 48 "Off" 49 "Warning!" 50 "Caution!" 51 "No Timing modifier" 52 "Timing is being modified" 53 "Timing Value is being replaced" 54 "Acq Sat" 55 "No GPS" 56 "No Data" 22 "Non Critical Green LED" 23 "Non Critical Yellow LED" 24 "Non Critical Red LED" 25 "Non Critical Blue LED" 26 "Non Critical Grey LED" 28 "Critical Yellow LED" 29 "Critical Red LED" 30 "Critical Blue LED" 31 "Critical Grey LED";
VAL_ 2659225600 Status 0 "OK" 1 "Disabled" 2 "Initializing" 3 "Heating" 4 "WB_Active" 5 "Too Cold" 6 "Too Hot" 7 "Unplugged" 8 "Slow!" 9 "Uncal Yellow" 10 "Uncal Red" 11 "Replace" 12 "Disabled" 13 "Shorted" 14 "Open" 15 "Over Range" 16 "Under Range" 17 "Undefined" 18 "Error!" 19 "Low Error" 20 "High Error" 21 "Non Critical No LED" 27 "Critical Green LED" 32 "Stall!" 33 "Synchronized" 34 "Syncing" 35 "Error!" 36 "Error!" 37 "Uncalibrated" 38 "Open Loop" 39 "Closed Loop" 40 "Not Learn" 41 "Learning" 42 "Off" 43 "On" 44 "Not Rev Limiting" 45 "Rev Limit" 46 "No Cut Off" 47 "CutOff!" 48 "Off" 49 "Warning!" 50 "Caution!" 51 "No Timing modifier" 52 "Timing is being modified" 53 "Timing Value is being replaced" 54 "Acq Sat" 55 "No GPS" 56 "No Data" 22 "Non Critical Green LED" 23 "Non Critical Yellow LED" 24 "Non Critical Red LED" 25 "Non Critical Blue LED" 26 "Non Critical Grey LED" 28 "Critical Yellow LED" 29 "Critical Red LED" 30 "Critical Blue LED" 31 "Critical Grey LED";
VAL_ 2659241984 Status 0 "OK" 1 "Disabled" 2 "Initializing" 3 "Heating" 4 "WB_Active" 5 "Too Cold" 6 "Too Hot" 7 "Unplugged" 8 "Slow!" 9 "Uncal Yellow" 10 "Uncal Red" 11 "Replace" 12 "Disabled" 13 "Shorted" 14 "Open" 15 "Over Range" 16 "Under Range" 17 "Undefined" 18 "Error!" 19 "Low Error" 20 "High Error" 21 "Non Critical No LED" 27 "Critical Green LED" 32 "Stall!" 33 "Synchronized" 34 "Syncing" 35 "Error!" 36 "Error!" 37 "Uncalibrated" 38 "Open Loop" 39 "Closed Loop" 40 "Not Learn" 41 "Learning" 42 "Off" 43 "On" 44 "Not Rev Limiting" 45 "Rev Limit" 46 "No Cut Off" 47 "CutOff!" 48 "Off" 49 "Warning!" 50 "Caution!" 51 "No Timing modifier" 52 "Timing is being modified" 53 "Timing Value is being replaced" 54 "Acq Sat" 55 "No GPS" 56 "No Data" 22 "Non Critical Green LED" 23 "Non Critical Yellow LED" 24 "Non Critical Red LED" 25 "Non Critical Blue LED" 26 "Non Critical Grey LED" 28 "Critical Yellow LED" 29 "Critical Red LED" 30 "Critical Blue LED" 31 "Critical Grey LED";
VAL_ 2659258368 Status 0 "OK" 1 "Disabled" 2 "Initializing" 3 "Heating" 4 "WB_Active" 5 "Too Cold" 6 "Too Hot" 7 "Unplugged" 8 "Slow!" 9 "Uncal Yellow" 10 "Uncal Red" 11 "Replace" 12 "Disabled" 13 "Shorted" 14 "Open" 15 "Over Range" 16 "Under Range" 17 "Undefined" 18 "Error!" 19 "Low Error" 20 "High Error" 21 "Non Critical No LED" 27 "Critical Green LED" 32 "Stall!" 33 "Synchronized" 34 "Syncing" 35 "Error!" 36 "Error!" 37 "Uncalibrated" 38 "Open Loop" 39 "Closed Loop" 40 "Not Learn" 41 "Learning" 42 "Off" 43 "On" 44 "Not Rev Limiting" 45 "Rev Limit" 46 "No Cut Off" 47 "CutOff!" 48 "Off" 49 "Warning!" 50 "Caution!" 51 "No Timing modifier" 52 "Timing is being modified" 53 "Timing Value is being replaced" 54 "Acq Sat" 55 "No GPS" 56 "No Data" 22 "Non Critical Green LED" 23 "Non Critical Yellow LED" 24 "Non Critical Red LED" 25 "Non Critical Blue LED" 26 "Non Critical Grey LED" 28 "Critical Yellow LED" 29 "Critical Red LED" 30 "Critical Blue LED" 31 "Critical Grey LED";
VAL_ 2659274752 Status 0 "OK" 1 "Disabled" 2 "Initializing" 3 "Heating" 4 "WB_Active" 5 "Too Cold" 6 "Too Hot" 7 "Unplugged" 8 "Slow!" 9 "Uncal Yellow" 10 "Uncal Red" 11 "Replace" 12 "Disabled" 13 "Shorted" 14 "Open" 15 "Over Range" 16 "Under Range" 17 "Undefined" 18 "Error!" 19 "Low Error" 20 "High Error" 21 "Non Critical No LED" 27 "Critical Green LED" 32 "Stall!" 33 "Synchronized" 34 "Syncing" 35 "Error!" 36 "Error!" 37 "Uncalibrated" 38 "Open Loop" 39 "Closed Loop" 40 "Not Learn" 41 "Learning" 42 "Off" 43 "On" 44 "Not Rev Limiting" 45 "Rev Limit" 46 "No Cut Off" 47 "CutOff!" 48 "Off" 49 "Warning!" 50 "Caution!" 51 "No Timing modifier" 52 "Timing is being modified" 53 "Timing Value is being replaced" 54 "Acq Sat" 55 "No GPS" 56 "No Data" 22 "Non Critical Green LED" 23 "Non Critical Yellow LED" 24 "Non Critical Red LED" 25 "Non Critical Blue LED" 26 "Non Critical Grey LED" 28 "Critical Yellow LED" 29 "Critical Red LED" 30 "Critical Blue LED" 31 "Critical Grey LED";
VAL_ 2659291136 Status 0 "OK" 1 "Disabled" 2 "Initializing" 3 "Heating" 4 "WB_Active" 5 "Too Cold" 6 "Too Hot" 7 "Unplugged" 8 "Slow!" 9 "Uncal Yellow" 10 "Uncal Red" 11 "Replace" 12 "Disabled" 13 "Shorted" 14 "Open" 15 "Over Range" 16 "Under Range" 17 "Undefined" 18 "Error!" 19 "Low Error" 20 "High Error" 21 "Non Critical No LED" 27 "Critical Green LED" 32 "Stall!" 33 "Synchronized" 34 "Syncing" 35 "Error!" 36 "Error!" 37 "Uncalibrated" 38 "Open Loop" 39 "Closed Loop" 40 "Not Learn" 41 "Learning" 42 "Off" 43 "On" 44 "Not Rev Limiting" 45 "Rev Limit" 46 "No Cut Off" 47 "CutOff!" 48 "Off" 49 "Warning!" 50 "Caution!" 51 "No Timing modifier" 52 "Timing is being modified" 53 "Timing Value is being replaced" 54 "Acq Sat" 55 "No GPS" 56 "No Data" 22 "Non Critical Green LED" 23 "Non Critical Yellow LED" 24 "Non Critical Red LED" 25 "Non Critical Blue LED" 26 "Non Critical Grey LED" 28 "Critical Yellow LED" 29 "Critical Red LED" 30 "Critical Blue LED" 31 "Critical Grey LED";
VAL_ 2659307520 Status 0 "OK" 1 "Disabled" 2 "Initializing" 3 "Heating" 4 "WB_Active" 5 "Too Cold" 6 "Too Hot" 7 "Unplugged" 8 "Slow!" 9 "Uncal Yellow" 10 "Uncal Red" 11 "Replace" 12 "Disabled" 13 "Shorted" 14 "Open" 15 "Over Range" 16 "Under Range" 17 "Undefined" 18 "Error!" 19 "Low Error" 20 "High Error" 21 "Non Critical No LED" 27 "Critical Green LED" 32 "Stall!" 33 "Synchronized" 34 "Syncing" 35 "Error!" 36 "Error!" 37 "Uncalibrated" 38 "Open Loop" 39 "Closed Loop" 40 "Not Learn" 41 "Learning" 42 "Off" 43 "On" 44 "Not Rev Limiting" 45 "Rev Limit" 46 "No Cut Off" 47 "CutOff!" 48 "Off" 49 "Warning!" 50 "Caution!" 51 "No Timing modifier" 52 "Timing is being modified" 53 "Timing Value is being replaced" 54 "Acq Sat" 55 "No GPS" 56 "No Data" 22 "Non Critical Green LED" 23 "Non Critical Yellow LED" 24 "Non Critical Red LED" 25 "Non Critical Blue LED" 26 "Non Critical Grey LED" 28 "Critical Yellow LED" 29 "Critical Red LED" 30 "Critical Blue LED" 31 "Critical Grey LED";
VAL_ 2659323904 Status 0 "OK" 1 "Disabled" 2 "Initializing" 3 "Heating" 4 "WB_Active" 5 "Too Cold" 6 "Too Hot" 7 "Unplugged" 8 "Slow!" 9 "Uncal Yellow" 10 "Uncal Red" 11 "Replace" 12 "Disabled" 13 "Shorted" 14 "Open" 15 "Over Range" 16 "Under Range" 17 "Undefined" 18 "Error!" 19 "Low Error" 20 "High Error" 21 "Non Critical No LED" 27 "Critical Green LED" 32 "Stall!" 33 "Synchronized" 34 "Syncing" 35 "Error!" 36 "Error!" 37 "Uncalibrated" 38 "Open Loop" 39 "Closed Loop" 40 "Not Learn" 41 "Learning" 42 "Off" 43 "On" 44 "Not Rev Limiting" 45 "Rev Limit" 46 "No Cut Off" 47 "CutOff!" 48 "Off" 49 "Warning!" 50 "Caution!" 51 "No Timing modifier" 52 "Timing is being modified" 53 "Timing Value is being replaced" 54 "Acq Sat" 55 "No GPS" 56 "No Data" 22 "Non Critical Green LED" 23 "Non Critical Yellow LED" 24 "Non Critical Red LED" 25 "Non Critical Blue LED" 26 "Non Critical Grey LED" 28 "Critical Yellow LED" 29 "Critical Red LED" 30 "Critical Blue LED" 31 "Critical Grey LED";
VAL_ 2659340288 Status 0 "OK" 1 "Disabled" 2 "Initializing" 3 "Heating" 4 "WB_Active" 5 "Too Cold" 6 "Too Hot" 7 "Unplugged" 8 "Slow!" 9 "Uncal Yellow" 10 "Uncal Red" 11 "Replace" 12 "Disabled" 13 "Shorted" 14 "Open" 15 "Over Range" 16 "Under Range" 17 "Undefined" 18 "Error!" 19 "Low Error" 20 "High Error" 21 "Non Critical No LED" 27 "Critical Green LED" 32 "Stall!" 33 "Synchronized" 34 "Syncing" 35 "Error!" 36 "Error!" 37 "Uncalibrated" 38 "Open Loop" 39 "Closed Loop" 40 "Not Learn" 41 "Learning" 42 "Off" 43 "On" 44 "Not Rev Limiting" 45 "Rev Limit" 46 "No Cut Off" 47 "CutOff!" 48 "Off" 49 "Warning!" 50 "Caution!" 51 "No Timing modifier" 52 "Timing is being modified" 53 "Timing Value is being replaced" 54 "Acq Sat" 55 "No GPS" 56 "No Data" 22 "Non Critical Green LED" 23 "Non Critical Yellow LED" 24 "Non Critical Red LED" 25 "Non Critical Blue LED" 26 "Non Critical Grey LED" 28 "Critical Yellow LED" 29 "Critical Red LED" 30 "Critical Blue LED" 31 "Critical Grey LED";
VAL_ 2659356672 Status 0 "OK" 1 "Disabled" 2 "Initializing" 3 "Heating" 4 "WB_Active" 5 "Too Cold" 6 "Too Hot" 7 "Unplugged" 8 "Slow!" 9 "Uncal Yellow" 10 "Uncal Red" 11 "Replace" 12 "Disabled" 13 "Shorted" 14 "Open" 15 "Over Range" 16 "Under Range" 17 "Undefined" 18 "Error!" 19 "Low Error" 20 "High Error" 21 "Non Critical No LED" 27 "Critical Green LED" 32 "Stall!" 33 "Synchronized" 34 "Syncing" 35 "Error!" 36 "Error!" 37 "Uncalibrated" 38 "Open Loop" 39 "Closed Loop" 40 "Not Learn" 41 "Learning" 42 "Off" 43 "On" 44 "Not Rev Limiting" 45 "Rev Limit" 46 "No Cut Off" 47 "CutOff!" 48 "Off" 49 "Warning!" 50 "Caution!" 51 "No Timing modifier" 52 "Timing is being modified" 53 "Timing Value is being replaced" 54 "Acq Sat" 55 "No GPS" 56 "No Data" 22 "Non Critical Green LED" 23 "Non Critical Yellow LED" 24 "Non Critical Red LED" 25 "Non Critical Blue LED" 26 "Non Critical Grey LED" 28 "Critical Yellow LED" 29 "Critical Red LED" 30 "Critical Blue LED" 31 "Critical Grey LED";
VAL_ 2659373056 Status 0 "OK" 1 "Disabled" 2 "Initializing" 3 "Heating" 4 "WB_Active" 5 "Too Cold" 6 "Too Hot" 7 "Unplugged" 8 "Slow!" 9 "Uncal Yellow" 10 "Uncal Red" 11 "Replace" 12 "Disabled" 13 "Shorted" 14 "Open" 15 "Over Range" 16 "Under Range" 17 "Undefined" 18 "Error!" 19 "Low Error" 20 "High Error" 21 "Non Critical No LED" 27 "Critical Green LED" 32 "Stall!" 33 "Synchronized" 34 "Syncing" 35 "Error!" 36 "Error!" 37 "Uncalibrated" 38 "Open Loop" 39 "Closed Loop" 40 "Not Learn" 41 "Learning" 42 "Off" 43 "On" 44 "Not Rev Limiting" 45 "Rev Limit" 46 "No Cut Off" 47 "CutOff!" 48 "Off" 49 "Warning!" 50 "Caution!" 51 "No Timing modifier" 52 "Timing is being modified" 53 "Timing Value is being replaced" 54 "Acq Sat" 55 "No GPS" 56 "No Data" 22 "Non Critical Green LED" 23 "Non Critical Yellow LED" 24 "Non Critical Red LED" 25 "Non Critical Blue LED" 26 "Non Critical Grey LED" 28 "Critical Yellow LED" 29 "Critical Red LED" 30 "Critical Blue LED" 31 "Critical Grey LED";
VAL_ 2659389440 Status 0 "OK" 1 "Disabled" 2 "Initializing" 3 "Heating" 4 "WB_Active" 5 "Too Cold" 6 "Too Hot" 7 "Unplugged" 8 "Slow!" 9 "Uncal Yellow" 10 "Uncal Red" 11 "Replace" 12 "Disabled" 13 "Shorted" 14 "Open" 15 "Over Range" 16 "Under Range" 17 "Undefined" 18 "Error!" 19 "Low Error" 20 "High Error" 21 "Non Critical No LED" 27 "Critical Green LED" 32 "Stall!" 33 "Synchronized" 34 "Syncing" 35 "Error!" 36 "Error!" 37 "Uncalibrated" 38 "Open Loop" 39 "Closed Loop" 40 "Not Learn" 41 "Learning" 42 "Off" 43 "On" 44 "Not Rev Limiting" 45 "Rev Limit" 46 "No Cut Off" 47 "CutOff!" 48 "Off" 49 "Warning!" 50 "Caution!" 51 "No Timing modifier" 52 "Timing is being modified" 53 "Timing Value is being replaced" 54 "Acq Sat" 55 "No GPS" 56 "No Data" 22 "Non Critical Green LED" 23 "Non Critical Yellow LED" 24 "Non Critical Red LED" 25 "Non Critical Blue LED" 26 "Non Critical Grey LED" 28 "Critical Yellow LED" 29 "Critical Red LED" 30 "Critical Blue LED" 31 "Critical Grey LED";
SIG_VALTYPE_ 2657357824 IO_OUTPUT23 : 1;
SIG_VALTYPE_ 2657374208 IO_OUTPUT24 : 1;
SIG_VALTYPE_ 2657390592 IO_OUTPUT25 : 1;
SIG_VALTYPE_ 2657406976 IO_OUTPUT26 : 1;
SIG_VALTYPE_ 2657423360 IO_OUTPUT27 : 1;
SIG_VALTYPE_ 2657439744 IO_OUTPUT28 : 1;
SIG_VALTYPE_ 2657456128 IO_OUTPUT29 : 1;
SIG_VALTYPE_ 2657472512 IO_OUTPUT30 : 1;
SIG_VALTYPE_ 2657488896 IO_OUTPUT31 : 1;
SIG_VALTYPE_ 2657505280 IO_OUTPUT32 : 1;
SIG_VALTYPE_ 2657521664 IO_OUTPUT33 : 1;
SIG_VALTYPE_ 2657538048 IO_OUTPUT34 : 1;
SIG_VALTYPE_ 2657554432 IO_OUTPUT35 : 1;
SIG_VALTYPE_ 2657570816 IO_OUTPUT36 : 1;
SIG_VALTYPE_ 2657587200 IO_OUTPUT37 : 1;
SIG_VALTYPE_ 2657603584 IO_OUTPUT38 : 1;
SIG_VALTYPE_ 2657619968 IO_OUTPUT39 : 1;
SIG_VALTYPE_ 2657636352 IO_OUTPUT40 : 1;
SIG_VALTYPE_ 2657652736 IO_OUTPUT41 : 1;
SIG_VALTYPE_ 2657669120 IO_OUTPUT42 : 1;
SIG_VALTYPE_ 2657685504 IO_OUTPUT43 : 1;
SIG_VALTYPE_ 2657701888 IO_OUTPUT44 : 1;
SIG_VALTYPE_ 2657718272 IO_OUTPUT45 : 1;
SIG_VALTYPE_ 2657734656 IO_OUTPUT46 : 1;
SIG_VALTYPE_ 2657751040 IO_OUTPUT47 : 1;
SIG_VALTYPE_ 2657767424 IO_OUTPUT48 : 1;
SIG_VALTYPE_ 2657783808 IO_OUTPUT49 : 1;
SIG_VALTYPE_ 2657800192 IO_OUTPUT50 : 1;
SIG_VALTYPE_ 2657816576 IO_OUTPUT51 : 1;
SIG_VALTYPE_ 2657832960 IO_OUTPUT52 : 1;
SIG_VALTYPE_ 2657849344 IO_OUTPUT53 : 1;
SIG_VALTYPE_ 2657865728 IO_OUTPUT54 : 1;
SIG_VALTYPE_ 2657882112 IO_OUTPUT55 : 1;
SIG_VALTYPE_ 2657898496 IO_OUTPUT56 : 1;
SIG_VALTYPE_ 2657914880 IO_OUTPUT57 : 1;
SIG_VALTYPE_ 2657931264 IO_OUTPUT58 : 1;
SIG_VALTYPE_ 2657947648 IO_OUTPUT59 : 1;
SIG_VALTYPE_ 2657964032 IO_OUTPUT60 : 1;
SIG_VALTYPE_ 2657980416 IO_OUTPUT61 : 1;
SIG_VALTYPE_ 2657996800 IO_OUTPUT62 : 1;
SIG_VALTYPE_ 2658013184 FUEL_TABLE1_PERCENT : 1;
SIG_VALTYPE_ 2658029568 FUEL_TABLE2_PERCENT : 1;
SIG_VALTYPE_ 2658045952 FUEL_TABLE3_PERCENT : 1;
SIG_VALTYPE_ 2658062336 SYSTEM_INJ_PPH13 : 1;
SIG_VALTYPE_ 2658078720 SYSTEM_INJ_PPH14 : 1;
SIG_VALTYPE_ 2658095104 SYSTEM_INJ_PPH15 : 1;
SIG_VALTYPE_ 2658111488 SYSTEM_INJ_PPH16 : 1;
SIG_VALTYPE_ 2658127872 SYSTEM_INJ_PPH17 : 1;
SIG_VALTYPE_ 2658144256 SYSTEM_INJ_PPH18 : 1;
SIG_VALTYPE_ 2658160640 SYSTEM_INJ_PPH19 : 1;
SIG_VALTYPE_ 2658177024 SYSTEM_INJ_PPH20 : 1;
SIG_VALTYPE_ 2658193408 SYSTEM_INJ_PPH21 : 1;
SIG_VALTYPE_ 2658209792 SYSTEM_INJ_PPH22 : 1;
SIG_VALTYPE_ 2658226176 SYSTEM_INJ_PPH23 : 1;
SIG_VALTYPE_ 2658242560 SYSTEM_INJ_PPH24 : 1;
SIG_VALTYPE_ 2658258944 SYSTEM_INJ_PPH25 : 1;
SIG_VALTYPE_ 2658275328 SYSTEM_INJ_PPH26 : 1;
SIG_VALTYPE_ 2658291712 SYSTEM_INJ_PPH27 : 1;
SIG_VALTYPE_ 2658308096 SYSTEM_INJ_PPH28 : 1;
SIG_VALTYPE_ 2658324480 SYSTEM_INJ_PW13 : 1;
SIG_VALTYPE_ 2658340864 SYSTEM_INJ_PW14 : 1;
SIG_VALTYPE_ 2658357248 SYSTEM_INJ_PW15 : 1;
SIG_VALTYPE_ 2658373632 SYSTEM_INJ_PW16 : 1;
SIG_VALTYPE_ 2658390016 SYSTEM_INJ_PW17 : 1;
SIG_VALTYPE_ 2658406400 SYSTEM_INJ_PW18 : 1;
SIG_VALTYPE_ 2658422784 SYSTEM_INJ_PW19 : 1;
SIG_VALTYPE_ 2658439168 SYSTEM_INJ_PW20 : 1;
SIG_VALTYPE_ 2658455552 SYSTEM_INJ_PW21 : 1;
SIG_VALTYPE_ 2658471936 SYSTEM_INJ_PW22 : 1;
SIG_VALTYPE_ 2658488320 SYSTEM_INJ_PW23 : 1;
SIG_VALTYPE_ 2658504704 SYSTEM_INJ_PW24 : 1;
SIG_VALTYPE_ 2658521088 SYSTEM_INJ_PW25 : 1;
SIG_VALTYPE_ 2658537472 SYSTEM_INJ_PW26 : 1;
SIG_VALTYPE_ 2658553856 SYSTEM_INJ_PW27 : 1;
SIG_VALTYPE_ 2658570240 SYSTEM_INJ_PW28 : 1;
SIG_VALTYPE_ 2658586624 SYSTEM_STAGING_INPUT1 : 1;
SIG_VALTYPE_ 2658603008 SYSTEM_STAGING_INPUT2 : 1;
SIG_VALTYPE_ 2658619392 SYSTEM_STAGING_OUTPUT : 1;
SIG_VALTYPE_ 2658635776 TRACTION_SMARTDROP : 1;
SIG_VALTYPE_ 2658652160 TRACTION_TIMINGRETARD : 1;
SIG_VALTYPE_ 2658668544 TRACTION_N2ODECREASE : 1;
SIG_VALTYPE_ 2658684928 TRACTION_BOOSTDECREASE : 1;
SIG_VALTYPE_ 2658701312 TRACTION_DBWDECREASE : 1;
SIG_VALTYPE_ 2658717696 TRACTION_DSTIMINGOFFSET : 1;
SIG_VALTYPE_ 2658734080 TRACTION_CSTIMINGOFFSET : 1;
SIG_VALTYPE_ 2658750464 TRACTION_DSREVLIMIT : 1;
SIG_VALTYPE_ 2658766848 TRACTION_CSREVLIMIT : 1;
SIG_VALTYPE_ 2658783232 TRACTION_TCTIME : 1;
SIG_VALTYPE_ 2658799616 TRACTION_TCLAUNCHINPUT : 1;
SIG_VALTYPE_ 2658816000 DIFUEL_GRAMSPERCYLINDER : 1;
SIG_VALTYPE_ 2658832384 VVT_DESIREDINTAKECAMPOS : 1;
SIG_VALTYPE_ 2658848768 VVT_ACTUALINTAKECAMPOS : 1;
SIG_VALTYPE_ 2658865152 VVT_INTAKESOLDUTY : 1;
SIG_VALTYPE_ 2658881536 VVT_DESIREDEXHAUSTCAMPOS : 1;
SIG_VALTYPE_ 2658897920 VVT_ACTUALEXHAUSTCAMPOS : 1;
SIG_VALTYPE_ 2658914304 VVT_EXHAUSTSOLDUTY : 1;
SIG_VALTYPE_ 2658930688 TRANS_GOVERNORPRESSUREPSIACTUAL : 1;
SIG_VALTYPE_ 2658947072 TRANS_GOVERNORPRESSUREPSITARGET : 1;
SIG_VALTYPE_ 2658963456 TRANS_LINEPRESSUREPSIACTUAL : 1;
SIG_VALTYPE_ 2658979840 RACE_LAUNCH_STATUS : 1;
SIG_VALTYPE_ 2658996224 RACE_SPOOL_ASSIST_OUTPUT_STATUS2 : 1;
SIG_VALTYPE_ 2659012608 RACE_SHIFT_SINGLE_OUTPUT_STATUS : 1;
SIG_VALTYPE_ 2659028992 RACE_SHIFT_1_2_OUTPUT_STATUS : 1;
SIG_VALTYPE_ 2659045376 RACE_SHIFT_2_3_OUTPUT_STATUS : 1;
SIG_VALTYPE_ 2659061760 RACE_SHIFT_3_4_OUTPUT_STATUS : 1;
SIG_VALTYPE_ 2659078144 RACE_SHIFT_4_5_OUTPUT_STATUS : 1;
SIG_VALTYPE_ 2659094528 RACE_SHIFT_5_6_OUTPUT_STATUS : 1;
SIG_VALTYPE_ 2659110912 RACE_SHIFT_6_7_OUTPUT_STATUS : 1;
SIG_VALTYPE_ 2659127296 RACE_SHIFT_7_8_OUTPUT_STATUS : 1;
SIG_VALTYPE_ 2659143680 RACE_SHIFT_OVERRIDE_STATUS : 1;
SIG_VALTYPE_ 2659160064 RACE_SHIFT_MASTER_ENABLE_STATUS : 1;
SIG_VALTYPE_ 2659176448 RACE_SHIFT_IGNITION_CUT_STATUS : 1;
SIG_VALTYPE_ 2659192832 RACE_SHIFT_TIMING_MODIFIER : 1;
SIG_VALTYPE_ 2659209216 RACE_SHIFT_TIMER : 1;
SIG_VALTYPE_ 2659225600 RACE_CONVERTER_LOCK1 : 1;
SIG_VALTYPE_ 2659241984 RACE_CONVERTER_LOCK2 : 1;
SIG_VALTYPE_ 2659258368 RACE_CONVERTER_LOCK3 : 1;
SIG_VALTYPE_ 2659274752 RACE_CONVERTER_LOCK4 : 1;
SIG_VALTYPE_ 2659291136 RACE_CONVERTER_LOCK_DISABLE_STAT : 1;
SIG_VALTYPE_ 2659307520 RACE_SPOOL_ASSIST_OUTPUT_STATUS : 1;
SIG_VALTYPE_ 2659323904 RACE_TRANS_DUMP_VALVE1 : 1;
SIG_VALTYPE_ 2659340288 RACE_TRANS_DUMP_VALVE2 : 1;
SIG_VALTYPE_ 2659356672 RACE_TRANS_DUMP_VALVE3 : 1;
SIG_VALTYPE_ 2659373056 RACE_TRANS_DUMP_VALVE4 : 1;
SIG_VALTYPE_ 2659389440 RACE_TRANS_DUMP_DISABLE_STATUS : 1;
